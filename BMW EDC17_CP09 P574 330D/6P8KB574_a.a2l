ASAP2_VERSION 1 4
/begin PROJECT P_574 "EDC17_CP09"
/begin HEADER "" VERSION "V8KB" PROJECT_NO P_574 /end HEADER
/begin MODULE DIM ""
/begin MOD_COMMON "" BYTE_ORDER MSB_LAST ALIGNMENT_BYTE 1 ALIGNMENT_WORD 2 ALIGNMENT_LONG 4 ALIGNMENT_FLOAT32_IEEE 4 /end MOD_COMMON
/begin MEASUREMENT DFES_numDFC00 "Namen der im Fehlerspeicher eingetragenen Fehlerprüfungen" UWORD DFCDSQ_Verb 1 100 0.00 1213. FORMAT "%2.0" ECU_ADDRESS 0xD0008C3E /end MEASUREMENT
/begin MEASUREMENT DFES_numDFC01 "Namen der im Fehlerspeicher eingetragenen Fehlerprüfungen" UWORD DFCDSQ_Verb 1 100 0.00 1213. FORMAT "%2.0" ECU_ADDRESS 0xD0008C40 /end MEASUREMENT
/begin MEASUREMENT DFES_numDFC02 "Namen der im Fehlerspeicher eingetragenen Fehlerprüfungen" UWORD DFCDSQ_Verb 1 100 0.00 1213. FORMAT "%2.0" ECU_ADDRESS 0xD0008C42 /end MEASUREMENT
/begin MEASUREMENT DFES_numDFC03 "Namen der im Fehlerspeicher eingetragenen Fehlerprüfungen" UWORD DFCDSQ_Verb 1 100 0.00 1213. FORMAT "%2.0" ECU_ADDRESS 0xD0008C44 /end MEASUREMENT
/begin MEASUREMENT DFES_numDFC04 "Namen der im Fehlerspeicher eingetragenen Fehlerprüfungen" UWORD DFCDSQ_Verb 1 100 0.00 1213. FORMAT "%2.0" ECU_ADDRESS 0xD0008C46 /end MEASUREMENT
/begin MEASUREMENT DFES_numDFC05 "Namen der im Fehlerspeicher eingetragenen Fehlerprüfungen" UWORD DFCDSQ_Verb 1 100 0.00 1213. FORMAT "%2.0" ECU_ADDRESS 0xD0008C48 /end MEASUREMENT
/begin MEASUREMENT DFES_numDFC06 "Namen der im Fehlerspeicher eingetragenen Fehlerprüfungen" UWORD DFCDSQ_Verb 1 100 0.00 1213. FORMAT "%2.0" ECU_ADDRESS 0xD0008C4A /end MEASUREMENT
/begin MEASUREMENT DFES_numDFC07 "Namen der im Fehlerspeicher eingetragenen Fehlerprüfungen" UWORD DFCDSQ_Verb 1 100 0.00 1213. FORMAT "%2.0" ECU_ADDRESS 0xD0008C4C /end MEASUREMENT
/begin MEASUREMENT DFES_numDFC08 "Namen der im Fehlerspeicher eingetragenen Fehlerprüfungen" UWORD DFCDSQ_Verb 1 100 0.00 1213. FORMAT "%2.0" ECU_ADDRESS 0xD0008C4E /end MEASUREMENT
/begin MEASUREMENT DFES_numDFC09 "Namen der im Fehlerspeicher eingetragenen Fehlerprüfungen" UWORD DFCDSQ_Verb 1 100 0.00 1213. FORMAT "%2.0" ECU_ADDRESS 0xD0008C50 /end MEASUREMENT
/begin MEASUREMENT DFES_numDFC10 "Namen der im Fehlerspeicher eingetragenen Fehlerprüfungen" UWORD DFCDSQ_Verb 1 100 0.00 1213. FORMAT "%2.0" ECU_ADDRESS 0xD0008C52 /end MEASUREMENT
/begin MEASUREMENT DFES_numDFC11 "Namen der im Fehlerspeicher eingetragenen Fehlerprüfungen" UWORD DFCDSQ_Verb 1 100 0.00 1213. FORMAT "%2.0" ECU_ADDRESS 0xD0008C54 /end MEASUREMENT
/begin MEASUREMENT DFES_numDFC12 "Namen der im Fehlerspeicher eingetragenen Fehlerprüfungen" UWORD DFCDSQ_Verb 1 100 0.00 1213. FORMAT "%2.0" ECU_ADDRESS 0xD0008C56 /end MEASUREMENT
/begin MEASUREMENT DFES_numDFC13 "Namen der im Fehlerspeicher eingetragenen Fehlerprüfungen" UWORD DFCDSQ_Verb 1 100 0.00 1213. FORMAT "%2.0" ECU_ADDRESS 0xD0008C58 /end MEASUREMENT
/begin MEASUREMENT DFES_numDFC14 "Namen der im Fehlerspeicher eingetragenen Fehlerprüfungen" UWORD DFCDSQ_Verb 1 100 0.00 1213. FORMAT "%2.0" ECU_ADDRESS 0xD0008C5A /end MEASUREMENT
/begin MEASUREMENT DFES_numDFC15 "Namen der im Fehlerspeicher eingetragenen Fehlerprüfungen" UWORD DFCDSQ_Verb 1 100 0.00 1213. FORMAT "%2.0" ECU_ADDRESS 0xD0008C5C /end MEASUREMENT
/begin MEASUREMENT DFES_numDFC16 "Namen der im Fehlerspeicher eingetragenen Fehlerprüfungen" UWORD DFCDSQ_Verb 1 100 0.00 1213. FORMAT "%2.0" ECU_ADDRESS 0xD0008C5E /end MEASUREMENT
/begin MEASUREMENT DFES_numDFC17 "Namen der im Fehlerspeicher eingetragenen Fehlerprüfungen" UWORD DFCDSQ_Verb 1 100 0.00 1213. FORMAT "%2.0" ECU_ADDRESS 0xD0008C60 /end MEASUREMENT
/begin MEASUREMENT DFES_numDFC18 "Namen der im Fehlerspeicher eingetragenen Fehlerprüfungen" UWORD DFCDSQ_Verb 1 100 0.00 1213. FORMAT "%2.0" ECU_ADDRESS 0xD0008C62 /end MEASUREMENT
/begin MEASUREMENT DFES_numDFC19 "Namen der im Fehlerspeicher eingetragenen Fehlerprüfungen" UWORD DFCDSQ_Verb 1 100 0.00 1213. FORMAT "%2.0" ECU_ADDRESS 0xD0008C64 /end MEASUREMENT
/begin MEASUREMENT DFES_Order00 "Auftragsstatus aller Fehlerspeichereinträge" UWORD DFES_OneToOne 1 100 0.00 65535.00 ECU_ADDRESS 0xD00038CC /end MEASUREMENT
/begin MEASUREMENT DFES_Order01 "Auftragsstatus aller Fehlerspeichereinträge" UWORD DFES_OneToOne 1 100 0.00 65535.00 ECU_ADDRESS 0xD00038CE /end MEASUREMENT
/begin MEASUREMENT DFES_Order02 "Auftragsstatus aller Fehlerspeichereinträge" UWORD DFES_OneToOne 1 100 0.00 65535.00 ECU_ADDRESS 0xD00038D0 /end MEASUREMENT
/begin MEASUREMENT DFES_Order03 "Auftragsstatus aller Fehlerspeichereinträge" UWORD DFES_OneToOne 1 100 0.00 65535.00 ECU_ADDRESS 0xD00038D2 /end MEASUREMENT
/begin MEASUREMENT DFES_Order04 "Auftragsstatus aller Fehlerspeichereinträge" UWORD DFES_OneToOne 1 100 0.00 65535.00 ECU_ADDRESS 0xD00038D4 /end MEASUREMENT
/begin MEASUREMENT DFES_Order05 "Auftragsstatus aller Fehlerspeichereinträge" UWORD DFES_OneToOne 1 100 0.00 65535.00 ECU_ADDRESS 0xD00038D6 /end MEASUREMENT
/begin MEASUREMENT DFES_Order06 "Auftragsstatus aller Fehlerspeichereinträge" UWORD DFES_OneToOne 1 100 0.00 65535.00 ECU_ADDRESS 0xD00038D8 /end MEASUREMENT
/begin MEASUREMENT DFES_Order07 "Auftragsstatus aller Fehlerspeichereinträge" UWORD DFES_OneToOne 1 100 0.00 65535.00 ECU_ADDRESS 0xD00038DA /end MEASUREMENT
/begin MEASUREMENT DFES_Order08 "Auftragsstatus aller Fehlerspeichereinträge" UWORD DFES_OneToOne 1 100 0.00 65535.00 ECU_ADDRESS 0xD00038DC /end MEASUREMENT
/begin MEASUREMENT DFES_Order09 "Auftragsstatus aller Fehlerspeichereinträge" UWORD DFES_OneToOne 1 100 0.00 65535.00 ECU_ADDRESS 0xD00038DE /end MEASUREMENT
/begin MEASUREMENT DFES_Order10 "Auftragsstatus aller Fehlerspeichereinträge" UWORD DFES_OneToOne 1 100 0.00 65535.00 ECU_ADDRESS 0xD00038E0 /end MEASUREMENT
/begin MEASUREMENT DFES_Order11 "Auftragsstatus aller Fehlerspeichereinträge" UWORD DFES_OneToOne 1 100 0.00 65535.00 ECU_ADDRESS 0xD00038E2 /end MEASUREMENT
/begin MEASUREMENT DFES_Order12 "Auftragsstatus aller Fehlerspeichereinträge" UWORD DFES_OneToOne 1 100 0.00 65535.00 ECU_ADDRESS 0xD00038E4 /end MEASUREMENT
/begin MEASUREMENT DFES_Order13 "Auftragsstatus aller Fehlerspeichereinträge" UWORD DFES_OneToOne 1 100 0.00 65535.00 ECU_ADDRESS 0xD00038E6 /end MEASUREMENT
/begin MEASUREMENT DFES_Order14 "Auftragsstatus aller Fehlerspeichereinträge" UWORD DFES_OneToOne 1 100 0.00 65535.00 ECU_ADDRESS 0xD00038E8 /end MEASUREMENT
/begin MEASUREMENT DFES_Order15 "Auftragsstatus aller Fehlerspeichereinträge" UWORD DFES_OneToOne 1 100 0.00 65535.00 ECU_ADDRESS 0xD00038EA /end MEASUREMENT
/begin MEASUREMENT DFES_Order16 "Auftragsstatus aller Fehlerspeichereinträge" UWORD DFES_OneToOne 1 100 0.00 65535.00 ECU_ADDRESS 0xD00038EC /end MEASUREMENT
/begin MEASUREMENT DFES_Order17 "Auftragsstatus aller Fehlerspeichereinträge" UWORD DFES_OneToOne 1 100 0.00 65535.00 ECU_ADDRESS 0xD00038EE /end MEASUREMENT
/begin MEASUREMENT DFES_Order18 "Auftragsstatus aller Fehlerspeichereinträge" UWORD DFES_OneToOne 1 100 0.00 65535.00 ECU_ADDRESS 0xD00038F0 /end MEASUREMENT
/begin MEASUREMENT DFES_Order19 "Auftragsstatus aller Fehlerspeichereinträge" UWORD DFES_OneToOne 1 100 0.00 65535.00 ECU_ADDRESS 0xD00038F2 /end MEASUREMENT
/begin MEASUREMENT DFES_OutLamps00 "Fehlerlampenzustand aller Fehlerspeichereinträge" UBYTE DFES_OneToOne 1 100 0.00 255.0 ECU_ADDRESS 0xC0006B07 /end MEASUREMENT
/begin MEASUREMENT DFES_OutLamps01 "Fehlerlampenzustand aller Fehlerspeichereinträge" UBYTE DFES_OneToOne 1 100 0.00 255.0 ECU_ADDRESS 0xC0006B08 /end MEASUREMENT
/begin MEASUREMENT DFES_OutLamps02 "Fehlerlampenzustand aller Fehlerspeichereinträge" UBYTE DFES_OneToOne 1 100 0.00 255.0 ECU_ADDRESS 0xC0006B09 /end MEASUREMENT
/begin MEASUREMENT DFES_OutLamps03 "Fehlerlampenzustand aller Fehlerspeichereinträge" UBYTE DFES_OneToOne 1 100 0.00 255.0 ECU_ADDRESS 0xC0006B0A /end MEASUREMENT
/begin MEASUREMENT DFES_OutLamps04 "Fehlerlampenzustand aller Fehlerspeichereinträge" UBYTE DFES_OneToOne 1 100 0.00 255.0 ECU_ADDRESS 0xC0006B0B /end MEASUREMENT
/begin MEASUREMENT DFES_OutLamps05 "Fehlerlampenzustand aller Fehlerspeichereinträge" UBYTE DFES_OneToOne 1 100 0.00 255.0 ECU_ADDRESS 0xC0006B0C /end MEASUREMENT
/begin MEASUREMENT DFES_OutLamps06 "Fehlerlampenzustand aller Fehlerspeichereinträge" UBYTE DFES_OneToOne 1 100 0.00 255.0 ECU_ADDRESS 0xC0006B0D /end MEASUREMENT
/begin MEASUREMENT DFES_OutLamps07 "Fehlerlampenzustand aller Fehlerspeichereinträge" UBYTE DFES_OneToOne 1 100 0.00 255.0 ECU_ADDRESS 0xC0006B0E /end MEASUREMENT
/begin MEASUREMENT DFES_OutLamps08 "Fehlerlampenzustand aller Fehlerspeichereinträge" UBYTE DFES_OneToOne 1 100 0.00 255.0 ECU_ADDRESS 0xC0006B0F /end MEASUREMENT
/begin MEASUREMENT DFES_OutLamps09 "Fehlerlampenzustand aller Fehlerspeichereinträge" UBYTE DFES_OneToOne 1 100 0.00 255.0 ECU_ADDRESS 0xC0006B10 /end MEASUREMENT
/begin MEASUREMENT DFES_OutLamps10 "Fehlerlampenzustand aller Fehlerspeichereinträge" UBYTE DFES_OneToOne 1 100 0.00 255.0 ECU_ADDRESS 0xC0006B11 /end MEASUREMENT
/begin MEASUREMENT DFES_OutLamps11 "Fehlerlampenzustand aller Fehlerspeichereinträge" UBYTE DFES_OneToOne 1 100 0.00 255.0 ECU_ADDRESS 0xC0006B12 /end MEASUREMENT
/begin MEASUREMENT DFES_OutLamps12 "Fehlerlampenzustand aller Fehlerspeichereinträge" UBYTE DFES_OneToOne 1 100 0.00 255.0 ECU_ADDRESS 0xC0006B13 /end MEASUREMENT
/begin MEASUREMENT DFES_OutLamps13 "Fehlerlampenzustand aller Fehlerspeichereinträge" UBYTE DFES_OneToOne 1 100 0.00 255.0 ECU_ADDRESS 0xC0006B14 /end MEASUREMENT
/begin MEASUREMENT DFES_OutLamps14 "Fehlerlampenzustand aller Fehlerspeichereinträge" UBYTE DFES_OneToOne 1 100 0.00 255.0 ECU_ADDRESS 0xC0006B15 /end MEASUREMENT
/begin MEASUREMENT DFES_OutLamps15 "Fehlerlampenzustand aller Fehlerspeichereinträge" UBYTE DFES_OneToOne 1 100 0.00 255.0 ECU_ADDRESS 0xC0006B16 /end MEASUREMENT
/begin MEASUREMENT DFES_OutLamps16 "Fehlerlampenzustand aller Fehlerspeichereinträge" UBYTE DFES_OneToOne 1 100 0.00 255.0 ECU_ADDRESS 0xC0006B17 /end MEASUREMENT
/begin MEASUREMENT DFES_OutLamps17 "Fehlerlampenzustand aller Fehlerspeichereinträge" UBYTE DFES_OneToOne 1 100 0.00 255.0 ECU_ADDRESS 0xC0006B18 /end MEASUREMENT
/begin MEASUREMENT DFES_OutLamps18 "Fehlerlampenzustand aller Fehlerspeichereinträge" UBYTE DFES_OneToOne 1 100 0.00 255.0 ECU_ADDRESS 0xC0006B19 /end MEASUREMENT
/begin MEASUREMENT DFES_OutLamps19 "Fehlerlampenzustand aller Fehlerspeichereinträge" UBYTE DFES_OneToOne 1 100 0.00 255.0 ECU_ADDRESS 0xC0006B1A /end MEASUREMENT
/begin MEASUREMENT DFES_OutTester00 "Testersichtbarkeit aller Fehlerspeichereinträge" UBYTE DFES_OneToOne 1 100 0.00 255.0 ECU_ADDRESS 0xC0006B1B /end MEASUREMENT
/begin MEASUREMENT DFES_OutTester01 "Testersichtbarkeit aller Fehlerspeichereinträge" UBYTE DFES_OneToOne 1 100 0.00 255.0 ECU_ADDRESS 0xC0006B1C /end MEASUREMENT
/begin MEASUREMENT DFES_OutTester02 "Testersichtbarkeit aller Fehlerspeichereinträge" UBYTE DFES_OneToOne 1 100 0.00 255.0 ECU_ADDRESS 0xC0006B1D /end MEASUREMENT
/begin MEASUREMENT DFES_OutTester03 "Testersichtbarkeit aller Fehlerspeichereinträge" UBYTE DFES_OneToOne 1 100 0.00 255.0 ECU_ADDRESS 0xC0006B1E /end MEASUREMENT
/begin MEASUREMENT DFES_OutTester04 "Testersichtbarkeit aller Fehlerspeichereinträge" UBYTE DFES_OneToOne 1 100 0.00 255.0 ECU_ADDRESS 0xC0006B1F /end MEASUREMENT
/begin MEASUREMENT DFES_OutTester05 "Testersichtbarkeit aller Fehlerspeichereinträge" UBYTE DFES_OneToOne 1 100 0.00 255.0 ECU_ADDRESS 0xC0006B20 /end MEASUREMENT
/begin MEASUREMENT DFES_OutTester06 "Testersichtbarkeit aller Fehlerspeichereinträge" UBYTE DFES_OneToOne 1 100 0.00 255.0 ECU_ADDRESS 0xC0006B21 /end MEASUREMENT
/begin MEASUREMENT DFES_OutTester07 "Testersichtbarkeit aller Fehlerspeichereinträge" UBYTE DFES_OneToOne 1 100 0.00 255.0 ECU_ADDRESS 0xC0006B22 /end MEASUREMENT
/begin MEASUREMENT DFES_OutTester08 "Testersichtbarkeit aller Fehlerspeichereinträge" UBYTE DFES_OneToOne 1 100 0.00 255.0 ECU_ADDRESS 0xC0006B23 /end MEASUREMENT
/begin MEASUREMENT DFES_OutTester09 "Testersichtbarkeit aller Fehlerspeichereinträge" UBYTE DFES_OneToOne 1 100 0.00 255.0 ECU_ADDRESS 0xC0006B24 /end MEASUREMENT
/begin MEASUREMENT DFES_OutTester10 "Testersichtbarkeit aller Fehlerspeichereinträge" UBYTE DFES_OneToOne 1 100 0.00 255.0 ECU_ADDRESS 0xC0006B25 /end MEASUREMENT
/begin MEASUREMENT DFES_OutTester11 "Testersichtbarkeit aller Fehlerspeichereinträge" UBYTE DFES_OneToOne 1 100 0.00 255.0 ECU_ADDRESS 0xC0006B26 /end MEASUREMENT
/begin MEASUREMENT DFES_OutTester12 "Testersichtbarkeit aller Fehlerspeichereinträge" UBYTE DFES_OneToOne 1 100 0.00 255.0 ECU_ADDRESS 0xC0006B27 /end MEASUREMENT
/begin MEASUREMENT DFES_OutTester13 "Testersichtbarkeit aller Fehlerspeichereinträge" UBYTE DFES_OneToOne 1 100 0.00 255.0 ECU_ADDRESS 0xC0006B28 /end MEASUREMENT
/begin MEASUREMENT DFES_OutTester14 "Testersichtbarkeit aller Fehlerspeichereinträge" UBYTE DFES_OneToOne 1 100 0.00 255.0 ECU_ADDRESS 0xC0006B29 /end MEASUREMENT
/begin MEASUREMENT DFES_OutTester15 "Testersichtbarkeit aller Fehlerspeichereinträge" UBYTE DFES_OneToOne 1 100 0.00 255.0 ECU_ADDRESS 0xC0006B2A /end MEASUREMENT
/begin MEASUREMENT DFES_OutTester16 "Testersichtbarkeit aller Fehlerspeichereinträge" UBYTE DFES_OneToOne 1 100 0.00 255.0 ECU_ADDRESS 0xC0006B2B /end MEASUREMENT
/begin MEASUREMENT DFES_OutTester17 "Testersichtbarkeit aller Fehlerspeichereinträge" UBYTE DFES_OneToOne 1 100 0.00 255.0 ECU_ADDRESS 0xC0006B2C /end MEASUREMENT
/begin MEASUREMENT DFES_OutTester18 "Testersichtbarkeit aller Fehlerspeichereinträge" UBYTE DFES_OneToOne 1 100 0.00 255.0 ECU_ADDRESS 0xC0006B2D /end MEASUREMENT
/begin MEASUREMENT DFES_OutTester19 "Testersichtbarkeit aller Fehlerspeichereinträge" UBYTE DFES_OneToOne 1 100 0.00 255.0 ECU_ADDRESS 0xC0006B2E /end MEASUREMENT
/begin MEASUREMENT DFES_stChk00 "Prüfungsstatus aller im Fehlerspeicher eingetragenen DFCs" UBYTE DFES_stCheck_Verb 1 100 0.00 247.000000000 FORMAT "%13.9" ECU_ADDRESS 0xD0008C7A /end MEASUREMENT
/begin MEASUREMENT DFES_stChk01 "Prüfungsstatus aller im Fehlerspeicher eingetragenen DFCs" UBYTE DFES_stCheck_Verb 1 100 0.00 247.000000000 FORMAT "%13.9" ECU_ADDRESS 0xD0008C7B /end MEASUREMENT
/begin MEASUREMENT DFES_stChk02 "Prüfungsstatus aller im Fehlerspeicher eingetragenen DFCs" UBYTE DFES_stCheck_Verb 1 100 0.00 247.000000000 FORMAT "%13.9" ECU_ADDRESS 0xD0008C7C /end MEASUREMENT
/begin MEASUREMENT DFES_stChk03 "Prüfungsstatus aller im Fehlerspeicher eingetragenen DFCs" UBYTE DFES_stCheck_Verb 1 100 0.00 247.000000000 FORMAT "%13.9" ECU_ADDRESS 0xD0008C7D /end MEASUREMENT
/begin MEASUREMENT DFES_stChk04 "Prüfungsstatus aller im Fehlerspeicher eingetragenen DFCs" UBYTE DFES_stCheck_Verb 1 100 0.00 247.000000000 FORMAT "%13.9" ECU_ADDRESS 0xD0008C7E /end MEASUREMENT
/begin MEASUREMENT DFES_stChk05 "Prüfungsstatus aller im Fehlerspeicher eingetragenen DFCs" UBYTE DFES_stCheck_Verb 1 100 0.00 247.000000000 FORMAT "%13.9" ECU_ADDRESS 0xD0008C7F /end MEASUREMENT
/begin MEASUREMENT DFES_stChk06 "Prüfungsstatus aller im Fehlerspeicher eingetragenen DFCs" UBYTE DFES_stCheck_Verb 1 100 0.00 247.000000000 FORMAT "%13.9" ECU_ADDRESS 0xD0008C80 /end MEASUREMENT
/begin MEASUREMENT DFES_stChk07 "Prüfungsstatus aller im Fehlerspeicher eingetragenen DFCs" UBYTE DFES_stCheck_Verb 1 100 0.00 247.000000000 FORMAT "%13.9" ECU_ADDRESS 0xD0008C81 /end MEASUREMENT
/begin MEASUREMENT DFES_stChk08 "Prüfungsstatus aller im Fehlerspeicher eingetragenen DFCs" UBYTE DFES_stCheck_Verb 1 100 0.00 247.000000000 FORMAT "%13.9" ECU_ADDRESS 0xD0008C82 /end MEASUREMENT
/begin MEASUREMENT DFES_stChk09 "Prüfungsstatus aller im Fehlerspeicher eingetragenen DFCs" UBYTE DFES_stCheck_Verb 1 100 0.00 247.000000000 FORMAT "%13.9" ECU_ADDRESS 0xD0008C83 /end MEASUREMENT
/begin MEASUREMENT DFES_stChk10 "Prüfungsstatus aller im Fehlerspeicher eingetragenen DFCs" UBYTE DFES_stCheck_Verb 1 100 0.00 247.000000000 FORMAT "%13.9" ECU_ADDRESS 0xD0008C84 /end MEASUREMENT
/begin MEASUREMENT DFES_stChk11 "Prüfungsstatus aller im Fehlerspeicher eingetragenen DFCs" UBYTE DFES_stCheck_Verb 1 100 0.00 247.000000000 FORMAT "%13.9" ECU_ADDRESS 0xD0008C85 /end MEASUREMENT
/begin MEASUREMENT DFES_stChk12 "Prüfungsstatus aller im Fehlerspeicher eingetragenen DFCs" UBYTE DFES_stCheck_Verb 1 100 0.00 247.000000000 FORMAT "%13.9" ECU_ADDRESS 0xD0008C86 /end MEASUREMENT
/begin MEASUREMENT DFES_stChk13 "Prüfungsstatus aller im Fehlerspeicher eingetragenen DFCs" UBYTE DFES_stCheck_Verb 1 100 0.00 247.000000000 FORMAT "%13.9" ECU_ADDRESS 0xD0008C87 /end MEASUREMENT
/begin MEASUREMENT DFES_stChk14 "Prüfungsstatus aller im Fehlerspeicher eingetragenen DFCs" UBYTE DFES_stCheck_Verb 1 100 0.00 247.000000000 FORMAT "%13.9" ECU_ADDRESS 0xD0008C88 /end MEASUREMENT
/begin MEASUREMENT DFES_stChk15 "Prüfungsstatus aller im Fehlerspeicher eingetragenen DFCs" UBYTE DFES_stCheck_Verb 1 100 0.00 247.000000000 FORMAT "%13.9" ECU_ADDRESS 0xD0008C89 /end MEASUREMENT
/begin MEASUREMENT DFES_stChk16 "Prüfungsstatus aller im Fehlerspeicher eingetragenen DFCs" UBYTE DFES_stCheck_Verb 1 100 0.00 247.000000000 FORMAT "%13.9" ECU_ADDRESS 0xD0008C8A /end MEASUREMENT
/begin MEASUREMENT DFES_stChk17 "Prüfungsstatus aller im Fehlerspeicher eingetragenen DFCs" UBYTE DFES_stCheck_Verb 1 100 0.00 247.000000000 FORMAT "%13.9" ECU_ADDRESS 0xD0008C8B /end MEASUREMENT
/begin MEASUREMENT DFES_stChk18 "Prüfungsstatus aller im Fehlerspeicher eingetragenen DFCs" UBYTE DFES_stCheck_Verb 1 100 0.00 247.000000000 FORMAT "%13.9" ECU_ADDRESS 0xD0008C8C /end MEASUREMENT
/begin MEASUREMENT DFES_stChk19 "Prüfungsstatus aller im Fehlerspeicher eingetragenen DFCs" UBYTE DFES_stCheck_Verb 1 100 0.00 247.000000000 FORMAT "%13.9" ECU_ADDRESS 0xD0008C8D /end MEASUREMENT
/begin MEASUREMENT DFES_stChkFault00 "DSM interner Fehlerstatus aller im Fehlerspeicher eingetragenen DFCs" UBYTE DFES_OneToOne 1 100 0.00 255.0 ECU_ADDRESS 0xD0008C8E /end MEASUREMENT
/begin MEASUREMENT DFES_stChkFault01 "DSM interner Fehlerstatus aller im Fehlerspeicher eingetragenen DFCs" UBYTE DFES_OneToOne 1 100 0.00 255.0 ECU_ADDRESS 0xD0008C8F /end MEASUREMENT
/begin MEASUREMENT DFES_stChkFault02 "DSM interner Fehlerstatus aller im Fehlerspeicher eingetragenen DFCs" UBYTE DFES_OneToOne 1 100 0.00 255.0 ECU_ADDRESS 0xD0008C90 /end MEASUREMENT
/begin MEASUREMENT DFES_stChkFault03 "DSM interner Fehlerstatus aller im Fehlerspeicher eingetragenen DFCs" UBYTE DFES_OneToOne 1 100 0.00 255.0 ECU_ADDRESS 0xD0008C91 /end MEASUREMENT
/begin MEASUREMENT DFES_stChkFault04 "DSM interner Fehlerstatus aller im Fehlerspeicher eingetragenen DFCs" UBYTE DFES_OneToOne 1 100 0.00 255.0 ECU_ADDRESS 0xD0008C92 /end MEASUREMENT
/begin MEASUREMENT DFES_stChkFault05 "DSM interner Fehlerstatus aller im Fehlerspeicher eingetragenen DFCs" UBYTE DFES_OneToOne 1 100 0.00 255.0 ECU_ADDRESS 0xD0008C93 /end MEASUREMENT
/begin MEASUREMENT DFES_stChkFault06 "DSM interner Fehlerstatus aller im Fehlerspeicher eingetragenen DFCs" UBYTE DFES_OneToOne 1 100 0.00 255.0 ECU_ADDRESS 0xD0008C94 /end MEASUREMENT
/begin MEASUREMENT DFES_stChkFault07 "DSM interner Fehlerstatus aller im Fehlerspeicher eingetragenen DFCs" UBYTE DFES_OneToOne 1 100 0.00 255.0 ECU_ADDRESS 0xD0008C95 /end MEASUREMENT
/begin MEASUREMENT DFES_stChkFault08 "DSM interner Fehlerstatus aller im Fehlerspeicher eingetragenen DFCs" UBYTE DFES_OneToOne 1 100 0.00 255.0 ECU_ADDRESS 0xD0008C96 /end MEASUREMENT
/begin MEASUREMENT DFES_stChkFault09 "DSM interner Fehlerstatus aller im Fehlerspeicher eingetragenen DFCs" UBYTE DFES_OneToOne 1 100 0.00 255.0 ECU_ADDRESS 0xD0008C97 /end MEASUREMENT
/begin MEASUREMENT DFES_stChkFault10 "DSM interner Fehlerstatus aller im Fehlerspeicher eingetragenen DFCs" UBYTE DFES_OneToOne 1 100 0.00 255.0 ECU_ADDRESS 0xD0008C98 /end MEASUREMENT
/begin MEASUREMENT DFES_stChkFault11 "DSM interner Fehlerstatus aller im Fehlerspeicher eingetragenen DFCs" UBYTE DFES_OneToOne 1 100 0.00 255.0 ECU_ADDRESS 0xD0008C99 /end MEASUREMENT
/begin MEASUREMENT DFES_stChkFault12 "DSM interner Fehlerstatus aller im Fehlerspeicher eingetragenen DFCs" UBYTE DFES_OneToOne 1 100 0.00 255.0 ECU_ADDRESS 0xD0008C9A /end MEASUREMENT
/begin MEASUREMENT DFES_stChkFault13 "DSM interner Fehlerstatus aller im Fehlerspeicher eingetragenen DFCs" UBYTE DFES_OneToOne 1 100 0.00 255.0 ECU_ADDRESS 0xD0008C9B /end MEASUREMENT
/begin MEASUREMENT DFES_stChkFault14 "DSM interner Fehlerstatus aller im Fehlerspeicher eingetragenen DFCs" UBYTE DFES_OneToOne 1 100 0.00 255.0 ECU_ADDRESS 0xD0008C9C /end MEASUREMENT
/begin MEASUREMENT DFES_stChkFault15 "DSM interner Fehlerstatus aller im Fehlerspeicher eingetragenen DFCs" UBYTE DFES_OneToOne 1 100 0.00 255.0 ECU_ADDRESS 0xD0008C9D /end MEASUREMENT
/begin MEASUREMENT DFES_stChkFault16 "DSM interner Fehlerstatus aller im Fehlerspeicher eingetragenen DFCs" UBYTE DFES_OneToOne 1 100 0.00 255.0 ECU_ADDRESS 0xD0008C9E /end MEASUREMENT
/begin MEASUREMENT DFES_stChkFault17 "DSM interner Fehlerstatus aller im Fehlerspeicher eingetragenen DFCs" UBYTE DFES_OneToOne 1 100 0.00 255.0 ECU_ADDRESS 0xD0008C9F /end MEASUREMENT
/begin MEASUREMENT DFES_stChkFault18 "DSM interner Fehlerstatus aller im Fehlerspeicher eingetragenen DFCs" UBYTE DFES_OneToOne 1 100 0.00 255.0 ECU_ADDRESS 0xD0008CA0 /end MEASUREMENT
/begin MEASUREMENT DFES_stChkFault19 "DSM interner Fehlerstatus aller im Fehlerspeicher eingetragenen DFCs" UBYTE DFES_OneToOne 1 100 0.00 255.0 ECU_ADDRESS 0xD0008CA1 /end MEASUREMENT
/begin MEASUREMENT DFES_stCounters00 "Zählerstatus aller im Fehlerspeicher eingetragenen DFCs" UBYTE DFES_stCnt_Verb 1 100 0.00 85.0000000000 FORMAT "%13.10" ECU_ADDRESS 0xD0008CA2 /end MEASUREMENT
/begin MEASUREMENT DFES_stCounters01 "Zählerstatus aller im Fehlerspeicher eingetragenen DFCs" UBYTE DFES_stCnt_Verb 1 100 0.00 85.0000000000 FORMAT "%13.10" ECU_ADDRESS 0xD0008CA3 /end MEASUREMENT
/begin MEASUREMENT DFES_stCounters02 "Zählerstatus aller im Fehlerspeicher eingetragenen DFCs" UBYTE DFES_stCnt_Verb 1 100 0.00 85.0000000000 FORMAT "%13.10" ECU_ADDRESS 0xD0008CA4 /end MEASUREMENT
/begin MEASUREMENT DFES_stCounters03 "Zählerstatus aller im Fehlerspeicher eingetragenen DFCs" UBYTE DFES_stCnt_Verb 1 100 0.00 85.0000000000 FORMAT "%13.10" ECU_ADDRESS 0xD0008CA5 /end MEASUREMENT
/begin MEASUREMENT DFES_stCounters04 "Zählerstatus aller im Fehlerspeicher eingetragenen DFCs" UBYTE DFES_stCnt_Verb 1 100 0.00 85.0000000000 FORMAT "%13.10" ECU_ADDRESS 0xD0008CA6 /end MEASUREMENT
/begin MEASUREMENT DFES_stCounters05 "Zählerstatus aller im Fehlerspeicher eingetragenen DFCs" UBYTE DFES_stCnt_Verb 1 100 0.00 85.0000000000 FORMAT "%13.10" ECU_ADDRESS 0xD0008CA7 /end MEASUREMENT
/begin MEASUREMENT DFES_stCounters06 "Zählerstatus aller im Fehlerspeicher eingetragenen DFCs" UBYTE DFES_stCnt_Verb 1 100 0.00 85.0000000000 FORMAT "%13.10" ECU_ADDRESS 0xD0008CA8 /end MEASUREMENT
/begin MEASUREMENT DFES_stCounters07 "Zählerstatus aller im Fehlerspeicher eingetragenen DFCs" UBYTE DFES_stCnt_Verb 1 100 0.00 85.0000000000 FORMAT "%13.10" ECU_ADDRESS 0xD0008CA9 /end MEASUREMENT
/begin MEASUREMENT DFES_stCounters08 "Zählerstatus aller im Fehlerspeicher eingetragenen DFCs" UBYTE DFES_stCnt_Verb 1 100 0.00 85.0000000000 FORMAT "%13.10" ECU_ADDRESS 0xD0008CAA /end MEASUREMENT
/begin MEASUREMENT DFES_stCounters09 "Zählerstatus aller im Fehlerspeicher eingetragenen DFCs" UBYTE DFES_stCnt_Verb 1 100 0.00 85.0000000000 FORMAT "%13.10" ECU_ADDRESS 0xD0008CAB /end MEASUREMENT
/begin MEASUREMENT DFES_stCounters10 "Zählerstatus aller im Fehlerspeicher eingetragenen DFCs" UBYTE DFES_stCnt_Verb 1 100 0.00 85.0000000000 FORMAT "%13.10" ECU_ADDRESS 0xD0008CAC /end MEASUREMENT
/begin MEASUREMENT DFES_stCounters11 "Zählerstatus aller im Fehlerspeicher eingetragenen DFCs" UBYTE DFES_stCnt_Verb 1 100 0.00 85.0000000000 FORMAT "%13.10" ECU_ADDRESS 0xD0008CAD /end MEASUREMENT
/begin MEASUREMENT DFES_stCounters12 "Zählerstatus aller im Fehlerspeicher eingetragenen DFCs" UBYTE DFES_stCnt_Verb 1 100 0.00 85.0000000000 FORMAT "%13.10" ECU_ADDRESS 0xD0008CAE /end MEASUREMENT
/begin MEASUREMENT DFES_stCounters13 "Zählerstatus aller im Fehlerspeicher eingetragenen DFCs" UBYTE DFES_stCnt_Verb 1 100 0.00 85.0000000000 FORMAT "%13.10" ECU_ADDRESS 0xD0008CAF /end MEASUREMENT
/begin MEASUREMENT DFES_stCounters14 "Zählerstatus aller im Fehlerspeicher eingetragenen DFCs" UBYTE DFES_stCnt_Verb 1 100 0.00 85.0000000000 FORMAT "%13.10" ECU_ADDRESS 0xD0008CB0 /end MEASUREMENT
/begin MEASUREMENT DFES_stCounters15 "Zählerstatus aller im Fehlerspeicher eingetragenen DFCs" UBYTE DFES_stCnt_Verb 1 100 0.00 85.0000000000 FORMAT "%13.10" ECU_ADDRESS 0xD0008CB1 /end MEASUREMENT
/begin MEASUREMENT DFES_stCounters16 "Zählerstatus aller im Fehlerspeicher eingetragenen DFCs" UBYTE DFES_stCnt_Verb 1 100 0.00 85.0000000000 FORMAT "%13.10" ECU_ADDRESS 0xD0008CB2 /end MEASUREMENT
/begin MEASUREMENT DFES_stCounters17 "Zählerstatus aller im Fehlerspeicher eingetragenen DFCs" UBYTE DFES_stCnt_Verb 1 100 0.00 85.0000000000 FORMAT "%13.10" ECU_ADDRESS 0xD0008CB3 /end MEASUREMENT
/begin MEASUREMENT DFES_stCounters18 "Zählerstatus aller im Fehlerspeicher eingetragenen DFCs" UBYTE DFES_stCnt_Verb 1 100 0.00 85.0000000000 FORMAT "%13.10" ECU_ADDRESS 0xD0008CB4 /end MEASUREMENT
/begin MEASUREMENT DFES_stCounters19 "Zählerstatus aller im Fehlerspeicher eingetragenen DFCs" UBYTE DFES_stCnt_Verb 1 100 0.00 85.0000000000 FORMAT "%13.10" ECU_ADDRESS 0xD0008CB5 /end MEASUREMENT
/begin MEASUREMENT DFES_stEntry00 "Eintragsstatus aller im Fehlerspeicher eingetragenen DFCs" UBYTE DFES_stEntry_Verb 1 100 0.00 158.000000000 FORMAT "%13.9" ECU_ADDRESS 0xD0008C66 /end MEASUREMENT
/begin MEASUREMENT DFES_stEntry01 "Eintragsstatus aller im Fehlerspeicher eingetragenen DFCs" UBYTE DFES_stEntry_Verb 1 100 0.00 158.000000000 FORMAT "%13.9" ECU_ADDRESS 0xD0008C67 /end MEASUREMENT
/begin MEASUREMENT DFES_stEntry02 "Eintragsstatus aller im Fehlerspeicher eingetragenen DFCs" UBYTE DFES_stEntry_Verb 1 100 0.00 158.000000000 FORMAT "%13.9" ECU_ADDRESS 0xD0008C68 /end MEASUREMENT
/begin MEASUREMENT DFES_stEntry03 "Eintragsstatus aller im Fehlerspeicher eingetragenen DFCs" UBYTE DFES_stEntry_Verb 1 100 0.00 158.000000000 FORMAT "%13.9" ECU_ADDRESS 0xD0008C69 /end MEASUREMENT
/begin MEASUREMENT DFES_stEntry04 "Eintragsstatus aller im Fehlerspeicher eingetragenen DFCs" UBYTE DFES_stEntry_Verb 1 100 0.00 158.000000000 FORMAT "%13.9" ECU_ADDRESS 0xD0008C6A /end MEASUREMENT
/begin MEASUREMENT DFES_stEntry05 "Eintragsstatus aller im Fehlerspeicher eingetragenen DFCs" UBYTE DFES_stEntry_Verb 1 100 0.00 158.000000000 FORMAT "%13.9" ECU_ADDRESS 0xD0008C6B /end MEASUREMENT
/begin MEASUREMENT DFES_stEntry06 "Eintragsstatus aller im Fehlerspeicher eingetragenen DFCs" UBYTE DFES_stEntry_Verb 1 100 0.00 158.000000000 FORMAT "%13.9" ECU_ADDRESS 0xD0008C6C /end MEASUREMENT
/begin MEASUREMENT DFES_stEntry07 "Eintragsstatus aller im Fehlerspeicher eingetragenen DFCs" UBYTE DFES_stEntry_Verb 1 100 0.00 158.000000000 FORMAT "%13.9" ECU_ADDRESS 0xD0008C6D /end MEASUREMENT
/begin MEASUREMENT DFES_stEntry08 "Eintragsstatus aller im Fehlerspeicher eingetragenen DFCs" UBYTE DFES_stEntry_Verb 1 100 0.00 158.000000000 FORMAT "%13.9" ECU_ADDRESS 0xD0008C6E /end MEASUREMENT
/begin MEASUREMENT DFES_stEntry09 "Eintragsstatus aller im Fehlerspeicher eingetragenen DFCs" UBYTE DFES_stEntry_Verb 1 100 0.00 158.000000000 FORMAT "%13.9" ECU_ADDRESS 0xD0008C6F /end MEASUREMENT
/begin MEASUREMENT DFES_stEntry10 "Eintragsstatus aller im Fehlerspeicher eingetragenen DFCs" UBYTE DFES_stEntry_Verb 1 100 0.00 158.000000000 FORMAT "%13.9" ECU_ADDRESS 0xD0008C70 /end MEASUREMENT
/begin MEASUREMENT DFES_stEntry11 "Eintragsstatus aller im Fehlerspeicher eingetragenen DFCs" UBYTE DFES_stEntry_Verb 1 100 0.00 158.000000000 FORMAT "%13.9" ECU_ADDRESS 0xD0008C71 /end MEASUREMENT
/begin MEASUREMENT DFES_stEntry12 "Eintragsstatus aller im Fehlerspeicher eingetragenen DFCs" UBYTE DFES_stEntry_Verb 1 100 0.00 158.000000000 FORMAT "%13.9" ECU_ADDRESS 0xD0008C72 /end MEASUREMENT
/begin MEASUREMENT DFES_stEntry13 "Eintragsstatus aller im Fehlerspeicher eingetragenen DFCs" UBYTE DFES_stEntry_Verb 1 100 0.00 158.000000000 FORMAT "%13.9" ECU_ADDRESS 0xD0008C73 /end MEASUREMENT
/begin MEASUREMENT DFES_stEntry14 "Eintragsstatus aller im Fehlerspeicher eingetragenen DFCs" UBYTE DFES_stEntry_Verb 1 100 0.00 158.000000000 FORMAT "%13.9" ECU_ADDRESS 0xD0008C74 /end MEASUREMENT
/begin MEASUREMENT DFES_stEntry15 "Eintragsstatus aller im Fehlerspeicher eingetragenen DFCs" UBYTE DFES_stEntry_Verb 1 100 0.00 158.000000000 FORMAT "%13.9" ECU_ADDRESS 0xD0008C75 /end MEASUREMENT
/begin MEASUREMENT DFES_stEntry16 "Eintragsstatus aller im Fehlerspeicher eingetragenen DFCs" UBYTE DFES_stEntry_Verb 1 100 0.00 158.000000000 FORMAT "%13.9" ECU_ADDRESS 0xD0008C76 /end MEASUREMENT
/begin MEASUREMENT DFES_stEntry17 "Eintragsstatus aller im Fehlerspeicher eingetragenen DFCs" UBYTE DFES_stEntry_Verb 1 100 0.00 158.000000000 FORMAT "%13.9" ECU_ADDRESS 0xD0008C77 /end MEASUREMENT
/begin MEASUREMENT DFES_stEntry18 "Eintragsstatus aller im Fehlerspeicher eingetragenen DFCs" UBYTE DFES_stEntry_Verb 1 100 0.00 158.000000000 FORMAT "%13.9" ECU_ADDRESS 0xD0008C78 /end MEASUREMENT
/begin MEASUREMENT DFES_stEntry19 "Eintragsstatus aller im Fehlerspeicher eingetragenen DFCs" UBYTE DFES_stEntry_Verb 1 100 0.00 158.000000000 FORMAT "%13.9" ECU_ADDRESS 0xD0008C79 /end MEASUREMENT
/begin MEASUREMENT DINH_stClctFId_mp00 "gesammelte Zustände aller function identifer, bei Verriegelung ist das Bit gesetzt" UWORD DFC_OneToOne 1 100 0.00 65535.00 ECU_ADDRESS 0xC000BB0C /end MEASUREMENT
/begin MEASUREMENT DINH_stClctFId_mp01 "gesammelte Zustände aller function identifer, bei Verriegelung ist das Bit gesetzt" UWORD DFC_OneToOne 1 100 0.00 65535.00 ECU_ADDRESS 0xC000BB0E /end MEASUREMENT
/begin MEASUREMENT DINH_stClctFId_mp02 "gesammelte Zustände aller function identifer, bei Verriegelung ist das Bit gesetzt" UWORD DFC_OneToOne 1 100 0.00 65535.00 ECU_ADDRESS 0xC000BB10 /end MEASUREMENT
/begin MEASUREMENT DINH_stClctFId_mp03 "gesammelte Zustände aller function identifer, bei Verriegelung ist das Bit gesetzt" UWORD DFC_OneToOne 1 100 0.00 65535.00 ECU_ADDRESS 0xC000BB12 /end MEASUREMENT
/begin MEASUREMENT DINH_stClctFId_mp04 "gesammelte Zustände aller function identifer, bei Verriegelung ist das Bit gesetzt" UWORD DFC_OneToOne 1 100 0.00 65535.00 ECU_ADDRESS 0xC000BB14 /end MEASUREMENT
/begin MEASUREMENT DINH_stClctFId_mp05 "gesammelte Zustände aller function identifer, bei Verriegelung ist das Bit gesetzt" UWORD DFC_OneToOne 1 100 0.00 65535.00 ECU_ADDRESS 0xC000BB16 /end MEASUREMENT
/begin MEASUREMENT DINH_stClctFId_mp06 "gesammelte Zustände aller function identifer, bei Verriegelung ist das Bit gesetzt" UWORD DFC_OneToOne 1 100 0.00 65535.00 ECU_ADDRESS 0xC000BB18 /end MEASUREMENT
/begin MEASUREMENT DINH_stClctFId_mp07 "gesammelte Zustände aller function identifer, bei Verriegelung ist das Bit gesetzt" UWORD DFC_OneToOne 1 100 0.00 65535.00 ECU_ADDRESS 0xC000BB1A /end MEASUREMENT
/begin MEASUREMENT DINH_stClctFId_mp08 "gesammelte Zustände aller function identifer, bei Verriegelung ist das Bit gesetzt" UWORD DFC_OneToOne 1 100 0.00 65535.00 ECU_ADDRESS 0xC000BB1C /end MEASUREMENT
/begin MEASUREMENT DINH_stClctFId_mp09 "gesammelte Zustände aller function identifer, bei Verriegelung ist das Bit gesetzt" UWORD DFC_OneToOne 1 100 0.00 65535.00 ECU_ADDRESS 0xC000BB1E /end MEASUREMENT
/begin MEASUREMENT DINH_stClctFId_mp10 "gesammelte Zustände aller function identifer, bei Verriegelung ist das Bit gesetzt" UWORD DFC_OneToOne 1 100 0.00 65535.00 ECU_ADDRESS 0xC000BB20 /end MEASUREMENT
/begin MEASUREMENT DINH_stClctFId_mp11 "gesammelte Zustände aller function identifer, bei Verriegelung ist das Bit gesetzt" UWORD DFC_OneToOne 1 100 0.00 65535.00 ECU_ADDRESS 0xC000BB22 /end MEASUREMENT
/begin MEASUREMENT DINH_stClctFId_mp12 "gesammelte Zustände aller function identifer, bei Verriegelung ist das Bit gesetzt" UWORD DFC_OneToOne 1 100 0.00 65535.00 ECU_ADDRESS 0xC000BB24 /end MEASUREMENT
/begin MEASUREMENT DINH_stClctFId_mp13 "gesammelte Zustände aller function identifer, bei Verriegelung ist das Bit gesetzt" UWORD DFC_OneToOne 1 100 0.00 65535.00 ECU_ADDRESS 0xC000BB26 /end MEASUREMENT
/begin MEASUREMENT DINH_stClctFId_mp14 "gesammelte Zustände aller function identifer, bei Verriegelung ist das Bit gesetzt" UWORD DFC_OneToOne 1 100 0.00 65535.00 ECU_ADDRESS 0xC000BB28 /end MEASUREMENT
/begin MEASUREMENT DINH_stClctFId_mp15 "gesammelte Zustände aller function identifer, bei Verriegelung ist das Bit gesetzt" UWORD DFC_OneToOne 1 100 0.00 65535.00 ECU_ADDRESS 0xC000BB2A /end MEASUREMENT
/begin MEASUREMENT DINH_stClctFId_mp16 "gesammelte Zustände aller function identifer, bei Verriegelung ist das Bit gesetzt" UWORD DFC_OneToOne 1 100 0.00 65535.00 ECU_ADDRESS 0xC000BB2C /end MEASUREMENT
/begin MEASUREMENT DINH_stClctFId_mp17 "gesammelte Zustände aller function identifer, bei Verriegelung ist das Bit gesetzt" UWORD DFC_OneToOne 1 100 0.00 65535.00 ECU_ADDRESS 0xC000BB2E /end MEASUREMENT
/begin MEASUREMENT DINH_stClctFId_mp18 "gesammelte Zustände aller function identifer, bei Verriegelung ist das Bit gesetzt" UWORD DFC_OneToOne 1 100 0.00 65535.00 ECU_ADDRESS 0xC000BB30 /end MEASUREMENT
/begin MEASUREMENT DINH_stClctFId_mp19 "gesammelte Zustände aller function identifer, bei Verriegelung ist das Bit gesetzt" UWORD DFC_OneToOne 1 100 0.00 65535.00 ECU_ADDRESS 0xC000BB32 /end MEASUREMENT
/begin MEASUREMENT DINH_stClctFId_mp20 "gesammelte Zustände aller function identifer, bei Verriegelung ist das Bit gesetzt" UWORD DFC_OneToOne 1 100 0.00 65535.00 ECU_ADDRESS 0xC000BB34 /end MEASUREMENT
/begin MEASUREMENT DINH_stClctFId_mp21 "gesammelte Zustände aller function identifer, bei Verriegelung ist das Bit gesetzt" UWORD DFC_OneToOne 1 100 0.00 65535.00 ECU_ADDRESS 0xC000BB36 /end MEASUREMENT
/begin MEASUREMENT DINH_stClctFId_mp22 "gesammelte Zustände aller function identifer, bei Verriegelung ist das Bit gesetzt" UWORD DFC_OneToOne 1 100 0.00 65535.00 ECU_ADDRESS 0xC000BB38 /end MEASUREMENT
/begin MEASUREMENT DINH_stClctFId_mp23 "gesammelte Zustände aller function identifer, bei Verriegelung ist das Bit gesetzt" UWORD DFC_OneToOne 1 100 0.00 65535.00 ECU_ADDRESS 0xC000BB3A /end MEASUREMENT
/begin MEASUREMENT DINH_stClctFId_mp24 "gesammelte Zustände aller function identifer, bei Verriegelung ist das Bit gesetzt" UWORD DFC_OneToOne 1 100 0.00 65535.00 ECU_ADDRESS 0xC000BB3C /end MEASUREMENT
/begin MEASUREMENT DINH_stClctFId_mp25 "gesammelte Zustände aller function identifer, bei Verriegelung ist das Bit gesetzt" UWORD DFC_OneToOne 1 100 0.00 65535.00 ECU_ADDRESS 0xC000BB3E /end MEASUREMENT
/begin MEASUREMENT DINH_stClctFId_mp26 "gesammelte Zustände aller function identifer, bei Verriegelung ist das Bit gesetzt" UWORD DFC_OneToOne 1 100 0.00 65535.00 ECU_ADDRESS 0xC000BB40 /end MEASUREMENT
/begin MEASUREMENT DINH_stClctFId_mp27 "gesammelte Zustände aller function identifer, bei Verriegelung ist das Bit gesetzt" UWORD DFC_OneToOne 1 100 0.00 65535.00 ECU_ADDRESS 0xC000BB42 /end MEASUREMENT
/begin MEASUREMENT DINH_stClctFId_mp28 "gesammelte Zustände aller function identifer, bei Verriegelung ist das Bit gesetzt" UWORD DFC_OneToOne 1 100 0.00 65535.00 ECU_ADDRESS 0xC000BB44 /end MEASUREMENT
/begin MEASUREMENT DINH_stClctFId_mp29 "gesammelte Zustände aller function identifer, bei Verriegelung ist das Bit gesetzt" UWORD DFC_OneToOne 1 100 0.00 65535.00 ECU_ADDRESS 0xC000BB46 /end MEASUREMENT
/begin MEASUREMENT DINH_stClctFId_mp30 "gesammelte Zustände aller function identifer, bei Verriegelung ist das Bit gesetzt" UWORD DFC_OneToOne 1 100 0.00 65535.00 ECU_ADDRESS 0xC000BB48 /end MEASUREMENT
/begin MEASUREMENT DINH_stClctFId_mp31 "gesammelte Zustände aller function identifer, bei Verriegelung ist das Bit gesetzt" UWORD DFC_OneToOne 1 100 0.00 65535.00 ECU_ADDRESS 0xC000BB4A /end MEASUREMENT
/begin MEASUREMENT DINH_stClctFId_mp32 "gesammelte Zustände aller function identifer, bei Verriegelung ist das Bit gesetzt" UWORD DFC_OneToOne 1 100 0.00 65535.00 ECU_ADDRESS 0xC000BB4C /end MEASUREMENT
/begin MEASUREMENT DINH_stClctFId_mp33 "gesammelte Zustände aller function identifer, bei Verriegelung ist das Bit gesetzt" UWORD DFC_OneToOne 1 100 0.00 65535.00 ECU_ADDRESS 0xC000BB4E /end MEASUREMENT
/begin MEASUREMENT DINH_stClctFId_mp34 "gesammelte Zustände aller function identifer, bei Verriegelung ist das Bit gesetzt" UWORD DFC_OneToOne 1 100 0.00 65535.00 ECU_ADDRESS 0xC000BB50 /end MEASUREMENT
/begin MEASUREMENT DINH_stClctFId_mp35 "gesammelte Zustände aller function identifer, bei Verriegelung ist das Bit gesetzt" UWORD DFC_OneToOne 1 100 0.00 65535.00 ECU_ADDRESS 0xC000BB52 /end MEASUREMENT
/begin MEASUREMENT DINH_stClctFId_mp36 "gesammelte Zustände aller function identifer, bei Verriegelung ist das Bit gesetzt" UWORD DFC_OneToOne 1 100 0.00 65535.00 ECU_ADDRESS 0xC000BB54 /end MEASUREMENT
/begin MEASUREMENT DINH_stClctFId_mp37 "gesammelte Zustände aller function identifer, bei Verriegelung ist das Bit gesetzt" UWORD DFC_OneToOne 1 100 0.00 65535.00 ECU_ADDRESS 0xC000BB56 /end MEASUREMENT
/begin MEASUREMENT DINH_stClctFId_mp38 "gesammelte Zustände aller function identifer, bei Verriegelung ist das Bit gesetzt" UWORD DFC_OneToOne 1 100 0.00 65535.00 ECU_ADDRESS 0xC000BB58 /end MEASUREMENT
/begin MEASUREMENT DINH_stClctFId_mp39 "gesammelte Zustände aller function identifer, bei Verriegelung ist das Bit gesetzt" UWORD DFC_OneToOne 1 100 0.00 65535.00 ECU_ADDRESS 0xC000BB5A /end MEASUREMENT
/begin MEASUREMENT DINH_stClctFId_mp40 "gesammelte Zustände aller function identifer, bei Verriegelung ist das Bit gesetzt" UWORD DFC_OneToOne 1 100 0.00 65535.00 ECU_ADDRESS 0xC000BB5C /end MEASUREMENT
/begin MEASUREMENT DINH_stClctFId_mp41 "gesammelte Zustände aller function identifer, bei Verriegelung ist das Bit gesetzt" UWORD DFC_OneToOne 1 100 0.00 65535.00 ECU_ADDRESS 0xC000BB5E /end MEASUREMENT
/begin MEASUREMENT DINH_stClctFId_mp42 "gesammelte Zustände aller function identifer, bei Verriegelung ist das Bit gesetzt" UWORD DFC_OneToOne 1 100 0.00 65535.00 ECU_ADDRESS 0xC000BB60 /end MEASUREMENT
/begin MEASUREMENT DINH_stClctFId_mp43 "gesammelte Zustände aller function identifer, bei Verriegelung ist das Bit gesetzt" UWORD DFC_OneToOne 1 100 0.00 65535.00 ECU_ADDRESS 0xC000BB62 /end MEASUREMENT
/begin MEASUREMENT DINH_xFIDObsvInh_mp00 "Liste der Verriegelungsquellen die den über DINH_xFIDObsv_C ausgewählten FID aktuell sperren" UWORD DFCDSQ_Verb 1 100 0.00 1213. FORMAT "%2.0" ECU_ADDRESS 0xC000BB64 /end MEASUREMENT
/begin MEASUREMENT DINH_xFIDObsvRls_mp00 "Liste der möglichen Verriegelungsquellen die den über DINH_xFIDObsv_C ausgewählten FID aktuell nicht sperren" UWORD DFCDSQ_Verb 1 100 0.00 1213. FORMAT "%2.0" ECU_ADDRESS 0xC000BB66 /end MEASUREMENT
/begin MEASUREMENT DIUMPR_ctDenom00 "berechnete Nenner der IUMPR relevanten Diagnosen (Varainte 1)" UWORD OneToOne 1 100 0.00 65535.00 ECU_ADDRESS 0xD00095E6 /end MEASUREMENT
/begin MEASUREMENT DIUMPR_ctDenom01 "berechnete Nenner der IUMPR relevanten Diagnosen (Varainte 1)" UWORD OneToOne 1 100 0.00 65535.00 ECU_ADDRESS 0xD00095E8 /end MEASUREMENT
/begin MEASUREMENT DIUMPR_ctDenom02 "berechnete Nenner der IUMPR relevanten Diagnosen (Varainte 1)" UWORD OneToOne 1 100 0.00 65535.00 ECU_ADDRESS 0xD00095EA /end MEASUREMENT
/begin MEASUREMENT DIUMPR_ctDenom03 "berechnete Nenner der IUMPR relevanten Diagnosen (Varainte 1)" UWORD OneToOne 1 100 0.00 65535.00 ECU_ADDRESS 0xD00095EC /end MEASUREMENT
/begin MEASUREMENT DIUMPR_ctDenom04 "berechnete Nenner der IUMPR relevanten Diagnosen (Varainte 1)" UWORD OneToOne 1 100 0.00 65535.00 ECU_ADDRESS 0xD00095EE /end MEASUREMENT
/begin MEASUREMENT DIUMPR_ctDenom05 "berechnete Nenner der IUMPR relevanten Diagnosen (Varainte 1)" UWORD OneToOne 1 100 0.00 65535.00 ECU_ADDRESS 0xD00095F0 /end MEASUREMENT
/begin MEASUREMENT DIUMPR_ctDenom06 "berechnete Nenner der IUMPR relevanten Diagnosen (Varainte 1)" UWORD OneToOne 1 100 0.00 65535.00 ECU_ADDRESS 0xD00095F2 /end MEASUREMENT
/begin MEASUREMENT DIUMPR_ctDenom07 "berechnete Nenner der IUMPR relevanten Diagnosen (Varainte 1)" UWORD OneToOne 1 100 0.00 65535.00 ECU_ADDRESS 0xD00095F4 /end MEASUREMENT
/begin MEASUREMENT DIUMPR_ctDenom08 "berechnete Nenner der IUMPR relevanten Diagnosen (Varainte 1)" UWORD OneToOne 1 100 0.00 65535.00 ECU_ADDRESS 0xD00095F6 /end MEASUREMENT
/begin MEASUREMENT DIUMPR_ctDenom09 "berechnete Nenner der IUMPR relevanten Diagnosen (Varainte 1)" UWORD OneToOne 1 100 0.00 65535.00 ECU_ADDRESS 0xD00095F8 /end MEASUREMENT
/begin MEASUREMENT DIUMPR_ctDenom10 "berechnete Nenner der IUMPR relevanten Diagnosen (Varainte 1)" UWORD OneToOne 1 100 0.00 65535.00 ECU_ADDRESS 0xD00095FA /end MEASUREMENT
/begin MEASUREMENT DIUMPR_ctDenom11 "berechnete Nenner der IUMPR relevanten Diagnosen (Varainte 1)" UWORD OneToOne 1 100 0.00 65535.00 ECU_ADDRESS 0xD00095FC /end MEASUREMENT
/begin MEASUREMENT DIUMPR_ctDenom12 "berechnete Nenner der IUMPR relevanten Diagnosen (Varainte 1)" UWORD OneToOne 1 100 0.00 65535.00 ECU_ADDRESS 0xD00095FE /end MEASUREMENT
/begin MEASUREMENT DIUMPR_ctDenom13 "berechnete Nenner der IUMPR relevanten Diagnosen (Varainte 1)" UWORD OneToOne 1 100 0.00 65535.00 ECU_ADDRESS 0xD0009600 /end MEASUREMENT
/begin MEASUREMENT DIUMPR_ctDenom14 "berechnete Nenner der IUMPR relevanten Diagnosen (Varainte 1)" UWORD OneToOne 1 100 0.00 65535.00 ECU_ADDRESS 0xD0009602 /end MEASUREMENT
/begin MEASUREMENT DIUMPR_ctDenom15 "berechnete Nenner der IUMPR relevanten Diagnosen (Varainte 1)" UWORD OneToOne 1 100 0.00 65535.00 ECU_ADDRESS 0xD0009604 /end MEASUREMENT
/begin MEASUREMENT DIUMPR_ctDenom16 "berechnete Nenner der IUMPR relevanten Diagnosen (Varainte 1)" UWORD OneToOne 1 100 0.00 65535.00 ECU_ADDRESS 0xD0009606 /end MEASUREMENT
/begin MEASUREMENT DIUMPR_ctDenom17 "berechnete Nenner der IUMPR relevanten Diagnosen (Varainte 1)" UWORD OneToOne 1 100 0.00 65535.00 ECU_ADDRESS 0xD0009608 /end MEASUREMENT
/begin MEASUREMENT DIUMPR_ctDenom18 "berechnete Nenner der IUMPR relevanten Diagnosen (Varainte 1)" UWORD OneToOne 1 100 0.00 65535.00 ECU_ADDRESS 0xD000960A /end MEASUREMENT
/begin MEASUREMENT DIUMPR_ctDenom19 "berechnete Nenner der IUMPR relevanten Diagnosen (Varainte 1)" UWORD OneToOne 1 100 0.00 65535.00 ECU_ADDRESS 0xD000960C /end MEASUREMENT
/begin MEASUREMENT DIUMPR_ctNum00 "berechnete Zähler der IUMPR relevanten Diagnosen (Variante 1)" UWORD OneToOne 1 100 0.00 65535.00 ECU_ADDRESS 0xD00095BE /end MEASUREMENT
/begin MEASUREMENT DIUMPR_ctNum01 "berechnete Zähler der IUMPR relevanten Diagnosen (Variante 1)" UWORD OneToOne 1 100 0.00 65535.00 ECU_ADDRESS 0xD00095C0 /end MEASUREMENT
/begin MEASUREMENT DIUMPR_ctNum02 "berechnete Zähler der IUMPR relevanten Diagnosen (Variante 1)" UWORD OneToOne 1 100 0.00 65535.00 ECU_ADDRESS 0xD00095C2 /end MEASUREMENT
/begin MEASUREMENT DIUMPR_ctNum03 "berechnete Zähler der IUMPR relevanten Diagnosen (Variante 1)" UWORD OneToOne 1 100 0.00 65535.00 ECU_ADDRESS 0xD00095C4 /end MEASUREMENT
/begin MEASUREMENT DIUMPR_ctNum04 "berechnete Zähler der IUMPR relevanten Diagnosen (Variante 1)" UWORD OneToOne 1 100 0.00 65535.00 ECU_ADDRESS 0xD00095C6 /end MEASUREMENT
/begin MEASUREMENT DIUMPR_ctNum05 "berechnete Zähler der IUMPR relevanten Diagnosen (Variante 1)" UWORD OneToOne 1 100 0.00 65535.00 ECU_ADDRESS 0xD00095C8 /end MEASUREMENT
/begin MEASUREMENT DIUMPR_ctNum06 "berechnete Zähler der IUMPR relevanten Diagnosen (Variante 1)" UWORD OneToOne 1 100 0.00 65535.00 ECU_ADDRESS 0xD00095CA /end MEASUREMENT
/begin MEASUREMENT DIUMPR_ctNum07 "berechnete Zähler der IUMPR relevanten Diagnosen (Variante 1)" UWORD OneToOne 1 100 0.00 65535.00 ECU_ADDRESS 0xD00095CC /end MEASUREMENT
/begin MEASUREMENT DIUMPR_ctNum08 "berechnete Zähler der IUMPR relevanten Diagnosen (Variante 1)" UWORD OneToOne 1 100 0.00 65535.00 ECU_ADDRESS 0xD00095CE /end MEASUREMENT
/begin MEASUREMENT DIUMPR_ctNum09 "berechnete Zähler der IUMPR relevanten Diagnosen (Variante 1)" UWORD OneToOne 1 100 0.00 65535.00 ECU_ADDRESS 0xD00095D0 /end MEASUREMENT
/begin MEASUREMENT DIUMPR_ctNum10 "berechnete Zähler der IUMPR relevanten Diagnosen (Variante 1)" UWORD OneToOne 1 100 0.00 65535.00 ECU_ADDRESS 0xD00095D2 /end MEASUREMENT
/begin MEASUREMENT DIUMPR_ctNum11 "berechnete Zähler der IUMPR relevanten Diagnosen (Variante 1)" UWORD OneToOne 1 100 0.00 65535.00 ECU_ADDRESS 0xD00095D4 /end MEASUREMENT
/begin MEASUREMENT DIUMPR_ctNum12 "berechnete Zähler der IUMPR relevanten Diagnosen (Variante 1)" UWORD OneToOne 1 100 0.00 65535.00 ECU_ADDRESS 0xD00095D6 /end MEASUREMENT
/begin MEASUREMENT DIUMPR_ctNum13 "berechnete Zähler der IUMPR relevanten Diagnosen (Variante 1)" UWORD OneToOne 1 100 0.00 65535.00 ECU_ADDRESS 0xD00095D8 /end MEASUREMENT
/begin MEASUREMENT DIUMPR_ctNum14 "berechnete Zähler der IUMPR relevanten Diagnosen (Variante 1)" UWORD OneToOne 1 100 0.00 65535.00 ECU_ADDRESS 0xD00095DA /end MEASUREMENT
/begin MEASUREMENT DIUMPR_ctNum15 "berechnete Zähler der IUMPR relevanten Diagnosen (Variante 1)" UWORD OneToOne 1 100 0.00 65535.00 ECU_ADDRESS 0xD00095DC /end MEASUREMENT
/begin MEASUREMENT DIUMPR_ctNum16 "berechnete Zähler der IUMPR relevanten Diagnosen (Variante 1)" UWORD OneToOne 1 100 0.00 65535.00 ECU_ADDRESS 0xD00095DE /end MEASUREMENT
/begin MEASUREMENT DIUMPR_ctNum17 "berechnete Zähler der IUMPR relevanten Diagnosen (Variante 1)" UWORD OneToOne 1 100 0.00 65535.00 ECU_ADDRESS 0xD00095E0 /end MEASUREMENT
/begin MEASUREMENT DIUMPR_ctNum18 "berechnete Zähler der IUMPR relevanten Diagnosen (Variante 1)" UWORD OneToOne 1 100 0.00 65535.00 ECU_ADDRESS 0xD00095E2 /end MEASUREMENT
/begin MEASUREMENT DIUMPR_ctNum19 "berechnete Zähler der IUMPR relevanten Diagnosen (Variante 1)" UWORD OneToOne 1 100 0.00 65535.00 ECU_ADDRESS 0xD00095E4 /end MEASUREMENT
/begin MEASUREMENT DIUMPR_numIndGrp00 "IUMPR record mit dem kleinsten Ratio innerhalb der Komponentengruppe" UBYTE OneToOne 1 100 0.00 255.0 ECU_ADDRESS 0xC0008993 /end MEASUREMENT
/begin MEASUREMENT DIUMPR_numIndGrp01 "IUMPR record mit dem kleinsten Ratio innerhalb der Komponentengruppe" UBYTE OneToOne 1 100 0.00 255.0 ECU_ADDRESS 0xC0008994 /end MEASUREMENT
/begin MEASUREMENT DIUMPR_numIndGrp02 "IUMPR record mit dem kleinsten Ratio innerhalb der Komponentengruppe" UBYTE OneToOne 1 100 0.00 255.0 ECU_ADDRESS 0xC0008995 /end MEASUREMENT
/begin MEASUREMENT DIUMPR_numIndGrp03 "IUMPR record mit dem kleinsten Ratio innerhalb der Komponentengruppe" UBYTE OneToOne 1 100 0.00 255.0 ECU_ADDRESS 0xC0008996 /end MEASUREMENT
/begin MEASUREMENT DIUMPR_numIndGrp04 "IUMPR record mit dem kleinsten Ratio innerhalb der Komponentengruppe" UBYTE OneToOne 1 100 0.00 255.0 ECU_ADDRESS 0xC0008997 /end MEASUREMENT
/begin MEASUREMENT DIUMPR_numIndGrp05 "IUMPR record mit dem kleinsten Ratio innerhalb der Komponentengruppe" UBYTE OneToOne 1 100 0.00 255.0 ECU_ADDRESS 0xC0008998 /end MEASUREMENT
/begin MEASUREMENT DIUMPR_numIndGrp06 "IUMPR record mit dem kleinsten Ratio innerhalb der Komponentengruppe" UBYTE OneToOne 1 100 0.00 255.0 ECU_ADDRESS 0xC0008999 /end MEASUREMENT
/begin MEASUREMENT DIUMPR_numIndGrp07 "IUMPR record mit dem kleinsten Ratio innerhalb der Komponentengruppe" UBYTE OneToOne 1 100 0.00 255.0 ECU_ADDRESS 0xC000899A /end MEASUREMENT
/begin MEASUREMENT DIUMPR_rMBGrp00 "kleinstes Ratio innerhalb des Messwerteblocks" UWORD Fact 1 100 0.00 7.999878 ECU_ADDRESS 0xD0006674 /end MEASUREMENT
/begin MEASUREMENT DIUMPR_rMBGrp01 "kleinstes Ratio innerhalb des Messwerteblocks" UWORD Fact 1 100 0.00 7.999878 ECU_ADDRESS 0xD0006676 /end MEASUREMENT
/begin MEASUREMENT DIUMPR_rMBGrp02 "kleinstes Ratio innerhalb des Messwerteblocks" UWORD Fact 1 100 0.00 7.999878 ECU_ADDRESS 0xD0006678 /end MEASUREMENT
/begin MEASUREMENT DIUMPR_rMBGrp03 "kleinstes Ratio innerhalb des Messwerteblocks" UWORD Fact 1 100 0.00 7.999878 ECU_ADDRESS 0xD000667A /end MEASUREMENT
/begin MEASUREMENT DIUMPR_rMBGrp04 "kleinstes Ratio innerhalb des Messwerteblocks" UWORD Fact 1 100 0.00 7.999878 ECU_ADDRESS 0xD000667C /end MEASUREMENT
/begin MEASUREMENT DIUMPR_rMBGrp05 "kleinstes Ratio innerhalb des Messwerteblocks" UWORD Fact 1 100 0.00 7.999878 ECU_ADDRESS 0xD000667E /end MEASUREMENT
/begin MEASUREMENT DIUMPR_rMBGrp06 "kleinstes Ratio innerhalb des Messwerteblocks" UWORD Fact 1 100 0.00 7.999878 ECU_ADDRESS 0xD0006680 /end MEASUREMENT
/begin MEASUREMENT DIUMPR_rMBGrp07 "kleinstes Ratio innerhalb des Messwerteblocks" UWORD Fact 1 100 0.00 7.999878 ECU_ADDRESS 0xD0006682 /end MEASUREMENT
/begin MEASUREMENT DIUMPR_rMBGrp08 "kleinstes Ratio innerhalb des Messwerteblocks" UWORD Fact 1 100 0.00 7.999878 ECU_ADDRESS 0xD0006684 /end MEASUREMENT
/begin MEASUREMENT DIUMPR_rMBGrp09 "kleinstes Ratio innerhalb des Messwerteblocks" UWORD Fact 1 100 0.00 7.999878 ECU_ADDRESS 0xD0006686 /end MEASUREMENT
/begin MEASUREMENT DIUMPR_rValRatMin00 "kleinstes Ratio innerhalb der Komponentegruppe" UWORD Fact 1 100 0.00 7.999878 ECU_ADDRESS 0xD0006664 /end MEASUREMENT
/begin MEASUREMENT DIUMPR_rValRatMin01 "kleinstes Ratio innerhalb der Komponentegruppe" UWORD Fact 1 100 0.00 7.999878 ECU_ADDRESS 0xD0006666 /end MEASUREMENT
/begin MEASUREMENT DIUMPR_rValRatMin02 "kleinstes Ratio innerhalb der Komponentegruppe" UWORD Fact 1 100 0.00 7.999878 ECU_ADDRESS 0xD0006668 /end MEASUREMENT
/begin MEASUREMENT DIUMPR_rValRatMin03 "kleinstes Ratio innerhalb der Komponentegruppe" UWORD Fact 1 100 0.00 7.999878 ECU_ADDRESS 0xD000666A /end MEASUREMENT
/begin MEASUREMENT DIUMPR_rValRatMin04 "kleinstes Ratio innerhalb der Komponentegruppe" UWORD Fact 1 100 0.00 7.999878 ECU_ADDRESS 0xD000666C /end MEASUREMENT
/begin MEASUREMENT DIUMPR_rValRatMin05 "kleinstes Ratio innerhalb der Komponentegruppe" UWORD Fact 1 100 0.00 7.999878 ECU_ADDRESS 0xD000666E /end MEASUREMENT
/begin MEASUREMENT DIUMPR_rValRatMin06 "kleinstes Ratio innerhalb der Komponentegruppe" UWORD Fact 1 100 0.00 7.999878 ECU_ADDRESS 0xD0006670 /end MEASUREMENT
/begin MEASUREMENT DIUMPR_rValRatMin07 "kleinstes Ratio innerhalb der Komponentegruppe" UWORD Fact 1 100 0.00 7.999878 ECU_ADDRESS 0xD0006672 /end MEASUREMENT
/begin MEASUREMENT DIUMPR_state00 "Statusbytes der IUMPR relevanten Diagnosen (Variante 1)" UBYTE OneToOne 1 100 0.00 255.0 ECU_ADDRESS 0xC000897A /end MEASUREMENT
/begin MEASUREMENT DIUMPR_state01 "Statusbytes der IUMPR relevanten Diagnosen (Variante 1)" UBYTE OneToOne 1 100 0.00 255.0 ECU_ADDRESS 0xC000897B /end MEASUREMENT
/begin MEASUREMENT DIUMPR_state02 "Statusbytes der IUMPR relevanten Diagnosen (Variante 1)" UBYTE OneToOne 1 100 0.00 255.0 ECU_ADDRESS 0xC000897C /end MEASUREMENT
/begin MEASUREMENT DIUMPR_state03 "Statusbytes der IUMPR relevanten Diagnosen (Variante 1)" UBYTE OneToOne 1 100 0.00 255.0 ECU_ADDRESS 0xC000897D /end MEASUREMENT
/begin MEASUREMENT DIUMPR_state04 "Statusbytes der IUMPR relevanten Diagnosen (Variante 1)" UBYTE OneToOne 1 100 0.00 255.0 ECU_ADDRESS 0xC000897E /end MEASUREMENT
/begin MEASUREMENT DIUMPR_state05 "Statusbytes der IUMPR relevanten Diagnosen (Variante 1)" UBYTE OneToOne 1 100 0.00 255.0 ECU_ADDRESS 0xC000897F /end MEASUREMENT
/begin MEASUREMENT DIUMPR_state06 "Statusbytes der IUMPR relevanten Diagnosen (Variante 1)" UBYTE OneToOne 1 100 0.00 255.0 ECU_ADDRESS 0xC0008980 /end MEASUREMENT
/begin MEASUREMENT DIUMPR_state07 "Statusbytes der IUMPR relevanten Diagnosen (Variante 1)" UBYTE OneToOne 1 100 0.00 255.0 ECU_ADDRESS 0xC0008981 /end MEASUREMENT
/begin MEASUREMENT DIUMPR_state08 "Statusbytes der IUMPR relevanten Diagnosen (Variante 1)" UBYTE OneToOne 1 100 0.00 255.0 ECU_ADDRESS 0xC0008982 /end MEASUREMENT
/begin MEASUREMENT DIUMPR_state09 "Statusbytes der IUMPR relevanten Diagnosen (Variante 1)" UBYTE OneToOne 1 100 0.00 255.0 ECU_ADDRESS 0xC0008983 /end MEASUREMENT
/begin MEASUREMENT DIUMPR_state10 "Statusbytes der IUMPR relevanten Diagnosen (Variante 1)" UBYTE OneToOne 1 100 0.00 255.0 ECU_ADDRESS 0xC0008984 /end MEASUREMENT
/begin MEASUREMENT DIUMPR_state11 "Statusbytes der IUMPR relevanten Diagnosen (Variante 1)" UBYTE OneToOne 1 100 0.00 255.0 ECU_ADDRESS 0xC0008985 /end MEASUREMENT
/begin MEASUREMENT DIUMPR_state12 "Statusbytes der IUMPR relevanten Diagnosen (Variante 1)" UBYTE OneToOne 1 100 0.00 255.0 ECU_ADDRESS 0xC0008986 /end MEASUREMENT
/begin MEASUREMENT DIUMPR_state13 "Statusbytes der IUMPR relevanten Diagnosen (Variante 1)" UBYTE OneToOne 1 100 0.00 255.0 ECU_ADDRESS 0xC0008987 /end MEASUREMENT
/begin MEASUREMENT DIUMPR_state14 "Statusbytes der IUMPR relevanten Diagnosen (Variante 1)" UBYTE OneToOne 1 100 0.00 255.0 ECU_ADDRESS 0xC0008988 /end MEASUREMENT
/begin MEASUREMENT DIUMPR_state15 "Statusbytes der IUMPR relevanten Diagnosen (Variante 1)" UBYTE OneToOne 1 100 0.00 255.0 ECU_ADDRESS 0xC0008989 /end MEASUREMENT
/begin MEASUREMENT DIUMPR_state16 "Statusbytes der IUMPR relevanten Diagnosen (Variante 1)" UBYTE OneToOne 1 100 0.00 255.0 ECU_ADDRESS 0xC000898A /end MEASUREMENT
/begin MEASUREMENT DIUMPR_state17 "Statusbytes der IUMPR relevanten Diagnosen (Variante 1)" UBYTE OneToOne 1 100 0.00 255.0 ECU_ADDRESS 0xC000898B /end MEASUREMENT
/begin MEASUREMENT DIUMPR_state18 "Statusbytes der IUMPR relevanten Diagnosen (Variante 1)" UBYTE OneToOne 1 100 0.00 255.0 ECU_ADDRESS 0xC000898C /end MEASUREMENT
/begin MEASUREMENT DIUMPR_state19 "Statusbytes der IUMPR relevanten Diagnosen (Variante 1)" UBYTE OneToOne 1 100 0.00 255.0 ECU_ADDRESS 0xC000898D /end MEASUREMENT
/begin MEASUREMENT DIUMPR_tiSigActv00 "ununterbrochene Betriebszeit der beobachteten Überwachung" UBYTE DIUMPR_ti100ms 1 100 0.00 25.50 FORMAT "%5.2" ECU_ADDRESS 0xC000898E /end MEASUREMENT
/begin MEASUREMENT DIUMPR_tiSigActv01 "ununterbrochene Betriebszeit der beobachteten Überwachung" UBYTE DIUMPR_ti100ms 1 100 0.00 25.50 FORMAT "%5.2" ECU_ADDRESS 0xC000898F /end MEASUREMENT
/begin MEASUREMENT DIUMPR_tiSigActv02 "ununterbrochene Betriebszeit der beobachteten Überwachung" UBYTE DIUMPR_ti100ms 1 100 0.00 25.50 FORMAT "%5.2" ECU_ADDRESS 0xC0008990 /end MEASUREMENT
/begin MEASUREMENT DIUMPR_tiSigActv03 "ununterbrochene Betriebszeit der beobachteten Überwachung" UBYTE DIUMPR_ti100ms 1 100 0.00 25.50 FORMAT "%5.2" ECU_ADDRESS 0xC0008991 /end MEASUREMENT
/begin MEASUREMENT DIUMPR_tiSigActv04 "ununterbrochene Betriebszeit der beobachteten Überwachung" UBYTE DIUMPR_ti100ms 1 100 0.00 25.50 FORMAT "%5.2" ECU_ADDRESS 0xC0008992 /end MEASUREMENT
/begin MEASUREMENT DSMDur_ctDFES000 "erster eintragsspezifischer duration counter" UWORD DFES_OneToOne 1 100 0.00 65535.00 ECU_ADDRESS 0xD00094E6 /end MEASUREMENT
/begin MEASUREMENT DSMDur_ctDFES001 "erster eintragsspezifischer duration counter" UWORD DFES_OneToOne 1 100 0.00 65535.00 ECU_ADDRESS 0xD00094E8 /end MEASUREMENT
/begin MEASUREMENT DSMDur_ctDFES002 "erster eintragsspezifischer duration counter" UWORD DFES_OneToOne 1 100 0.00 65535.00 ECU_ADDRESS 0xD00094EA /end MEASUREMENT
/begin MEASUREMENT DSMDur_ctDFES003 "erster eintragsspezifischer duration counter" UWORD DFES_OneToOne 1 100 0.00 65535.00 ECU_ADDRESS 0xD00094EC /end MEASUREMENT
/begin MEASUREMENT DSMDur_ctDFES004 "erster eintragsspezifischer duration counter" UWORD DFES_OneToOne 1 100 0.00 65535.00 ECU_ADDRESS 0xD00094EE /end MEASUREMENT
/begin MEASUREMENT DSMDur_ctDFES005 "erster eintragsspezifischer duration counter" UWORD DFES_OneToOne 1 100 0.00 65535.00 ECU_ADDRESS 0xD00094F0 /end MEASUREMENT
/begin MEASUREMENT DSMDur_ctDFES006 "erster eintragsspezifischer duration counter" UWORD DFES_OneToOne 1 100 0.00 65535.00 ECU_ADDRESS 0xD00094F2 /end MEASUREMENT
/begin MEASUREMENT DSMDur_ctDFES007 "erster eintragsspezifischer duration counter" UWORD DFES_OneToOne 1 100 0.00 65535.00 ECU_ADDRESS 0xD00094F4 /end MEASUREMENT
/begin MEASUREMENT DSMDur_ctDFES008 "erster eintragsspezifischer duration counter" UWORD DFES_OneToOne 1 100 0.00 65535.00 ECU_ADDRESS 0xD00094F6 /end MEASUREMENT
/begin MEASUREMENT DSMDur_ctDFES009 "erster eintragsspezifischer duration counter" UWORD DFES_OneToOne 1 100 0.00 65535.00 ECU_ADDRESS 0xD00094F8 /end MEASUREMENT
/begin MEASUREMENT DSMDur_ctDFES010 "erster eintragsspezifischer duration counter" UWORD DFES_OneToOne 1 100 0.00 65535.00 ECU_ADDRESS 0xD00094FA /end MEASUREMENT
/begin MEASUREMENT DSMDur_ctDFES011 "erster eintragsspezifischer duration counter" UWORD DFES_OneToOne 1 100 0.00 65535.00 ECU_ADDRESS 0xD00094FC /end MEASUREMENT
/begin MEASUREMENT DSMDur_ctDFES012 "erster eintragsspezifischer duration counter" UWORD DFES_OneToOne 1 100 0.00 65535.00 ECU_ADDRESS 0xD00094FE /end MEASUREMENT
/begin MEASUREMENT DSMDur_ctDFES013 "erster eintragsspezifischer duration counter" UWORD DFES_OneToOne 1 100 0.00 65535.00 ECU_ADDRESS 0xD0009500 /end MEASUREMENT
/begin MEASUREMENT DSMDur_ctDFES014 "erster eintragsspezifischer duration counter" UWORD DFES_OneToOne 1 100 0.00 65535.00 ECU_ADDRESS 0xD0009502 /end MEASUREMENT
/begin MEASUREMENT DSMDur_ctDFES015 "erster eintragsspezifischer duration counter" UWORD DFES_OneToOne 1 100 0.00 65535.00 ECU_ADDRESS 0xD0009504 /end MEASUREMENT
/begin MEASUREMENT DSMDur_ctDFES016 "erster eintragsspezifischer duration counter" UWORD DFES_OneToOne 1 100 0.00 65535.00 ECU_ADDRESS 0xD0009506 /end MEASUREMENT
/begin MEASUREMENT DSMDur_ctDFES017 "erster eintragsspezifischer duration counter" UWORD DFES_OneToOne 1 100 0.00 65535.00 ECU_ADDRESS 0xD0009508 /end MEASUREMENT
/begin MEASUREMENT DSMDur_ctDFES018 "erster eintragsspezifischer duration counter" UWORD DFES_OneToOne 1 100 0.00 65535.00 ECU_ADDRESS 0xD000950A /end MEASUREMENT
/begin MEASUREMENT DSMDur_ctDFES019 "erster eintragsspezifischer duration counter" UWORD DFES_OneToOne 1 100 0.00 65535.00 ECU_ADDRESS 0xD000950C /end MEASUREMENT
/begin MEASUREMENT DSMDur_ctDFES100 "zweiter eintragsspezifischer duration counter" UWORD DFES_OneToOne 1 100 0.00 65535.00 ECU_ADDRESS 0xD000950E /end MEASUREMENT
/begin MEASUREMENT DSMDur_ctDFES101 "zweiter eintragsspezifischer duration counter" UWORD DFES_OneToOne 1 100 0.00 65535.00 ECU_ADDRESS 0xD0009510 /end MEASUREMENT
/begin MEASUREMENT DSMDur_ctDFES102 "zweiter eintragsspezifischer duration counter" UWORD DFES_OneToOne 1 100 0.00 65535.00 ECU_ADDRESS 0xD0009512 /end MEASUREMENT
/begin MEASUREMENT DSMDur_ctDFES103 "zweiter eintragsspezifischer duration counter" UWORD DFES_OneToOne 1 100 0.00 65535.00 ECU_ADDRESS 0xD0009514 /end MEASUREMENT
/begin MEASUREMENT DSMDur_ctDFES104 "zweiter eintragsspezifischer duration counter" UWORD DFES_OneToOne 1 100 0.00 65535.00 ECU_ADDRESS 0xD0009516 /end MEASUREMENT
/begin MEASUREMENT DSMDur_ctDFES105 "zweiter eintragsspezifischer duration counter" UWORD DFES_OneToOne 1 100 0.00 65535.00 ECU_ADDRESS 0xD0009518 /end MEASUREMENT
/begin MEASUREMENT DSMDur_ctDFES106 "zweiter eintragsspezifischer duration counter" UWORD DFES_OneToOne 1 100 0.00 65535.00 ECU_ADDRESS 0xD000951A /end MEASUREMENT
/begin MEASUREMENT DSMDur_ctDFES107 "zweiter eintragsspezifischer duration counter" UWORD DFES_OneToOne 1 100 0.00 65535.00 ECU_ADDRESS 0xD000951C /end MEASUREMENT
/begin MEASUREMENT DSMDur_ctDFES108 "zweiter eintragsspezifischer duration counter" UWORD DFES_OneToOne 1 100 0.00 65535.00 ECU_ADDRESS 0xD000951E /end MEASUREMENT
/begin MEASUREMENT DSMDur_ctDFES109 "zweiter eintragsspezifischer duration counter" UWORD DFES_OneToOne 1 100 0.00 65535.00 ECU_ADDRESS 0xD0009520 /end MEASUREMENT
/begin MEASUREMENT DSMDur_ctDFES110 "zweiter eintragsspezifischer duration counter" UWORD DFES_OneToOne 1 100 0.00 65535.00 ECU_ADDRESS 0xD0009522 /end MEASUREMENT
/begin MEASUREMENT DSMDur_ctDFES111 "zweiter eintragsspezifischer duration counter" UWORD DFES_OneToOne 1 100 0.00 65535.00 ECU_ADDRESS 0xD0009524 /end MEASUREMENT
/begin MEASUREMENT DSMDur_ctDFES112 "zweiter eintragsspezifischer duration counter" UWORD DFES_OneToOne 1 100 0.00 65535.00 ECU_ADDRESS 0xD0009526 /end MEASUREMENT
/begin MEASUREMENT DSMDur_ctDFES113 "zweiter eintragsspezifischer duration counter" UWORD DFES_OneToOne 1 100 0.00 65535.00 ECU_ADDRESS 0xD0009528 /end MEASUREMENT
/begin MEASUREMENT DSMDur_ctDFES114 "zweiter eintragsspezifischer duration counter" UWORD DFES_OneToOne 1 100 0.00 65535.00 ECU_ADDRESS 0xD000952A /end MEASUREMENT
/begin MEASUREMENT DSMDur_ctDFES115 "zweiter eintragsspezifischer duration counter" UWORD DFES_OneToOne 1 100 0.00 65535.00 ECU_ADDRESS 0xD000952C /end MEASUREMENT
/begin MEASUREMENT DSMDur_ctDFES116 "zweiter eintragsspezifischer duration counter" UWORD DFES_OneToOne 1 100 0.00 65535.00 ECU_ADDRESS 0xD000952E /end MEASUREMENT
/begin MEASUREMENT DSMDur_ctDFES117 "zweiter eintragsspezifischer duration counter" UWORD DFES_OneToOne 1 100 0.00 65535.00 ECU_ADDRESS 0xD0009530 /end MEASUREMENT
/begin MEASUREMENT DSMDur_ctDFES118 "zweiter eintragsspezifischer duration counter" UWORD DFES_OneToOne 1 100 0.00 65535.00 ECU_ADDRESS 0xD0009532 /end MEASUREMENT
/begin MEASUREMENT DSMDur_ctDFES119 "zweiter eintragsspezifischer duration counter" UWORD DFES_OneToOne 1 100 0.00 65535.00 ECU_ADDRESS 0xD0009534 /end MEASUREMENT
/begin MEASUREMENT DSMDur_ctDFES200 "dritter eintragsspezifischer duration counter" UWORD DFES_OneToOne 1 100 0.00 65535.00 ECU_ADDRESS 0xD0009536 /end MEASUREMENT
/begin MEASUREMENT DSMDur_ctDFES201 "dritter eintragsspezifischer duration counter" UWORD DFES_OneToOne 1 100 0.00 65535.00 ECU_ADDRESS 0xD0009538 /end MEASUREMENT
/begin MEASUREMENT DSMDur_ctDFES202 "dritter eintragsspezifischer duration counter" UWORD DFES_OneToOne 1 100 0.00 65535.00 ECU_ADDRESS 0xD000953A /end MEASUREMENT
/begin MEASUREMENT DSMDur_ctDFES203 "dritter eintragsspezifischer duration counter" UWORD DFES_OneToOne 1 100 0.00 65535.00 ECU_ADDRESS 0xD000953C /end MEASUREMENT
/begin MEASUREMENT DSMDur_ctDFES204 "dritter eintragsspezifischer duration counter" UWORD DFES_OneToOne 1 100 0.00 65535.00 ECU_ADDRESS 0xD000953E /end MEASUREMENT
/begin MEASUREMENT DSMDur_ctDFES205 "dritter eintragsspezifischer duration counter" UWORD DFES_OneToOne 1 100 0.00 65535.00 ECU_ADDRESS 0xD0009540 /end MEASUREMENT
/begin MEASUREMENT DSMDur_ctDFES206 "dritter eintragsspezifischer duration counter" UWORD DFES_OneToOne 1 100 0.00 65535.00 ECU_ADDRESS 0xD0009542 /end MEASUREMENT
/begin MEASUREMENT DSMDur_ctDFES207 "dritter eintragsspezifischer duration counter" UWORD DFES_OneToOne 1 100 0.00 65535.00 ECU_ADDRESS 0xD0009544 /end MEASUREMENT
/begin MEASUREMENT DSMDur_ctDFES208 "dritter eintragsspezifischer duration counter" UWORD DFES_OneToOne 1 100 0.00 65535.00 ECU_ADDRESS 0xD0009546 /end MEASUREMENT
/begin MEASUREMENT DSMDur_ctDFES209 "dritter eintragsspezifischer duration counter" UWORD DFES_OneToOne 1 100 0.00 65535.00 ECU_ADDRESS 0xD0009548 /end MEASUREMENT
/begin MEASUREMENT DSMDur_ctDFES210 "dritter eintragsspezifischer duration counter" UWORD DFES_OneToOne 1 100 0.00 65535.00 ECU_ADDRESS 0xD000954A /end MEASUREMENT
/begin MEASUREMENT DSMDur_ctDFES211 "dritter eintragsspezifischer duration counter" UWORD DFES_OneToOne 1 100 0.00 65535.00 ECU_ADDRESS 0xD000954C /end MEASUREMENT
/begin MEASUREMENT DSMDur_ctDFES212 "dritter eintragsspezifischer duration counter" UWORD DFES_OneToOne 1 100 0.00 65535.00 ECU_ADDRESS 0xD000954E /end MEASUREMENT
/begin MEASUREMENT DSMDur_ctDFES213 "dritter eintragsspezifischer duration counter" UWORD DFES_OneToOne 1 100 0.00 65535.00 ECU_ADDRESS 0xD0009550 /end MEASUREMENT
/begin MEASUREMENT DSMDur_ctDFES214 "dritter eintragsspezifischer duration counter" UWORD DFES_OneToOne 1 100 0.00 65535.00 ECU_ADDRESS 0xD0009552 /end MEASUREMENT
/begin MEASUREMENT DSMDur_ctDFES215 "dritter eintragsspezifischer duration counter" UWORD DFES_OneToOne 1 100 0.00 65535.00 ECU_ADDRESS 0xD0009554 /end MEASUREMENT
/begin MEASUREMENT DSMDur_ctDFES216 "dritter eintragsspezifischer duration counter" UWORD DFES_OneToOne 1 100 0.00 65535.00 ECU_ADDRESS 0xD0009556 /end MEASUREMENT
/begin MEASUREMENT DSMDur_ctDFES217 "dritter eintragsspezifischer duration counter" UWORD DFES_OneToOne 1 100 0.00 65535.00 ECU_ADDRESS 0xD0009558 /end MEASUREMENT
/begin MEASUREMENT DSMDur_ctDFES218 "dritter eintragsspezifischer duration counter" UWORD DFES_OneToOne 1 100 0.00 65535.00 ECU_ADDRESS 0xD000955A /end MEASUREMENT
/begin MEASUREMENT DSMDur_ctDFES219 "dritter eintragsspezifischer duration counter" UWORD DFES_OneToOne 1 100 0.00 65535.00 ECU_ADDRESS 0xD000955C /end MEASUREMENT
/begin MEASUREMENT DSMDur_ctGlb00 "globale duration counter" ULONG DFES_OneToOne 1 100 0.00 4294967295.00 ECU_ADDRESS 0xD00094E0 /end MEASUREMENT
/begin MEASUREMENT DSMDur_stGlb00 "Status der globalen duration counter" UBYTE DSMDur_StDispl_Verb 1 100 0.00 2.00000000000 FORMAT "%13.11" ECU_ADDRESS 0xD00094E4 /end MEASUREMENT
/begin MEASUREMENT DSQ_stClct_mp00 "gesammelte Zustände aller Signalqualitäten, bei Signalqualität DSM_QUAL_ALL_OK (0) ist das Bit gelöscht" UWORD DFC_OneToOne 1 100 0.00 65535.00 ECU_ADDRESS 0xC000BA74 /end MEASUREMENT
/begin MEASUREMENT DSQ_stClct_mp01 "gesammelte Zustände aller Signalqualitäten, bei Signalqualität DSM_QUAL_ALL_OK (0) ist das Bit gelöscht" UWORD DFC_OneToOne 1 100 0.00 65535.00 ECU_ADDRESS 0xC000BA76 /end MEASUREMENT
/begin MEASUREMENT DSQ_stClct_mp02 "gesammelte Zustände aller Signalqualitäten, bei Signalqualität DSM_QUAL_ALL_OK (0) ist das Bit gelöscht" UWORD DFC_OneToOne 1 100 0.00 65535.00 ECU_ADDRESS 0xC000BA78 /end MEASUREMENT
/begin MEASUREMENT DSQ_stClct_mp03 "gesammelte Zustände aller Signalqualitäten, bei Signalqualität DSM_QUAL_ALL_OK (0) ist das Bit gelöscht" UWORD DFC_OneToOne 1 100 0.00 65535.00 ECU_ADDRESS 0xC000BA7A /end MEASUREMENT
/begin MEASUREMENT DSQ_stClct_mp04 "gesammelte Zustände aller Signalqualitäten, bei Signalqualität DSM_QUAL_ALL_OK (0) ist das Bit gelöscht" UWORD DFC_OneToOne 1 100 0.00 65535.00 ECU_ADDRESS 0xC000BA7C /end MEASUREMENT
/begin MEASUREMENT DSQ_stClct_mp05 "gesammelte Zustände aller Signalqualitäten, bei Signalqualität DSM_QUAL_ALL_OK (0) ist das Bit gelöscht" UWORD DFC_OneToOne 1 100 0.00 65535.00 ECU_ADDRESS 0xC000BA7E /end MEASUREMENT
/begin MEASUREMENT DSQ_stClct_mp06 "gesammelte Zustände aller Signalqualitäten, bei Signalqualität DSM_QUAL_ALL_OK (0) ist das Bit gelöscht" UWORD DFC_OneToOne 1 100 0.00 65535.00 ECU_ADDRESS 0xC000BA80 /end MEASUREMENT
/begin MEASUREMENT DSQ_stClct_mp07 "gesammelte Zustände aller Signalqualitäten, bei Signalqualität DSM_QUAL_ALL_OK (0) ist das Bit gelöscht" UWORD DFC_OneToOne 1 100 0.00 65535.00 ECU_ADDRESS 0xC000BA82 /end MEASUREMENT
/begin MEASUREMENT DSQ_stClct_mp08 "gesammelte Zustände aller Signalqualitäten, bei Signalqualität DSM_QUAL_ALL_OK (0) ist das Bit gelöscht" UWORD DFC_OneToOne 1 100 0.00 65535.00 ECU_ADDRESS 0xC000BA84 /end MEASUREMENT
/begin MEASUREMENT DSQ_stClct_mp09 "gesammelte Zustände aller Signalqualitäten, bei Signalqualität DSM_QUAL_ALL_OK (0) ist das Bit gelöscht" UWORD DFC_OneToOne 1 100 0.00 65535.00 ECU_ADDRESS 0xC000BA86 /end MEASUREMENT
/begin MEASUREMENT DSQ_stClct_mp10 "gesammelte Zustände aller Signalqualitäten, bei Signalqualität DSM_QUAL_ALL_OK (0) ist das Bit gelöscht" UWORD DFC_OneToOne 1 100 0.00 65535.00 ECU_ADDRESS 0xC000BA88 /end MEASUREMENT
/begin MEASUREMENT DSQ_stClct_mp11 "gesammelte Zustände aller Signalqualitäten, bei Signalqualität DSM_QUAL_ALL_OK (0) ist das Bit gelöscht" UWORD DFC_OneToOne 1 100 0.00 65535.00 ECU_ADDRESS 0xC000BA8A /end MEASUREMENT
/begin MEASUREMENT DSQ_stClct_mp12 "gesammelte Zustände aller Signalqualitäten, bei Signalqualität DSM_QUAL_ALL_OK (0) ist das Bit gelöscht" UWORD DFC_OneToOne 1 100 0.00 65535.00 ECU_ADDRESS 0xC000BA8C /end MEASUREMENT
/begin MEASUREMENT DSQ_stClct_mp13 "gesammelte Zustände aller Signalqualitäten, bei Signalqualität DSM_QUAL_ALL_OK (0) ist das Bit gelöscht" UWORD DFC_OneToOne 1 100 0.00 65535.00 ECU_ADDRESS 0xC000BA8E /end MEASUREMENT
/begin MEASUREMENT DSQ_stClct_mp14 "gesammelte Zustände aller Signalqualitäten, bei Signalqualität DSM_QUAL_ALL_OK (0) ist das Bit gelöscht" UWORD DFC_OneToOne 1 100 0.00 65535.00 ECU_ADDRESS 0xC000BA90 /end MEASUREMENT
/begin MEASUREMENT DSQ_stClct_mp15 "gesammelte Zustände aller Signalqualitäten, bei Signalqualität DSM_QUAL_ALL_OK (0) ist das Bit gelöscht" UWORD DFC_OneToOne 1 100 0.00 65535.00 ECU_ADDRESS 0xC000BA92 /end MEASUREMENT
/begin MEASUREMENT Elin_buffer00 "Puffer für ganze Elin Botschaft" UBYTE ident 1 100 0.00 255. FORMAT "%3.0" ECU_ADDRESS 0xC000BEFC /end MEASUREMENT
/begin MEASUREMENT Elin_buffer01 "Puffer für ganze Elin Botschaft" UBYTE ident 1 100 0.00 255. FORMAT "%3.0" ECU_ADDRESS 0xC000BEFD /end MEASUREMENT
/begin MEASUREMENT Elin_buffer02 "Puffer für ganze Elin Botschaft" UBYTE ident 1 100 0.00 255. FORMAT "%3.0" ECU_ADDRESS 0xC000BEFE /end MEASUREMENT
/begin MEASUREMENT Elin_buffer03 "Puffer für ganze Elin Botschaft" UBYTE ident 1 100 0.00 255. FORMAT "%3.0" ECU_ADDRESS 0xC000BEFF /end MEASUREMENT
/begin MEASUREMENT Elin_buffer04 "Puffer für ganze Elin Botschaft" UBYTE ident 1 100 0.00 255. FORMAT "%3.0" ECU_ADDRESS 0xC000BF00 /end MEASUREMENT
/begin MEASUREMENT Elin_buffer05 "Puffer für ganze Elin Botschaft" UBYTE ident 1 100 0.00 255. FORMAT "%3.0" ECU_ADDRESS 0xC000BF01 /end MEASUREMENT
/begin MEASUREMENT Elin_buffer06 "Puffer für ganze Elin Botschaft" UBYTE ident 1 100 0.00 255. FORMAT "%3.0" ECU_ADDRESS 0xC000BF02 /end MEASUREMENT
/begin MEASUREMENT Elin_buffer07 "Puffer für ganze Elin Botschaft" UBYTE ident 1 100 0.00 255. FORMAT "%3.0" ECU_ADDRESS 0xC000BF03 /end MEASUREMENT
/begin MEASUREMENT Elin_buffer08 "Puffer für ganze Elin Botschaft" UBYTE ident 1 100 0.00 255. FORMAT "%3.0" ECU_ADDRESS 0xC000BF04 /end MEASUREMENT
/begin MEASUREMENT Elin_buffer09 "Puffer für ganze Elin Botschaft" UBYTE ident 1 100 0.00 255. FORMAT "%3.0" ECU_ADDRESS 0xC000BF05 /end MEASUREMENT
/begin MEASUREMENT Elin_buffer10 "Puffer für ganze Elin Botschaft" UBYTE ident 1 100 0.00 255. FORMAT "%3.0" ECU_ADDRESS 0xC000BF06 /end MEASUREMENT
/begin MEASUREMENT Elin_buffer11 "Puffer für ganze Elin Botschaft" UBYTE ident 1 100 0.00 255. FORMAT "%3.0" ECU_ADDRESS 0xC000BF07 /end MEASUREMENT
/begin MEASUREMENT Elin_buffer12 "Puffer für ganze Elin Botschaft" UBYTE ident 1 100 0.00 255. FORMAT "%3.0" ECU_ADDRESS 0xC000BF08 /end MEASUREMENT
/begin MEASUREMENT Elin_buffer13 "Puffer für ganze Elin Botschaft" UBYTE ident 1 100 0.00 255. FORMAT "%3.0" ECU_ADDRESS 0xC000BF09 /end MEASUREMENT
/begin MEASUREMENT Elin_buffer14 "Puffer für ganze Elin Botschaft" UBYTE ident 1 100 0.00 255. FORMAT "%3.0" ECU_ADDRESS 0xC000BF0A /end MEASUREMENT
/begin MEASUREMENT Elin_buffer15 "Puffer für ganze Elin Botschaft" UBYTE ident 1 100 0.00 255. FORMAT "%3.0" ECU_ADDRESS 0xC000BF0B /end MEASUREMENT
/begin MEASUREMENT Elin_buffer16 "Puffer für ganze Elin Botschaft" UBYTE ident 1 100 0.00 255. FORMAT "%3.0" ECU_ADDRESS 0xC000BF0C /end MEASUREMENT
/begin MEASUREMENT Elin_buffer17 "Puffer für ganze Elin Botschaft" UBYTE ident 1 100 0.00 255. FORMAT "%3.0" ECU_ADDRESS 0xC000BF0D /end MEASUREMENT
/begin MEASUREMENT Elin_buffer18 "Puffer für ganze Elin Botschaft" UBYTE ident 1 100 0.00 255. FORMAT "%3.0" ECU_ADDRESS 0xC000BF0E /end MEASUREMENT
/begin MEASUREMENT Elin_buffer19 "Puffer für ganze Elin Botschaft" UBYTE ident 1 100 0.00 255. FORMAT "%3.0" ECU_ADDRESS 0xC000BF0F /end MEASUREMENT
/begin MEASUREMENT Elin_buffer20 "Puffer für ganze Elin Botschaft" UBYTE ident 1 100 0.00 255. FORMAT "%3.0" ECU_ADDRESS 0xC000BF10 /end MEASUREMENT
/begin MEASUREMENT Elin_buffer21 "Puffer für ganze Elin Botschaft" UBYTE ident 1 100 0.00 255. FORMAT "%3.0" ECU_ADDRESS 0xC000BF11 /end MEASUREMENT
/begin MEASUREMENT Elin_buffer22 "Puffer für ganze Elin Botschaft" UBYTE ident 1 100 0.00 255. FORMAT "%3.0" ECU_ADDRESS 0xC000BF12 /end MEASUREMENT
/begin MEASUREMENT Elin_buffer23 "Puffer für ganze Elin Botschaft" UBYTE ident 1 100 0.00 255. FORMAT "%3.0" ECU_ADDRESS 0xC000BF13 /end MEASUREMENT
/begin MEASUREMENT Elin_buffer24 "Puffer für ganze Elin Botschaft" UBYTE ident 1 100 0.00 255. FORMAT "%3.0" ECU_ADDRESS 0xC000BF14 /end MEASUREMENT
/begin MEASUREMENT Elin_buffer25 "Puffer für ganze Elin Botschaft" UBYTE ident 1 100 0.00 255. FORMAT "%3.0" ECU_ADDRESS 0xC000BF15 /end MEASUREMENT
/begin MEASUREMENT Elin_buffer26 "Puffer für ganze Elin Botschaft" UBYTE ident 1 100 0.00 255. FORMAT "%3.0" ECU_ADDRESS 0xC000BF16 /end MEASUREMENT
/begin MEASUREMENT Elin_buffer27 "Puffer für ganze Elin Botschaft" UBYTE ident 1 100 0.00 255. FORMAT "%3.0" ECU_ADDRESS 0xC000BF17 /end MEASUREMENT
/begin MEASUREMENT Elin_buffer28 "Puffer für ganze Elin Botschaft" UBYTE ident 1 100 0.00 255. FORMAT "%3.0" ECU_ADDRESS 0xC000BF18 /end MEASUREMENT
/begin MEASUREMENT Elin_buffer29 "Puffer für ganze Elin Botschaft" UBYTE ident 1 100 0.00 255. FORMAT "%3.0" ECU_ADDRESS 0xC000BF19 /end MEASUREMENT
/begin MEASUREMENT Elin_buffer30 "Puffer für ganze Elin Botschaft" UBYTE ident 1 100 0.00 255. FORMAT "%3.0" ECU_ADDRESS 0xC000BF1A /end MEASUREMENT
/begin MEASUREMENT Elin_buffer31 "Puffer für ganze Elin Botschaft" UBYTE ident 1 100 0.00 255. FORMAT "%3.0" ECU_ADDRESS 0xC000BF1B /end MEASUREMENT
/begin MEASUREMENT Elin_buffer32 "Puffer für ganze Elin Botschaft" UBYTE ident 1 100 0.00 255. FORMAT "%3.0" ECU_ADDRESS 0xC000BF1C /end MEASUREMENT
/begin MEASUREMENT Elin_buffer33 "Puffer für ganze Elin Botschaft" UBYTE ident 1 100 0.00 255. FORMAT "%3.0" ECU_ADDRESS 0xC000BF1D /end MEASUREMENT
/begin MEASUREMENT Elin_buffer34 "Puffer für ganze Elin Botschaft" UBYTE ident 1 100 0.00 255. FORMAT "%3.0" ECU_ADDRESS 0xC000BF1E /end MEASUREMENT
/begin MEASUREMENT Elin_buffer35 "Puffer für ganze Elin Botschaft" UBYTE ident 1 100 0.00 255. FORMAT "%3.0" ECU_ADDRESS 0xC000BF1F /end MEASUREMENT
/begin MEASUREMENT Elin_buffer36 "Puffer für ganze Elin Botschaft" UBYTE ident 1 100 0.00 255. FORMAT "%3.0" ECU_ADDRESS 0xC000BF20 /end MEASUREMENT
/begin MEASUREMENT Elin_buffer37 "Puffer für ganze Elin Botschaft" UBYTE ident 1 100 0.00 255. FORMAT "%3.0" ECU_ADDRESS 0xC000BF21 /end MEASUREMENT
/begin MEASUREMENT Elin_buffer38 "Puffer für ganze Elin Botschaft" UBYTE ident 1 100 0.00 255. FORMAT "%3.0" ECU_ADDRESS 0xC000BF22 /end MEASUREMENT
/begin MEASUREMENT Elin_buffer39 "Puffer für ganze Elin Botschaft" UBYTE ident 1 100 0.00 255. FORMAT "%3.0" ECU_ADDRESS 0xC000BF23 /end MEASUREMENT
/begin MEASUREMENT Elin_buffer40 "Puffer für ganze Elin Botschaft" UBYTE ident 1 100 0.00 255. FORMAT "%3.0" ECU_ADDRESS 0xC000BF24 /end MEASUREMENT
/begin MEASUREMENT Elin_buffer41 "Puffer für ganze Elin Botschaft" UBYTE ident 1 100 0.00 255. FORMAT "%3.0" ECU_ADDRESS 0xC000BF25 /end MEASUREMENT
/begin MEASUREMENT Elin_buffer42 "Puffer für ganze Elin Botschaft" UBYTE ident 1 100 0.00 255. FORMAT "%3.0" ECU_ADDRESS 0xC000BF26 /end MEASUREMENT
/begin MEASUREMENT Elin_buffer43 "Puffer für ganze Elin Botschaft" UBYTE ident 1 100 0.00 255. FORMAT "%3.0" ECU_ADDRESS 0xC000BF27 /end MEASUREMENT
/begin MEASUREMENT Elin_buffer44 "Puffer für ganze Elin Botschaft" UBYTE ident 1 100 0.00 255. FORMAT "%3.0" ECU_ADDRESS 0xC000BF28 /end MEASUREMENT
/begin MEASUREMENT Elin_buffer45 "Puffer für ganze Elin Botschaft" UBYTE ident 1 100 0.00 255. FORMAT "%3.0" ECU_ADDRESS 0xC000BF29 /end MEASUREMENT
/begin MEASUREMENT Elin_buffer46 "Puffer für ganze Elin Botschaft" UBYTE ident 1 100 0.00 255. FORMAT "%3.0" ECU_ADDRESS 0xC000BF2A /end MEASUREMENT
/begin MEASUREMENT Elin_buffer47 "Puffer für ganze Elin Botschaft" UBYTE ident 1 100 0.00 255. FORMAT "%3.0" ECU_ADDRESS 0xC000BF2B /end MEASUREMENT
/begin MEASUREMENT Elin_buffer48 "Puffer für ganze Elin Botschaft" UBYTE ident 1 100 0.00 255. FORMAT "%3.0" ECU_ADDRESS 0xC000BF2C /end MEASUREMENT
/begin MEASUREMENT Elin_buffer49 "Puffer für ganze Elin Botschaft" UBYTE ident 1 100 0.00 255. FORMAT "%3.0" ECU_ADDRESS 0xC000BF2D /end MEASUREMENT
/begin MEASUREMENT Elin_buffer50 "Puffer für ganze Elin Botschaft" UBYTE ident 1 100 0.00 255. FORMAT "%3.0" ECU_ADDRESS 0xC000BF2E /end MEASUREMENT
/begin MEASUREMENT Elin_buffer51 "Puffer für ganze Elin Botschaft" UBYTE ident 1 100 0.00 255. FORMAT "%3.0" ECU_ADDRESS 0xC000BF2F /end MEASUREMENT
/begin MEASUREMENT Elin_buffer52 "Puffer für ganze Elin Botschaft" UBYTE ident 1 100 0.00 255. FORMAT "%3.0" ECU_ADDRESS 0xC000BF30 /end MEASUREMENT
/begin MEASUREMENT Elin_buffer53 "Puffer für ganze Elin Botschaft" UBYTE ident 1 100 0.00 255. FORMAT "%3.0" ECU_ADDRESS 0xC000BF31 /end MEASUREMENT
/begin MEASUREMENT Elin_buffer54 "Puffer für ganze Elin Botschaft" UBYTE ident 1 100 0.00 255. FORMAT "%3.0" ECU_ADDRESS 0xC000BF32 /end MEASUREMENT
/begin MEASUREMENT Elin_buffer55 "Puffer für ganze Elin Botschaft" UBYTE ident 1 100 0.00 255. FORMAT "%3.0" ECU_ADDRESS 0xC000BF33 /end MEASUREMENT
/begin MEASUREMENT Elin_buffer56 "Puffer für ganze Elin Botschaft" UBYTE ident 1 100 0.00 255. FORMAT "%3.0" ECU_ADDRESS 0xC000BF34 /end MEASUREMENT
/begin MEASUREMENT Elin_buffer57 "Puffer für ganze Elin Botschaft" UBYTE ident 1 100 0.00 255. FORMAT "%3.0" ECU_ADDRESS 0xC000BF35 /end MEASUREMENT
/begin MEASUREMENT Elin_buffer58 "Puffer für ganze Elin Botschaft" UBYTE ident 1 100 0.00 255. FORMAT "%3.0" ECU_ADDRESS 0xC000BF36 /end MEASUREMENT
/begin MEASUREMENT Elin_buffer59 "Puffer für ganze Elin Botschaft" UBYTE ident 1 100 0.00 255. FORMAT "%3.0" ECU_ADDRESS 0xC000BF37 /end MEASUREMENT
/begin MEASUREMENT Elin_buffer60 "Puffer für ganze Elin Botschaft" UBYTE ident 1 100 0.00 255. FORMAT "%3.0" ECU_ADDRESS 0xC000BF38 /end MEASUREMENT
/begin MEASUREMENT Elin_buffer61 "Puffer für ganze Elin Botschaft" UBYTE ident 1 100 0.00 255. FORMAT "%3.0" ECU_ADDRESS 0xC000BF39 /end MEASUREMENT
/begin MEASUREMENT Elin_buffer62 "Puffer für ganze Elin Botschaft" UBYTE ident 1 100 0.00 255. FORMAT "%3.0" ECU_ADDRESS 0xC000BF3A /end MEASUREMENT
/begin MEASUREMENT Elin_buffer63 "Puffer für ganze Elin Botschaft" UBYTE ident 1 100 0.00 255. FORMAT "%3.0" ECU_ADDRESS 0xC000BF3B /end MEASUREMENT
/begin MEASUREMENT Elin_buffer64 "Puffer für ganze Elin Botschaft" UBYTE ident 1 100 0.00 255. FORMAT "%3.0" ECU_ADDRESS 0xC000BF3C /end MEASUREMENT
/begin MEASUREMENT Elin_buffer65 "Puffer für ganze Elin Botschaft" UBYTE ident 1 100 0.00 255. FORMAT "%3.0" ECU_ADDRESS 0xC000BF3D /end MEASUREMENT
/begin MEASUREMENT Elin_buffer66 "Puffer für ganze Elin Botschaft" UBYTE ident 1 100 0.00 255. FORMAT "%3.0" ECU_ADDRESS 0xC000BF3E /end MEASUREMENT
/begin MEASUREMENT Elin_buffer67 "Puffer für ganze Elin Botschaft" UBYTE ident 1 100 0.00 255. FORMAT "%3.0" ECU_ADDRESS 0xC000BF3F /end MEASUREMENT
/begin MEASUREMENT Elin_buffer68 "Puffer für ganze Elin Botschaft" UBYTE ident 1 100 0.00 255. FORMAT "%3.0" ECU_ADDRESS 0xC000BF40 /end MEASUREMENT
/begin MEASUREMENT Elin_buffer69 "Puffer für ganze Elin Botschaft" UBYTE ident 1 100 0.00 255. FORMAT "%3.0" ECU_ADDRESS 0xC000BF41 /end MEASUREMENT
/begin MEASUREMENT Elin_buffer70 "Puffer für ganze Elin Botschaft" UBYTE ident 1 100 0.00 255. FORMAT "%3.0" ECU_ADDRESS 0xC000BF42 /end MEASUREMENT
/begin MEASUREMENT Elin_buffer71 "Puffer für ganze Elin Botschaft" UBYTE ident 1 100 0.00 255. FORMAT "%3.0" ECU_ADDRESS 0xC000BF43 /end MEASUREMENT
/begin MEASUREMENT Elin_buffer72 "Puffer für ganze Elin Botschaft" UBYTE ident 1 100 0.00 255. FORMAT "%3.0" ECU_ADDRESS 0xC000BF44 /end MEASUREMENT
/begin MEASUREMENT Elin_buffer73 "Puffer für ganze Elin Botschaft" UBYTE ident 1 100 0.00 255. FORMAT "%3.0" ECU_ADDRESS 0xC000BF45 /end MEASUREMENT
/begin MEASUREMENT Elin_buffer74 "Puffer für ganze Elin Botschaft" UBYTE ident 1 100 0.00 255. FORMAT "%3.0" ECU_ADDRESS 0xC000BF46 /end MEASUREMENT
/begin MEASUREMENT Elin_buffer75 "Puffer für ganze Elin Botschaft" UBYTE ident 1 100 0.00 255. FORMAT "%3.0" ECU_ADDRESS 0xC000BF47 /end MEASUREMENT
/begin MEASUREMENT Elin_buffer76 "Puffer für ganze Elin Botschaft" UBYTE ident 1 100 0.00 255. FORMAT "%3.0" ECU_ADDRESS 0xC000BF48 /end MEASUREMENT
/begin MEASUREMENT Elin_buffer77 "Puffer für ganze Elin Botschaft" UBYTE ident 1 100 0.00 255. FORMAT "%3.0" ECU_ADDRESS 0xC000BF49 /end MEASUREMENT
/begin MEASUREMENT Elin_buffer78 "Puffer für ganze Elin Botschaft" UBYTE ident 1 100 0.00 255. FORMAT "%3.0" ECU_ADDRESS 0xC000BF4A /end MEASUREMENT
/begin MEASUREMENT Elin_buffer79 "Puffer für ganze Elin Botschaft" UBYTE ident 1 100 0.00 255. FORMAT "%3.0" ECU_ADDRESS 0xC000BF4B /end MEASUREMENT
/begin MEASUREMENT Elin_buffer80 "Puffer für ganze Elin Botschaft" UBYTE ident 1 100 0.00 255. FORMAT "%3.0" ECU_ADDRESS 0xC000BF4C /end MEASUREMENT
/begin MEASUREMENT Elin_buffer81 "Puffer für ganze Elin Botschaft" UBYTE ident 1 100 0.00 255. FORMAT "%3.0" ECU_ADDRESS 0xC000BF4D /end MEASUREMENT
/begin MEASUREMENT Elin_buffer82 "Puffer für ganze Elin Botschaft" UBYTE ident 1 100 0.00 255. FORMAT "%3.0" ECU_ADDRESS 0xC000BF4E /end MEASUREMENT
/begin MEASUREMENT Elin_buffer83 "Puffer für ganze Elin Botschaft" UBYTE ident 1 100 0.00 255. FORMAT "%3.0" ECU_ADDRESS 0xC000BF4F /end MEASUREMENT
/begin MEASUREMENT Elin_buffer84 "Puffer für ganze Elin Botschaft" UBYTE ident 1 100 0.00 255. FORMAT "%3.0" ECU_ADDRESS 0xC000BF50 /end MEASUREMENT
/begin MEASUREMENT Elin_buffer85 "Puffer für ganze Elin Botschaft" UBYTE ident 1 100 0.00 255. FORMAT "%3.0" ECU_ADDRESS 0xC000BF51 /end MEASUREMENT
/begin MEASUREMENT Elin_buffer86 "Puffer für ganze Elin Botschaft" UBYTE ident 1 100 0.00 255. FORMAT "%3.0" ECU_ADDRESS 0xC000BF52 /end MEASUREMENT
/begin MEASUREMENT Elin_buffer87 "Puffer für ganze Elin Botschaft" UBYTE ident 1 100 0.00 255. FORMAT "%3.0" ECU_ADDRESS 0xC000BF53 /end MEASUREMENT
/begin MEASUREMENT Elin_buffer88 "Puffer für ganze Elin Botschaft" UBYTE ident 1 100 0.00 255. FORMAT "%3.0" ECU_ADDRESS 0xC000BF54 /end MEASUREMENT
/begin MEASUREMENT Elin_buffer89 "Puffer für ganze Elin Botschaft" UBYTE ident 1 100 0.00 255. FORMAT "%3.0" ECU_ADDRESS 0xC000BF55 /end MEASUREMENT
/begin MEASUREMENT Elin_buffer90 "Puffer für ganze Elin Botschaft" UBYTE ident 1 100 0.00 255. FORMAT "%3.0" ECU_ADDRESS 0xC000BF56 /end MEASUREMENT
/begin MEASUREMENT Elin_buffer91 "Puffer für ganze Elin Botschaft" UBYTE ident 1 100 0.00 255. FORMAT "%3.0" ECU_ADDRESS 0xC000BF57 /end MEASUREMENT
/begin MEASUREMENT Elin_buffer92 "Puffer für ganze Elin Botschaft" UBYTE ident 1 100 0.00 255. FORMAT "%3.0" ECU_ADDRESS 0xC000BF58 /end MEASUREMENT
/begin MEASUREMENT Elin_buffer93 "Puffer für ganze Elin Botschaft" UBYTE ident 1 100 0.00 255. FORMAT "%3.0" ECU_ADDRESS 0xC000BF59 /end MEASUREMENT
/begin MEASUREMENT Elin_buffer94 "Puffer für ganze Elin Botschaft" UBYTE ident 1 100 0.00 255. FORMAT "%3.0" ECU_ADDRESS 0xC000BF5A /end MEASUREMENT
/begin MEASUREMENT Elin_buffer95 "Puffer für ganze Elin Botschaft" UBYTE ident 1 100 0.00 255. FORMAT "%3.0" ECU_ADDRESS 0xC000BF5B /end MEASUREMENT
/begin MEASUREMENT Elin_buffer96 "Puffer für ganze Elin Botschaft" UBYTE ident 1 100 0.00 255. FORMAT "%3.0" ECU_ADDRESS 0xC000BF5C /end MEASUREMENT
/begin MEASUREMENT Elin_buffer97 "Puffer für ganze Elin Botschaft" UBYTE ident 1 100 0.00 255. FORMAT "%3.0" ECU_ADDRESS 0xC000BF5D /end MEASUREMENT
/begin MEASUREMENT Elin_buffer98 "Puffer für ganze Elin Botschaft" UBYTE ident 1 100 0.00 255. FORMAT "%3.0" ECU_ADDRESS 0xC000BF5E /end MEASUREMENT
/begin MEASUREMENT Elin_buffer99 "Puffer für ganze Elin Botschaft" UBYTE ident 1 100 0.00 255. FORMAT "%3.0" ECU_ADDRESS 0xC000BF5F /end MEASUREMENT
/begin MEASUREMENT Elin_buffer100 "Puffer für ganze Elin Botschaft" UBYTE ident 1 100 0.00 255. FORMAT "%3.0" ECU_ADDRESS 0xC000BF60 /end MEASUREMENT
/begin MEASUREMENT Elin_buffer101 "Puffer für ganze Elin Botschaft" UBYTE ident 1 100 0.00 255. FORMAT "%3.0" ECU_ADDRESS 0xC000BF61 /end MEASUREMENT
/begin MEASUREMENT Elin_buffer102 "Puffer für ganze Elin Botschaft" UBYTE ident 1 100 0.00 255. FORMAT "%3.0" ECU_ADDRESS 0xC000BF62 /end MEASUREMENT
/begin MEASUREMENT Elin_buffer103 "Puffer für ganze Elin Botschaft" UBYTE ident 1 100 0.00 255. FORMAT "%3.0" ECU_ADDRESS 0xC000BF63 /end MEASUREMENT
/begin MEASUREMENT Elin_buffer104 "Puffer für ganze Elin Botschaft" UBYTE ident 1 100 0.00 255. FORMAT "%3.0" ECU_ADDRESS 0xC000BF64 /end MEASUREMENT
/begin MEASUREMENT Elin_buffer105 "Puffer für ganze Elin Botschaft" UBYTE ident 1 100 0.00 255. FORMAT "%3.0" ECU_ADDRESS 0xC000BF65 /end MEASUREMENT
/begin MEASUREMENT Elin_buffer106 "Puffer für ganze Elin Botschaft" UBYTE ident 1 100 0.00 255. FORMAT "%3.0" ECU_ADDRESS 0xC000BF66 /end MEASUREMENT
/begin MEASUREMENT Elin_buffer107 "Puffer für ganze Elin Botschaft" UBYTE ident 1 100 0.00 255. FORMAT "%3.0" ECU_ADDRESS 0xC000BF67 /end MEASUREMENT
/begin MEASUREMENT Elin_buffer108 "Puffer für ganze Elin Botschaft" UBYTE ident 1 100 0.00 255. FORMAT "%3.0" ECU_ADDRESS 0xC000BF68 /end MEASUREMENT
/begin MEASUREMENT Elin_buffer109 "Puffer für ganze Elin Botschaft" UBYTE ident 1 100 0.00 255. FORMAT "%3.0" ECU_ADDRESS 0xC000BF69 /end MEASUREMENT
/begin MEASUREMENT Elin_buffer110 "Puffer für ganze Elin Botschaft" UBYTE ident 1 100 0.00 255. FORMAT "%3.0" ECU_ADDRESS 0xC000BF6A /end MEASUREMENT
/begin MEASUREMENT Elin_buffer111 "Puffer für ganze Elin Botschaft" UBYTE ident 1 100 0.00 255. FORMAT "%3.0" ECU_ADDRESS 0xC000BF6B /end MEASUREMENT
/begin MEASUREMENT Elin_buffer112 "Puffer für ganze Elin Botschaft" UBYTE ident 1 100 0.00 255. FORMAT "%3.0" ECU_ADDRESS 0xC000BF6C /end MEASUREMENT
/begin MEASUREMENT Elin_buffer113 "Puffer für ganze Elin Botschaft" UBYTE ident 1 100 0.00 255. FORMAT "%3.0" ECU_ADDRESS 0xC000BF6D /end MEASUREMENT
/begin MEASUREMENT Elin_buffer114 "Puffer für ganze Elin Botschaft" UBYTE ident 1 100 0.00 255. FORMAT "%3.0" ECU_ADDRESS 0xC000BF6E /end MEASUREMENT
/begin MEASUREMENT Elin_buffer115 "Puffer für ganze Elin Botschaft" UBYTE ident 1 100 0.00 255. FORMAT "%3.0" ECU_ADDRESS 0xC000BF6F /end MEASUREMENT
/begin MEASUREMENT Elin_buffer116 "Puffer für ganze Elin Botschaft" UBYTE ident 1 100 0.00 255. FORMAT "%3.0" ECU_ADDRESS 0xC000BF70 /end MEASUREMENT
/begin MEASUREMENT Elin_buffer117 "Puffer für ganze Elin Botschaft" UBYTE ident 1 100 0.00 255. FORMAT "%3.0" ECU_ADDRESS 0xC000BF71 /end MEASUREMENT
/begin MEASUREMENT Elin_buffer118 "Puffer für ganze Elin Botschaft" UBYTE ident 1 100 0.00 255. FORMAT "%3.0" ECU_ADDRESS 0xC000BF72 /end MEASUREMENT
/begin MEASUREMENT Elin_buffer119 "Puffer für ganze Elin Botschaft" UBYTE ident 1 100 0.00 255. FORMAT "%3.0" ECU_ADDRESS 0xC000BF73 /end MEASUREMENT
/begin MEASUREMENT EMDmp_rPs00 "Ausgangstastverhältnis für das Motorschwingungsdämpfer-Gerät" SWORD DtyCyc 1 100 -327.6800 327.6700 ECU_ADDRESS 0xD0000934 /end MEASUREMENT
/begin MEASUREMENT EngDa_tFld00 "Motortemperatur-Feld" SWORD Temp_Cels 1 100 -3549.940 3003.560 ECU_ADDRESS 0xD00003D8 /end MEASUREMENT
/begin MEASUREMENT EngDa_tFld01 "Motortemperatur-Feld" SWORD Temp_Cels 1 100 -3549.940 3003.560 ECU_ADDRESS 0xD00003DA /end MEASUREMENT
/begin MEASUREMENT EngDa_tFld02 "Motortemperatur-Feld" SWORD Temp_Cels 1 100 -3549.940 3003.560 ECU_ADDRESS 0xD00003DC /end MEASUREMENT
/begin MEASUREMENT EngDa_tFld03 "Motortemperatur-Feld" SWORD Temp_Cels 1 100 -3549.940 3003.560 ECU_ADDRESS 0xD00003DE /end MEASUREMENT
/begin MEASUREMENT EngPrt_tiSeg00 "Zeit zwischen 2 Nockenwellensegmentflanken" SLONG OneToOne_us 1 100 -2147483648.00 2147483647.00 FORMAT "%13.2" ECU_ADDRESS 0xD0002EA4 /end MEASUREMENT
/begin MEASUREMENT EngPrt_tiSeg01 "Zeit zwischen 2 Nockenwellensegmentflanken" SLONG OneToOne_us 1 100 -2147483648.00 2147483647.00 FORMAT "%13.2" ECU_ADDRESS 0xD0002EA8 /end MEASUREMENT
/begin MEASUREMENT EngPrt_tiSeg02 "Zeit zwischen 2 Nockenwellensegmentflanken" SLONG OneToOne_us 1 100 -2147483648.00 2147483647.00 FORMAT "%13.2" ECU_ADDRESS 0xD0002EAC /end MEASUREMENT
/begin MEASUREMENT EngPrt_tiSeg03 "Zeit zwischen 2 Nockenwellensegmentflanken" SLONG OneToOne_us 1 100 -2147483648.00 2147483647.00 FORMAT "%13.2" ECU_ADDRESS 0xD0002EB0 /end MEASUREMENT
/begin MEASUREMENT EpmCaS_ctEdgeEquid00 "Offset der letzten equidistanten Nockenwellenflanke in EpmSyn_ctEdgeMapEquid" UBYTE OneToOne 1 100 0.00 255.0 ECU_ADDRESS 0xD0001DF8 /end MEASUREMENT
/begin MEASUREMENT EpmCaS_ctErrSigDef00 "Anzahl von Kurbelwellen-Inkrements während das Nockenwellen Pattern Matching Fehler liefert" UWORD OneToOne 1 100 0.00 65535.00 ECU_ADDRESS 0xD000581E /end MEASUREMENT
/begin MEASUREMENT EpmCaS_ctErrSigOk00 "Entprellzähler Heilung Nockenwellenstörung" UWORD OneToOne 1 100 0.00 65535.00 ECU_ADDRESS 0xD0005820 /end MEASUREMENT
/begin MEASUREMENT EpmCaS_ctNoSig00 "Anzahl der Kurbelwellen-Inkrements bei fehlendem Nockenwellensignal" UWORD OneToOne 1 100 0.00 65535.00 ECU_ADDRESS 0xD000581C /end MEASUREMENT
/begin MEASUREMENT EpmCaS_ctOfsErr_mp00 "Entprellzähler Verdrehung Nockenwelle" UBYTE OneToOne 1 100 0.00 255.0 ECU_ADDRESS 0xC000BB7C /end MEASUREMENT
/begin MEASUREMENT EpmCaS_numBufEntry_mp00 "Index des nächsten freien Elements im Puffer" UBYTE OneToOne 1 100 0.00 255.0 ECU_ADDRESS 0xC000BB7D /end MEASUREMENT
/begin MEASUREMENT EpmCaS_numCurrEdge00 "Anzahl der aktuell erkannten Nockenwellenflanken" UWORD OneToOne 1 100 0.00 65535.00 ECU_ADDRESS 0xD000581A /end MEASUREMENT
/begin MEASUREMENT EpmCaS_numValidTeeth_mp00 "Anzahl der äquidistanten Segmentflanken, die während eines Prozess Aufrufs gefunden wurden" UBYTE OneToOne 1 100 0.00 255.0 ECU_ADDRESS 0xC000BB7E /end MEASUREMENT
/begin MEASUREMENT EpmCaS_phiCaSOfsAvg00 "gemittelter Verdrehwinkel der Nockenwelle" SLONG AngleCrS 1 100 -47185920.0000 47185919.9780 ECU_ADDRESS 0xC00033EC /end MEASUREMENT
/begin MEASUREMENT EpmCaS_phiCor00 "Winkelkorrekturwert der Nockenwelle über Drehzahl und Temperatur" SWORD AngleCrS 1 100 -720.0000 719.9780 ECU_ADDRESS 0xD00009DA /end MEASUREMENT
/begin MEASUREMENT EpmCaS_phiDiff00 "Abweichung der aktuellen NW Position von der adaptierten bzw realen Referenzposition" SWORD AngleCrS 1 100 -720.0000 719.9780 ECU_ADDRESS 0xD00009DC /end MEASUREMENT
/begin MEASUREMENT EpmCaS_phiEdge00 "Winkel der NW Flanke" SWORD AngleCrS 1 100 -720.0000 719.9780 ECU_ADDRESS 0xD00009DE /end MEASUREMENT
/begin MEASUREMENT EpmCaS_phiMissedSeg_mp00 "Erwarteter Winkel einer fehlenden äquidistanten NW-Flanke" SWORD AngleCrS 1 100 -720.0000 719.9780 ECU_ADDRESS 0xC000BB80 /end MEASUREMENT
/begin MEASUREMENT EpmCaS_phiOfsCorr00 "gefilterter Nockenwellenverdrehwinkel" SWORD AngleCrS 1 100 -720.0000 719.9780 ECU_ADDRESS 0xD00009E0 /end MEASUREMENT
/begin MEASUREMENT EpmCaS_phiRawValue_mp00 "Array mit den Rohwerte der Flankenpositionen der Nockenwelle." SWORD AngleCrS 1 100 -720.0000 719.9780 ECU_ADDRESS 0xC000BB68 /end MEASUREMENT
/begin MEASUREMENT EpmCaS_phiRawValue_mp01 "Array mit den Rohwerte der Flankenpositionen der Nockenwelle." SWORD AngleCrS 1 100 -720.0000 719.9780 ECU_ADDRESS 0xC000BB6A /end MEASUREMENT
/begin MEASUREMENT EpmCaS_phiRawValue_mp02 "Array mit den Rohwerte der Flankenpositionen der Nockenwelle." SWORD AngleCrS 1 100 -720.0000 719.9780 ECU_ADDRESS 0xC000BB6C /end MEASUREMENT
/begin MEASUREMENT EpmCaS_phiRawValue_mp03 "Array mit den Rohwerte der Flankenpositionen der Nockenwelle." SWORD AngleCrS 1 100 -720.0000 719.9780 ECU_ADDRESS 0xC000BB6E /end MEASUREMENT
/begin MEASUREMENT EpmCaS_phiRawValue_mp04 "Array mit den Rohwerte der Flankenpositionen der Nockenwelle." SWORD AngleCrS 1 100 -720.0000 719.9780 ECU_ADDRESS 0xC000BB70 /end MEASUREMENT
/begin MEASUREMENT EpmCaS_phiRawValue_mp05 "Array mit den Rohwerte der Flankenpositionen der Nockenwelle." SWORD AngleCrS 1 100 -720.0000 719.9780 ECU_ADDRESS 0xC000BB72 /end MEASUREMENT
/begin MEASUREMENT EpmCaS_phiRawValue_mp06 "Array mit den Rohwerte der Flankenpositionen der Nockenwelle." SWORD AngleCrS 1 100 -720.0000 719.9780 ECU_ADDRESS 0xC000BB74 /end MEASUREMENT
/begin MEASUREMENT EpmCaS_phiRawValue_mp07 "Array mit den Rohwerte der Flankenpositionen der Nockenwelle." SWORD AngleCrS 1 100 -720.0000 719.9780 ECU_ADDRESS 0xC000BB76 /end MEASUREMENT
/begin MEASUREMENT EpmCaS_phiRawValue_mp08 "Array mit den Rohwerte der Flankenpositionen der Nockenwelle." SWORD AngleCrS 1 100 -720.0000 719.9780 ECU_ADDRESS 0xC000BB78 /end MEASUREMENT
/begin MEASUREMENT EpmCaS_phiRawValue_mp09 "Array mit den Rohwerte der Flankenpositionen der Nockenwelle." SWORD AngleCrS 1 100 -720.0000 719.9780 ECU_ADDRESS 0xC000BB7A /end MEASUREMENT
/begin MEASUREMENT EpmCaS_phiTempCor00 "Winkelkorrekturwert für jede Nockenwelle abhängig von der Temperatur" SWORD AngleCrS 1 100 -720.0000 719.9780 ECU_ADDRESS 0xD00009E2 /end MEASUREMENT
/begin MEASUREMENT EpmCaS_stAdap00 "Status der Nockenwellenadaption" UBYTE EpmCaS_stAdap_State 1 100 0.00 4.00000000000 FORMAT "%13.11" ECU_ADDRESS 0xD00095B4 /end MEASUREMENT
/begin MEASUREMENT EpmCaS_stDiag00 "Zustand der Nockenwellendiagnose" UBYTE OneToOne 1 100 0.00 255.0 ECU_ADDRESS 0xC0007E72 /end MEASUREMENT
/begin MEASUREMENT EpmCaS_stErrSig00 "Fehlerzustand für Nockenwellenstörung" UBYTE OneToOne 1 100 0.00 255.0 ECU_ADDRESS 0xC0007E73 /end MEASUREMENT
/begin MEASUREMENT EpmCaS_stNoSig00 "Fehlerzustand für Nockenwellenausfall" UBYTE OneToOne 1 100 0.00 255.0 ECU_ADDRESS 0xC0007E74 /end MEASUREMENT
/begin MEASUREMENT EpmCaS_stOfs00 "Zustand der NW-Verdrehberechnung" UBYTE EpmCas_stOfs_State 1 100 0.00 1.00000000000 FORMAT "%13.11" ECU_ADDRESS 0xD0002D04 /end MEASUREMENT
/begin MEASUREMENT EpmCaS_stOfsErr00 "Fehlerzustand der NW-Verdrehberechnung" UBYTE EpmCaS_stOfsErr_Val 1 100 0.00 5.00000000000 FORMAT "%13.11" ECU_ADDRESS 0xC0007E7C /end MEASUREMENT
/begin MEASUREMENT EpmCaS_tiEdge00 "Zeitpunkt der NW Flanke" SLONG Per_Dur 1 100 -2147483648.00 2147483647.00 FORMAT "%13.2" ECU_ADDRESS 0xD0002EC4 /end MEASUREMENT
/begin MEASUREMENT EpmCrS_tiInc_mp00 "TTmeasure - KW-Zahnzeiten seit dem letzten Interrupt" UWORD TimeGPTATick 1 100 0.00 3276.750 FORMAT "%8.3" ECU_ADDRESS 0xC000BB82 /end MEASUREMENT
/begin MEASUREMENT EpmCrS_tiInc_mp01 "TTmeasure - KW-Zahnzeiten seit dem letzten Interrupt" UWORD TimeGPTATick 1 100 0.00 3276.750 FORMAT "%8.3" ECU_ADDRESS 0xC000BB84 /end MEASUREMENT
/begin MEASUREMENT EpmCrS_tiInc_mp02 "TTmeasure - KW-Zahnzeiten seit dem letzten Interrupt" UWORD TimeGPTATick 1 100 0.00 3276.750 FORMAT "%8.3" ECU_ADDRESS 0xC000BB86 /end MEASUREMENT
/begin MEASUREMENT EpmCrS_tiInc_mp03 "TTmeasure - KW-Zahnzeiten seit dem letzten Interrupt" UWORD TimeGPTATick 1 100 0.00 3276.750 FORMAT "%8.3" ECU_ADDRESS 0xC000BB88 /end MEASUREMENT
/begin MEASUREMENT EpmCrS_tiInc_mp04 "TTmeasure - KW-Zahnzeiten seit dem letzten Interrupt" UWORD TimeGPTATick 1 100 0.00 3276.750 FORMAT "%8.3" ECU_ADDRESS 0xC000BB8A /end MEASUREMENT
/begin MEASUREMENT EpmCrS_tiInc_mp05 "TTmeasure - KW-Zahnzeiten seit dem letzten Interrupt" UWORD TimeGPTATick 1 100 0.00 3276.750 FORMAT "%8.3" ECU_ADDRESS 0xC000BB8C /end MEASUREMENT
/begin MEASUREMENT EpmCrS_tiInc_mp06 "TTmeasure - KW-Zahnzeiten seit dem letzten Interrupt" UWORD TimeGPTATick 1 100 0.00 3276.750 FORMAT "%8.3" ECU_ADDRESS 0xC000BB8E /end MEASUREMENT
/begin MEASUREMENT EpmCrS_tiInc_mp07 "TTmeasure - KW-Zahnzeiten seit dem letzten Interrupt" UWORD TimeGPTATick 1 100 0.00 3276.750 FORMAT "%8.3" ECU_ADDRESS 0xC000BB90 /end MEASUREMENT
/begin MEASUREMENT EpmCrS_tiInc_mp08 "TTmeasure - KW-Zahnzeiten seit dem letzten Interrupt" UWORD TimeGPTATick 1 100 0.00 3276.750 FORMAT "%8.3" ECU_ADDRESS 0xC000BB92 /end MEASUREMENT
/begin MEASUREMENT EpmCrS_tiInc_mp09 "TTmeasure - KW-Zahnzeiten seit dem letzten Interrupt" UWORD TimeGPTATick 1 100 0.00 3276.750 FORMAT "%8.3" ECU_ADDRESS 0xC000BB94 /end MEASUREMENT
/begin MEASUREMENT EpmCrS_tiInc_mp10 "TTmeasure - KW-Zahnzeiten seit dem letzten Interrupt" UWORD TimeGPTATick 1 100 0.00 3276.750 FORMAT "%8.3" ECU_ADDRESS 0xC000BB96 /end MEASUREMENT
/begin MEASUREMENT EpmCrS_tiInc_mp11 "TTmeasure - KW-Zahnzeiten seit dem letzten Interrupt" UWORD TimeGPTATick 1 100 0.00 3276.750 FORMAT "%8.3" ECU_ADDRESS 0xC000BB98 /end MEASUREMENT
/begin MEASUREMENT EpmCrS_tiInc_mp12 "TTmeasure - KW-Zahnzeiten seit dem letzten Interrupt" UWORD TimeGPTATick 1 100 0.00 3276.750 FORMAT "%8.3" ECU_ADDRESS 0xC000BB9A /end MEASUREMENT
/begin MEASUREMENT EpmCrS_tiInc_mp13 "TTmeasure - KW-Zahnzeiten seit dem letzten Interrupt" UWORD TimeGPTATick 1 100 0.00 3276.750 FORMAT "%8.3" ECU_ADDRESS 0xC000BB9C /end MEASUREMENT
/begin MEASUREMENT EpmCrS_tiInc_mp14 "TTmeasure - KW-Zahnzeiten seit dem letzten Interrupt" UWORD TimeGPTATick 1 100 0.00 3276.750 FORMAT "%8.3" ECU_ADDRESS 0xC000BB9E /end MEASUREMENT
/begin MEASUREMENT EpmCrS_tiInc_mp15 "TTmeasure - KW-Zahnzeiten seit dem letzten Interrupt" UWORD TimeGPTATick 1 100 0.00 3276.750 FORMAT "%8.3" ECU_ADDRESS 0xC000BBA0 /end MEASUREMENT
/begin MEASUREMENT EpmCrS_tiInc_mp16 "TTmeasure - KW-Zahnzeiten seit dem letzten Interrupt" UWORD TimeGPTATick 1 100 0.00 3276.750 FORMAT "%8.3" ECU_ADDRESS 0xC000BBA2 /end MEASUREMENT
/begin MEASUREMENT EpmCrS_tiInc_mp17 "TTmeasure - KW-Zahnzeiten seit dem letzten Interrupt" UWORD TimeGPTATick 1 100 0.00 3276.750 FORMAT "%8.3" ECU_ADDRESS 0xC000BBA4 /end MEASUREMENT
/begin MEASUREMENT EpmCrS_tiInc_mp18 "TTmeasure - KW-Zahnzeiten seit dem letzten Interrupt" UWORD TimeGPTATick 1 100 0.00 3276.750 FORMAT "%8.3" ECU_ADDRESS 0xC000BBA6 /end MEASUREMENT
/begin MEASUREMENT EpmCrS_tiInc_mp19 "TTmeasure - KW-Zahnzeiten seit dem letzten Interrupt" UWORD TimeGPTATick 1 100 0.00 3276.750 FORMAT "%8.3" ECU_ADDRESS 0xC000BBA8 /end MEASUREMENT
/begin MEASUREMENT EpmRRS_tiToothPerOrg_mp00 "Zahnzeitenpuffer ohne Lückenkorrektur" SLONG OneToOne_us 1 100 -2147483648.00 2147483647.00 FORMAT "%13.2" ECU_ADDRESS 0xC000BBAC /end MEASUREMENT
/begin MEASUREMENT EpmRRS_tiToothPerOrg_mp01 "Zahnzeitenpuffer ohne Lückenkorrektur" SLONG OneToOne_us 1 100 -2147483648.00 2147483647.00 FORMAT "%13.2" ECU_ADDRESS 0xC000BBB0 /end MEASUREMENT
/begin MEASUREMENT EpmRRS_tiToothPerOrg_mp02 "Zahnzeitenpuffer ohne Lückenkorrektur" SLONG OneToOne_us 1 100 -2147483648.00 2147483647.00 FORMAT "%13.2" ECU_ADDRESS 0xC000BBB4 /end MEASUREMENT
/begin MEASUREMENT EpmRRS_tiToothPerOrg_mp03 "Zahnzeitenpuffer ohne Lückenkorrektur" SLONG OneToOne_us 1 100 -2147483648.00 2147483647.00 FORMAT "%13.2" ECU_ADDRESS 0xC000BBB8 /end MEASUREMENT
/begin MEASUREMENT EpmRRS_tiToothPerOrg_mp04 "Zahnzeitenpuffer ohne Lückenkorrektur" SLONG OneToOne_us 1 100 -2147483648.00 2147483647.00 FORMAT "%13.2" ECU_ADDRESS 0xC000BBBC /end MEASUREMENT
/begin MEASUREMENT EpmRRS_tiToothPerOrg_mp05 "Zahnzeitenpuffer ohne Lückenkorrektur" SLONG OneToOne_us 1 100 -2147483648.00 2147483647.00 FORMAT "%13.2" ECU_ADDRESS 0xC000BBC0 /end MEASUREMENT
/begin MEASUREMENT EpmRRS_tiToothPerOrg_mp06 "Zahnzeitenpuffer ohne Lückenkorrektur" SLONG OneToOne_us 1 100 -2147483648.00 2147483647.00 FORMAT "%13.2" ECU_ADDRESS 0xC000BBC4 /end MEASUREMENT
/begin MEASUREMENT EpmRRS_tiToothPerOrg_mp07 "Zahnzeitenpuffer ohne Lückenkorrektur" SLONG OneToOne_us 1 100 -2147483648.00 2147483647.00 FORMAT "%13.2" ECU_ADDRESS 0xC000BBC8 /end MEASUREMENT
/begin MEASUREMENT EpmRRS_tiToothPerOrg_mp08 "Zahnzeitenpuffer ohne Lückenkorrektur" SLONG OneToOne_us 1 100 -2147483648.00 2147483647.00 FORMAT "%13.2" ECU_ADDRESS 0xC000BBCC /end MEASUREMENT
/begin MEASUREMENT EpmRRS_tiToothPerOrg_mp09 "Zahnzeitenpuffer ohne Lückenkorrektur" SLONG OneToOne_us 1 100 -2147483648.00 2147483647.00 FORMAT "%13.2" ECU_ADDRESS 0xC000BBD0 /end MEASUREMENT
/begin MEASUREMENT EpmRRS_tiToothPerOrg_mp10 "Zahnzeitenpuffer ohne Lückenkorrektur" SLONG OneToOne_us 1 100 -2147483648.00 2147483647.00 FORMAT "%13.2" ECU_ADDRESS 0xC000BBD4 /end MEASUREMENT
/begin MEASUREMENT EpmRRS_tiToothPerOrg_mp11 "Zahnzeitenpuffer ohne Lückenkorrektur" SLONG OneToOne_us 1 100 -2147483648.00 2147483647.00 FORMAT "%13.2" ECU_ADDRESS 0xC000BBD8 /end MEASUREMENT
/begin MEASUREMENT EpmSeq_numIncDiffInt00 "Abstand zwischen 2 Synchro-Interrupts in Kurbelwellenzähnen" SWORD OneToOne 1 100 -32768.00 32767.00 ECU_ADDRESS 0xD00009E8 /end MEASUREMENT
/begin MEASUREMENT EpmSeq_numIncDiffInt01 "Abstand zwischen 2 Synchro-Interrupts in Kurbelwellenzähnen" SWORD OneToOne 1 100 -32768.00 32767.00 ECU_ADDRESS 0xD00009EA /end MEASUREMENT
/begin MEASUREMENT EpmSyn_CaSData00 "Signaltabelle mit den erfassten Nockenwellensegmenten" UBYTE OneToOne 1 100 0.00 255.0 ECU_ADDRESS 0xD00058A2 /end MEASUREMENT
/begin MEASUREMENT EpmSyn_CaSData01 "Signaltabelle mit den erfassten Nockenwellensegmenten" UBYTE OneToOne 1 100 0.00 255.0 ECU_ADDRESS 0xD00058A3 /end MEASUREMENT
/begin MEASUREMENT EpmSyn_CaSData02 "Signaltabelle mit den erfassten Nockenwellensegmenten" UBYTE OneToOne 1 100 0.00 255.0 ECU_ADDRESS 0xD00058A4 /end MEASUREMENT
/begin MEASUREMENT EpmSyn_CaSData03 "Signaltabelle mit den erfassten Nockenwellensegmenten" UBYTE OneToOne 1 100 0.00 255.0 ECU_ADDRESS 0xD00058A5 /end MEASUREMENT
/begin MEASUREMENT EpmSyn_CaSData04 "Signaltabelle mit den erfassten Nockenwellensegmenten" UBYTE OneToOne 1 100 0.00 255.0 ECU_ADDRESS 0xD00058A6 /end MEASUREMENT
/begin MEASUREMENT EpmSyn_CaSData05 "Signaltabelle mit den erfassten Nockenwellensegmenten" UBYTE OneToOne 1 100 0.00 255.0 ECU_ADDRESS 0xD00058A7 /end MEASUREMENT
/begin MEASUREMENT EpmSyn_CaSData06 "Signaltabelle mit den erfassten Nockenwellensegmenten" UBYTE OneToOne 1 100 0.00 255.0 ECU_ADDRESS 0xD00058A8 /end MEASUREMENT
/begin MEASUREMENT EpmSyn_CaSData07 "Signaltabelle mit den erfassten Nockenwellensegmenten" UBYTE OneToOne 1 100 0.00 255.0 ECU_ADDRESS 0xD00058A9 /end MEASUREMENT
/begin MEASUREMENT EpmSyn_CaSData08 "Signaltabelle mit den erfassten Nockenwellensegmenten" UBYTE OneToOne 1 100 0.00 255.0 ECU_ADDRESS 0xD00058AA /end MEASUREMENT
/begin MEASUREMENT EpmSyn_CaSData09 "Signaltabelle mit den erfassten Nockenwellensegmenten" UBYTE OneToOne 1 100 0.00 255.0 ECU_ADDRESS 0xD00058AB /end MEASUREMENT
/begin MEASUREMENT EpmSyn_CaSData10 "Signaltabelle mit den erfassten Nockenwellensegmenten" UBYTE OneToOne 1 100 0.00 255.0 ECU_ADDRESS 0xD00058AC /end MEASUREMENT
/begin MEASUREMENT EpmSyn_CaSData11 "Signaltabelle mit den erfassten Nockenwellensegmenten" UBYTE OneToOne 1 100 0.00 255.0 ECU_ADDRESS 0xD00058AD /end MEASUREMENT
/begin MEASUREMENT EpmSyn_CaSData12 "Signaltabelle mit den erfassten Nockenwellensegmenten" UBYTE OneToOne 1 100 0.00 255.0 ECU_ADDRESS 0xD00058AE /end MEASUREMENT
/begin MEASUREMENT EpmSyn_CaSData13 "Signaltabelle mit den erfassten Nockenwellensegmenten" UBYTE OneToOne 1 100 0.00 255.0 ECU_ADDRESS 0xD00058AF /end MEASUREMENT
/begin MEASUREMENT EpmSyn_CaSData14 "Signaltabelle mit den erfassten Nockenwellensegmenten" UBYTE OneToOne 1 100 0.00 255.0 ECU_ADDRESS 0xD00058B0 /end MEASUREMENT
/begin MEASUREMENT EpmSyn_CaSData15 "Signaltabelle mit den erfassten Nockenwellensegmenten" UBYTE OneToOne 1 100 0.00 255.0 ECU_ADDRESS 0xD00058B1 /end MEASUREMENT
/begin MEASUREMENT EpmSyn_ctEdgeEarly00 "Anzahl der tolerierten NW-Flanken, die zu früh kommen" UBYTE OneToOne 1 100 0.00 255.0 ECU_ADDRESS 0xC0007EBA /end MEASUREMENT
/begin MEASUREMENT EpmSyn_ctEdgeLate00 "Anzahl der tolerierten Nockenwellenflanken, die zu spät kommen" UBYTE OneToOne 1 100 0.00 255.0 ECU_ADDRESS 0xC0007EBB /end MEASUREMENT
/begin MEASUREMENT EpmSyn_EdgeFailType00 "Fehlerart beim Tolerieren von Nockenwellenstörungen" UBYTE EpmSyn_EdgeFailTypes 1 100 0.00 2.00000000000 FORMAT "%13.11" ECU_ADDRESS 0xC0007EB9 /end MEASUREMENT
/begin MEASUREMENT EpmSyn_numMatchPos00 "Position bei der EpmCas_dSegSeries_C mit dem erfassten Muster übereinstimmt" SBYTE OneToOne 1 100 -128.0 127.0 ECU_ADDRESS 0xC0007EB8 /end MEASUREMENT
/begin MEASUREMENT EpmSyn_phiCaSPos00 "Nockenwellenwinkel nach Mustererkennung" SWORD AngleCrS 1 100 -720.0000 719.9780 ECU_ADDRESS 0xD00058A0 /end MEASUREMENT
/begin MEASUREMENT EpmSyn_phiSegLenUncorr00 "unkorrigierte segmentlänge des toleranten Nockenwellenmustervergleichs" SLONG OneToOne 1 100 -2147483648.00 2147483647.00 ECU_ADDRESS 0xC0003700 /end MEASUREMENT
/begin MEASUREMENT EpmSyn_stCaSPos00 "Zustand der Nockenwellenposition" UBYTE EpmSyn_stCaSPosComp 1 100 0.00 20.0000000000 FORMAT "%13.10" ECU_ADDRESS 0xC0007EA2 /end MEASUREMENT
/begin MEASUREMENT EpmSyn_stRR00 "Zustand Rückdreherkennung durch Nockenwellenmustervergleich" UBYTE EpmSyn_stRRComp 1 100 0.00 1.00000000000 FORMAT "%13.11" ECU_ADDRESS 0xD0001DFF /end MEASUREMENT
/begin MEASUREMENT ESC_stSchdS0_mp00 "Messpunkt für einen Eintrag der S0-Interrupttabelle, der die Aktivierung des Containers anzeigt" UBYTE ESC_stSchdSx_CntnrNames_t 1 100 0.00 255.000000000 FORMAT "%13.9" ECU_ADDRESS 0xC000BBDC /end MEASUREMENT
/begin MEASUREMENT ESC_stSchdS0_mp01 "Messpunkt für einen Eintrag der S0-Interrupttabelle, der die Aktivierung des Containers anzeigt" UBYTE ESC_stSchdSx_CntnrNames_t 1 100 0.00 255.000000000 FORMAT "%13.9" ECU_ADDRESS 0xC000BBDD /end MEASUREMENT
/begin MEASUREMENT ESC_stSchdS0_mp02 "Messpunkt für einen Eintrag der S0-Interrupttabelle, der die Aktivierung des Containers anzeigt" UBYTE ESC_stSchdSx_CntnrNames_t 1 100 0.00 255.000000000 FORMAT "%13.9" ECU_ADDRESS 0xC000BBDE /end MEASUREMENT
/begin MEASUREMENT ESC_stSchdS0_mp03 "Messpunkt für einen Eintrag der S0-Interrupttabelle, der die Aktivierung des Containers anzeigt" UBYTE ESC_stSchdSx_CntnrNames_t 1 100 0.00 255.000000000 FORMAT "%13.9" ECU_ADDRESS 0xC000BBDF /end MEASUREMENT
/begin MEASUREMENT ESC_stSchdS0_mp04 "Messpunkt für einen Eintrag der S0-Interrupttabelle, der die Aktivierung des Containers anzeigt" UBYTE ESC_stSchdSx_CntnrNames_t 1 100 0.00 255.000000000 FORMAT "%13.9" ECU_ADDRESS 0xC000BBE0 /end MEASUREMENT
/begin MEASUREMENT ESC_stSchdS0_mp05 "Messpunkt für einen Eintrag der S0-Interrupttabelle, der die Aktivierung des Containers anzeigt" UBYTE ESC_stSchdSx_CntnrNames_t 1 100 0.00 255.000000000 FORMAT "%13.9" ECU_ADDRESS 0xC000BBE1 /end MEASUREMENT
/begin MEASUREMENT ESC_stSchdS0_mp06 "Messpunkt für einen Eintrag der S0-Interrupttabelle, der die Aktivierung des Containers anzeigt" UBYTE ESC_stSchdSx_CntnrNames_t 1 100 0.00 255.000000000 FORMAT "%13.9" ECU_ADDRESS 0xC000BBE2 /end MEASUREMENT
/begin MEASUREMENT ESC_stSchdS0_mp07 "Messpunkt für einen Eintrag der S0-Interrupttabelle, der die Aktivierung des Containers anzeigt" UBYTE ESC_stSchdSx_CntnrNames_t 1 100 0.00 255.000000000 FORMAT "%13.9" ECU_ADDRESS 0xC000BBE3 /end MEASUREMENT
/begin MEASUREMENT ESC_stSchdS0_mp08 "Messpunkt für einen Eintrag der S0-Interrupttabelle, der die Aktivierung des Containers anzeigt" UBYTE ESC_stSchdSx_CntnrNames_t 1 100 0.00 255.000000000 FORMAT "%13.9" ECU_ADDRESS 0xC000BBE4 /end MEASUREMENT
/begin MEASUREMENT ESC_stSchdS0_mp09 "Messpunkt für einen Eintrag der S0-Interrupttabelle, der die Aktivierung des Containers anzeigt" UBYTE ESC_stSchdSx_CntnrNames_t 1 100 0.00 255.000000000 FORMAT "%13.9" ECU_ADDRESS 0xC000BBE5 /end MEASUREMENT
/begin MEASUREMENT ESC_stSchdS0_mp10 "Messpunkt für einen Eintrag der S0-Interrupttabelle, der die Aktivierung des Containers anzeigt" UBYTE ESC_stSchdSx_CntnrNames_t 1 100 0.00 255.000000000 FORMAT "%13.9" ECU_ADDRESS 0xC000BBE6 /end MEASUREMENT
/begin MEASUREMENT ESC_stSchdS0_mp11 "Messpunkt für einen Eintrag der S0-Interrupttabelle, der die Aktivierung des Containers anzeigt" UBYTE ESC_stSchdSx_CntnrNames_t 1 100 0.00 255.000000000 FORMAT "%13.9" ECU_ADDRESS 0xC000BBE7 /end MEASUREMENT
/begin MEASUREMENT ESC_stSchdS0_mp12 "Messpunkt für einen Eintrag der S0-Interrupttabelle, der die Aktivierung des Containers anzeigt" UBYTE ESC_stSchdSx_CntnrNames_t 1 100 0.00 255.000000000 FORMAT "%13.9" ECU_ADDRESS 0xC000BBE8 /end MEASUREMENT
/begin MEASUREMENT ESC_stSchdS0_mp13 "Messpunkt für einen Eintrag der S0-Interrupttabelle, der die Aktivierung des Containers anzeigt" UBYTE ESC_stSchdSx_CntnrNames_t 1 100 0.00 255.000000000 FORMAT "%13.9" ECU_ADDRESS 0xC000BBE9 /end MEASUREMENT
/begin MEASUREMENT ESC_stSchdS0_mp14 "Messpunkt für einen Eintrag der S0-Interrupttabelle, der die Aktivierung des Containers anzeigt" UBYTE ESC_stSchdSx_CntnrNames_t 1 100 0.00 255.000000000 FORMAT "%13.9" ECU_ADDRESS 0xC000BBEA /end MEASUREMENT
/begin MEASUREMENT ESC_stSchdS0_mp15 "Messpunkt für einen Eintrag der S0-Interrupttabelle, der die Aktivierung des Containers anzeigt" UBYTE ESC_stSchdSx_CntnrNames_t 1 100 0.00 255.000000000 FORMAT "%13.9" ECU_ADDRESS 0xC000BBEB /end MEASUREMENT
/begin MEASUREMENT ESC_stSchdS1_mp00 "Messpunkt für einen Eintrag der S1-Interrupttabelle, der die Aktivierung des Containers anzeigt" UBYTE ESC_stSchdSx_CntnrNames_t 1 100 0.00 255.000000000 FORMAT "%13.9" ECU_ADDRESS 0xC000BBEC /end MEASUREMENT
/begin MEASUREMENT ESC_stSchdS1_mp01 "Messpunkt für einen Eintrag der S1-Interrupttabelle, der die Aktivierung des Containers anzeigt" UBYTE ESC_stSchdSx_CntnrNames_t 1 100 0.00 255.000000000 FORMAT "%13.9" ECU_ADDRESS 0xC000BBED /end MEASUREMENT
/begin MEASUREMENT ESC_stSchdS1_mp02 "Messpunkt für einen Eintrag der S1-Interrupttabelle, der die Aktivierung des Containers anzeigt" UBYTE ESC_stSchdSx_CntnrNames_t 1 100 0.00 255.000000000 FORMAT "%13.9" ECU_ADDRESS 0xC000BBEE /end MEASUREMENT
/begin MEASUREMENT ESC_stSchdS1_mp03 "Messpunkt für einen Eintrag der S1-Interrupttabelle, der die Aktivierung des Containers anzeigt" UBYTE ESC_stSchdSx_CntnrNames_t 1 100 0.00 255.000000000 FORMAT "%13.9" ECU_ADDRESS 0xC000BBEF /end MEASUREMENT
/begin MEASUREMENT ESC_stSchdS1_mp04 "Messpunkt für einen Eintrag der S1-Interrupttabelle, der die Aktivierung des Containers anzeigt" UBYTE ESC_stSchdSx_CntnrNames_t 1 100 0.00 255.000000000 FORMAT "%13.9" ECU_ADDRESS 0xC000BBF0 /end MEASUREMENT
/begin MEASUREMENT ESC_stSchdS1_mp05 "Messpunkt für einen Eintrag der S1-Interrupttabelle, der die Aktivierung des Containers anzeigt" UBYTE ESC_stSchdSx_CntnrNames_t 1 100 0.00 255.000000000 FORMAT "%13.9" ECU_ADDRESS 0xC000BBF1 /end MEASUREMENT
/begin MEASUREMENT ESC_stSchdS1_mp06 "Messpunkt für einen Eintrag der S1-Interrupttabelle, der die Aktivierung des Containers anzeigt" UBYTE ESC_stSchdSx_CntnrNames_t 1 100 0.00 255.000000000 FORMAT "%13.9" ECU_ADDRESS 0xC000BBF2 /end MEASUREMENT
/begin MEASUREMENT ESC_stSchdS1_mp07 "Messpunkt für einen Eintrag der S1-Interrupttabelle, der die Aktivierung des Containers anzeigt" UBYTE ESC_stSchdSx_CntnrNames_t 1 100 0.00 255.000000000 FORMAT "%13.9" ECU_ADDRESS 0xC000BBF3 /end MEASUREMENT
/begin MEASUREMENT ESC_stSchdS1_mp08 "Messpunkt für einen Eintrag der S1-Interrupttabelle, der die Aktivierung des Containers anzeigt" UBYTE ESC_stSchdSx_CntnrNames_t 1 100 0.00 255.000000000 FORMAT "%13.9" ECU_ADDRESS 0xC000BBF4 /end MEASUREMENT
/begin MEASUREMENT ESC_stSchdS1_mp09 "Messpunkt für einen Eintrag der S1-Interrupttabelle, der die Aktivierung des Containers anzeigt" UBYTE ESC_stSchdSx_CntnrNames_t 1 100 0.00 255.000000000 FORMAT "%13.9" ECU_ADDRESS 0xC000BBF5 /end MEASUREMENT
/begin MEASUREMENT ESC_stSchdS1_mp10 "Messpunkt für einen Eintrag der S1-Interrupttabelle, der die Aktivierung des Containers anzeigt" UBYTE ESC_stSchdSx_CntnrNames_t 1 100 0.00 255.000000000 FORMAT "%13.9" ECU_ADDRESS 0xC000BBF6 /end MEASUREMENT
/begin MEASUREMENT ESC_stSchdS1_mp11 "Messpunkt für einen Eintrag der S1-Interrupttabelle, der die Aktivierung des Containers anzeigt" UBYTE ESC_stSchdSx_CntnrNames_t 1 100 0.00 255.000000000 FORMAT "%13.9" ECU_ADDRESS 0xC000BBF7 /end MEASUREMENT
/begin MEASUREMENT ESC_stSchdS1_mp12 "Messpunkt für einen Eintrag der S1-Interrupttabelle, der die Aktivierung des Containers anzeigt" UBYTE ESC_stSchdSx_CntnrNames_t 1 100 0.00 255.000000000 FORMAT "%13.9" ECU_ADDRESS 0xC000BBF8 /end MEASUREMENT
/begin MEASUREMENT ESC_stSchdS1_mp13 "Messpunkt für einen Eintrag der S1-Interrupttabelle, der die Aktivierung des Containers anzeigt" UBYTE ESC_stSchdSx_CntnrNames_t 1 100 0.00 255.000000000 FORMAT "%13.9" ECU_ADDRESS 0xC000BBF9 /end MEASUREMENT
/begin MEASUREMENT ESC_stSchdS1_mp14 "Messpunkt für einen Eintrag der S1-Interrupttabelle, der die Aktivierung des Containers anzeigt" UBYTE ESC_stSchdSx_CntnrNames_t 1 100 0.00 255.000000000 FORMAT "%13.9" ECU_ADDRESS 0xC000BBFA /end MEASUREMENT
/begin MEASUREMENT ESC_stSchdS1_mp15 "Messpunkt für einen Eintrag der S1-Interrupttabelle, der die Aktivierung des Containers anzeigt" UBYTE ESC_stSchdSx_CntnrNames_t 1 100 0.00 255.000000000 FORMAT "%13.9" ECU_ADDRESS 0xC000BBFB /end MEASUREMENT
/begin MEASUREMENT ETClb_ctLrnCyclAllw_mp00 "Anzahl der erlaubten Lernzyklen für jeden Raildruckkalibrierpunkt" UBYTE OneToOne 1 100 0.00 255.0 ECU_ADDRESS 0xC000BC69 /end MEASUREMENT
/begin MEASUREMENT ETClb_ctLrnCyclAllw_mp01 "Anzahl der erlaubten Lernzyklen für jeden Raildruckkalibrierpunkt" UBYTE OneToOne 1 100 0.00 255.0 ECU_ADDRESS 0xC000BC6A /end MEASUREMENT
/begin MEASUREMENT ETClb_ctLrnCyclAllw_mp02 "Anzahl der erlaubten Lernzyklen für jeden Raildruckkalibrierpunkt" UBYTE OneToOne 1 100 0.00 255.0 ECU_ADDRESS 0xC000BC6B /end MEASUREMENT
/begin MEASUREMENT ETClb_ctLrn_mp00 "Lernzykluszähler für jeden Raildruck-Kalibrierpunkt der Ansteuerdauerkalibrierung" UWORD OneToOne 1 100 0.00 65535.00 ECU_ADDRESS 0xC000BC2A /end MEASUREMENT
/begin MEASUREMENT ETClb_ctLrn_mp01 "Lernzykluszähler für jeden Raildruck-Kalibrierpunkt der Ansteuerdauerkalibrierung" UWORD OneToOne 1 100 0.00 65535.00 ECU_ADDRESS 0xC000BC2C /end MEASUREMENT
/begin MEASUREMENT ETClb_ctLrn_mp02 "Lernzykluszähler für jeden Raildruck-Kalibrierpunkt der Ansteuerdauerkalibrierung" UWORD OneToOne 1 100 0.00 65535.00 ECU_ADDRESS 0xC000BC2E /end MEASUREMENT
/begin MEASUREMENT ETClb_dtiETFlt0_mp00 "Gefilterte Ansteuerdauerdifferenz der Ansteuerdauerkalibrierung für jeden Zylinder beim Raildruck-Kalibrierpunkt 0" SWORD InjTime_us 1 100 -13107.20 5000.00 ECU_ADDRESS 0xC000BC30 /end MEASUREMENT
/begin MEASUREMENT ETClb_dtiETFlt0_mp01 "Gefilterte Ansteuerdauerdifferenz der Ansteuerdauerkalibrierung für jeden Zylinder beim Raildruck-Kalibrierpunkt 0" SWORD InjTime_us 1 100 -13107.20 5000.00 ECU_ADDRESS 0xC000BC32 /end MEASUREMENT
/begin MEASUREMENT ETClb_dtiETFlt0_mp02 "Gefilterte Ansteuerdauerdifferenz der Ansteuerdauerkalibrierung für jeden Zylinder beim Raildruck-Kalibrierpunkt 0" SWORD InjTime_us 1 100 -13107.20 5000.00 ECU_ADDRESS 0xC000BC34 /end MEASUREMENT
/begin MEASUREMENT ETClb_dtiETFlt0_mp03 "Gefilterte Ansteuerdauerdifferenz der Ansteuerdauerkalibrierung für jeden Zylinder beim Raildruck-Kalibrierpunkt 0" SWORD InjTime_us 1 100 -13107.20 5000.00 ECU_ADDRESS 0xC000BC36 /end MEASUREMENT
/begin MEASUREMENT ETClb_dtiETFlt0_mp04 "Gefilterte Ansteuerdauerdifferenz der Ansteuerdauerkalibrierung für jeden Zylinder beim Raildruck-Kalibrierpunkt 0" SWORD InjTime_us 1 100 -13107.20 5000.00 ECU_ADDRESS 0xC000BC38 /end MEASUREMENT
/begin MEASUREMENT ETClb_dtiETFlt0_mp05 "Gefilterte Ansteuerdauerdifferenz der Ansteuerdauerkalibrierung für jeden Zylinder beim Raildruck-Kalibrierpunkt 0" SWORD InjTime_us 1 100 -13107.20 5000.00 ECU_ADDRESS 0xC000BC3A /end MEASUREMENT
/begin MEASUREMENT ETClb_dtiETFlt1_mp00 "Gefilterte Ansteuerdauerdifferenz der Ansteuerdauerkalibrierung für jeden Zylinder beim Raildruck-Kalibrierpunkt 1" SWORD InjTime_us 1 100 -13107.20 5000.00 ECU_ADDRESS 0xC000BC3C /end MEASUREMENT
/begin MEASUREMENT ETClb_dtiETFlt1_mp01 "Gefilterte Ansteuerdauerdifferenz der Ansteuerdauerkalibrierung für jeden Zylinder beim Raildruck-Kalibrierpunkt 1" SWORD InjTime_us 1 100 -13107.20 5000.00 ECU_ADDRESS 0xC000BC3E /end MEASUREMENT
/begin MEASUREMENT ETClb_dtiETFlt1_mp02 "Gefilterte Ansteuerdauerdifferenz der Ansteuerdauerkalibrierung für jeden Zylinder beim Raildruck-Kalibrierpunkt 1" SWORD InjTime_us 1 100 -13107.20 5000.00 ECU_ADDRESS 0xC000BC40 /end MEASUREMENT
/begin MEASUREMENT ETClb_dtiETFlt1_mp03 "Gefilterte Ansteuerdauerdifferenz der Ansteuerdauerkalibrierung für jeden Zylinder beim Raildruck-Kalibrierpunkt 1" SWORD InjTime_us 1 100 -13107.20 5000.00 ECU_ADDRESS 0xC000BC42 /end MEASUREMENT
/begin MEASUREMENT ETClb_dtiETFlt1_mp04 "Gefilterte Ansteuerdauerdifferenz der Ansteuerdauerkalibrierung für jeden Zylinder beim Raildruck-Kalibrierpunkt 1" SWORD InjTime_us 1 100 -13107.20 5000.00 ECU_ADDRESS 0xC000BC44 /end MEASUREMENT
/begin MEASUREMENT ETClb_dtiETFlt1_mp05 "Gefilterte Ansteuerdauerdifferenz der Ansteuerdauerkalibrierung für jeden Zylinder beim Raildruck-Kalibrierpunkt 1" SWORD InjTime_us 1 100 -13107.20 5000.00 ECU_ADDRESS 0xC000BC46 /end MEASUREMENT
/begin MEASUREMENT ETClb_dtiETFlt2_mp00 "Gefilterte Ansteuerdauerdifferenz der Ansteuerdauerkalibrierung für jeden Zylinder beim Raildruck-Kalibrierpunkt 2" SWORD InjTime_us 1 100 -13107.20 5000.00 ECU_ADDRESS 0xC000BC48 /end MEASUREMENT
/begin MEASUREMENT ETClb_dtiETFlt2_mp01 "Gefilterte Ansteuerdauerdifferenz der Ansteuerdauerkalibrierung für jeden Zylinder beim Raildruck-Kalibrierpunkt 2" SWORD InjTime_us 1 100 -13107.20 5000.00 ECU_ADDRESS 0xC000BC4A /end MEASUREMENT
/begin MEASUREMENT ETClb_dtiETFlt2_mp02 "Gefilterte Ansteuerdauerdifferenz der Ansteuerdauerkalibrierung für jeden Zylinder beim Raildruck-Kalibrierpunkt 2" SWORD InjTime_us 1 100 -13107.20 5000.00 ECU_ADDRESS 0xC000BC4C /end MEASUREMENT
/begin MEASUREMENT ETClb_dtiETFlt2_mp03 "Gefilterte Ansteuerdauerdifferenz der Ansteuerdauerkalibrierung für jeden Zylinder beim Raildruck-Kalibrierpunkt 2" SWORD InjTime_us 1 100 -13107.20 5000.00 ECU_ADDRESS 0xC000BC4E /end MEASUREMENT
/begin MEASUREMENT ETClb_dtiETFlt2_mp04 "Gefilterte Ansteuerdauerdifferenz der Ansteuerdauerkalibrierung für jeden Zylinder beim Raildruck-Kalibrierpunkt 2" SWORD InjTime_us 1 100 -13107.20 5000.00 ECU_ADDRESS 0xC000BC50 /end MEASUREMENT
/begin MEASUREMENT ETClb_dtiETFlt2_mp05 "Gefilterte Ansteuerdauerdifferenz der Ansteuerdauerkalibrierung für jeden Zylinder beim Raildruck-Kalibrierpunkt 2" SWORD InjTime_us 1 100 -13107.20 5000.00 ECU_ADDRESS 0xC000BC52 /end MEASUREMENT
/begin MEASUREMENT ETClb_numCylCur_mp00 "Aktueller Zylinder für die Ansteuerdauerkalibrierung bei jedem Raildruck-Kalibrierpunkt" UBYTE OneToOne 1 100 0.00 255.0 ECU_ADDRESS 0xC000BBFC /end MEASUREMENT
/begin MEASUREMENT ETClb_numCylCur_mp01 "Aktueller Zylinder für die Ansteuerdauerkalibrierung bei jedem Raildruck-Kalibrierpunkt" UBYTE OneToOne 1 100 0.00 255.0 ECU_ADDRESS 0xC000BBFD /end MEASUREMENT
/begin MEASUREMENT ETClb_numCylCur_mp02 "Aktueller Zylinder für die Ansteuerdauerkalibrierung bei jedem Raildruck-Kalibrierpunkt" UBYTE OneToOne 1 100 0.00 255.0 ECU_ADDRESS 0xC000BBFE /end MEASUREMENT
/begin MEASUREMENT ETClb_pRailSet00 "Zustand der Ansteuerdauerkalibrierung" SWORD OneToOne 1 100 -32768.00 32767.00 ECU_ADDRESS 0xD0000938 /end MEASUREMENT
/begin MEASUREMENT ETClb_pRailSet01 "Zustand der Ansteuerdauerkalibrierung" SWORD OneToOne 1 100 -32768.00 32767.00 ECU_ADDRESS 0xD000093A /end MEASUREMENT
/begin MEASUREMENT ETClb_pRailSet02 "Zustand der Ansteuerdauerkalibrierung" SWORD OneToOne 1 100 -32768.00 32767.00 ECU_ADDRESS 0xD000093C /end MEASUREMENT
/begin MEASUREMENT ETClb_stEval_mp00 "Zustand des Zustandsautomaten zur Auswertung der Ansteuerdauerkalibrierung" UBYTE ETClb_Eval_State 1 100 0.00 2.00000000000 FORMAT "%13.11" ECU_ADDRESS 0xC000BC5A /end MEASUREMENT
/begin MEASUREMENT ETClb_stEval_mp01 "Zustand des Zustandsautomaten zur Auswertung der Ansteuerdauerkalibrierung" UBYTE ETClb_Eval_State 1 100 0.00 2.00000000000 FORMAT "%13.11" ECU_ADDRESS 0xC000BC5B /end MEASUREMENT
/begin MEASUREMENT ETClb_stEval_mp02 "Zustand des Zustandsautomaten zur Auswertung der Ansteuerdauerkalibrierung" UBYTE ETClb_Eval_State 1 100 0.00 2.00000000000 FORMAT "%13.11" ECU_ADDRESS 0xC000BC5C /end MEASUREMENT
/begin MEASUREMENT ETClb_stRailpClbPntMaxErr_mp00 "Ergebnis der Ansteuerdauerkalibrierungs-Einspritzungen" UBYTE OneToOne 1 100 0.00 255.0 ECU_ADDRESS 0xC000BC5D /end MEASUREMENT
/begin MEASUREMENT ETClb_stRailpClbPntMaxErr_mp01 "Ergebnis der Ansteuerdauerkalibrierungs-Einspritzungen" UBYTE OneToOne 1 100 0.00 255.0 ECU_ADDRESS 0xC000BC5E /end MEASUREMENT
/begin MEASUREMENT ETClb_stRailpClbPntMaxErr_mp02 "Ergebnis der Ansteuerdauerkalibrierungs-Einspritzungen" UBYTE OneToOne 1 100 0.00 255.0 ECU_ADDRESS 0xC000BC5F /end MEASUREMENT
/begin MEASUREMENT ETClb_stRailpClbPntMaxErr_mp03 "Ergebnis der Ansteuerdauerkalibrierungs-Einspritzungen" UBYTE OneToOne 1 100 0.00 255.0 ECU_ADDRESS 0xC000BC60 /end MEASUREMENT
/begin MEASUREMENT ETClb_stRailpClbPntMaxErr_mp04 "Ergebnis der Ansteuerdauerkalibrierungs-Einspritzungen" UBYTE OneToOne 1 100 0.00 255.0 ECU_ADDRESS 0xC000BC61 /end MEASUREMENT
/begin MEASUREMENT ETClb_stRailpClbPntMaxErr_mp05 "Ergebnis der Ansteuerdauerkalibrierungs-Einspritzungen" UBYTE OneToOne 1 100 0.00 255.0 ECU_ADDRESS 0xC000BC62 /end MEASUREMENT
/begin MEASUREMENT ETClb_stRailpClbPntMinErr_mp00 "Ergebnis der Ansteuerdauerkalibrierungs-Einspritzungen" UBYTE OneToOne 1 100 0.00 255.0 ECU_ADDRESS 0xC000BC63 /end MEASUREMENT
/begin MEASUREMENT ETClb_stRailpClbPntMinErr_mp01 "Ergebnis der Ansteuerdauerkalibrierungs-Einspritzungen" UBYTE OneToOne 1 100 0.00 255.0 ECU_ADDRESS 0xC000BC64 /end MEASUREMENT
/begin MEASUREMENT ETClb_stRailpClbPntMinErr_mp02 "Ergebnis der Ansteuerdauerkalibrierungs-Einspritzungen" UBYTE OneToOne 1 100 0.00 255.0 ECU_ADDRESS 0xC000BC65 /end MEASUREMENT
/begin MEASUREMENT ETClb_stRailpClbPntMinErr_mp03 "Ergebnis der Ansteuerdauerkalibrierungs-Einspritzungen" UBYTE OneToOne 1 100 0.00 255.0 ECU_ADDRESS 0xC000BC66 /end MEASUREMENT
/begin MEASUREMENT ETClb_stRailpClbPntMinErr_mp04 "Ergebnis der Ansteuerdauerkalibrierungs-Einspritzungen" UBYTE OneToOne 1 100 0.00 255.0 ECU_ADDRESS 0xC000BC67 /end MEASUREMENT
/begin MEASUREMENT ETClb_stRailpClbPntMinErr_mp05 "Ergebnis der Ansteuerdauerkalibrierungs-Einspritzungen" UBYTE OneToOne 1 100 0.00 255.0 ECU_ADDRESS 0xC000BC68 /end MEASUREMENT
/begin MEASUREMENT ETClb_tiETAvrg00 "Zustand der Ansteuerdauerkalibrierung" SWORD OneToOne 1 100 -32768.00 32767.00 ECU_ADDRESS 0xD0000944 /end MEASUREMENT
/begin MEASUREMENT ETClb_tiETAvrg01 "Zustand der Ansteuerdauerkalibrierung" SWORD OneToOne 1 100 -32768.00 32767.00 ECU_ADDRESS 0xD0000946 /end MEASUREMENT
/begin MEASUREMENT ETClb_tiETAvrg02 "Zustand der Ansteuerdauerkalibrierung" SWORD OneToOne 1 100 -32768.00 32767.00 ECU_ADDRESS 0xD0000948 /end MEASUREMENT
/begin MEASUREMENT ETClb_tiETChkCor0_mp00 "Ansteuerdauer der Nullmenge der ZFC nach Korrektur durch die IMA für Raildruck-Kalibrierpunkt 0" SWORD InjTime_us 1 100 -13107.20 5000.00 ECU_ADDRESS 0xC000BC6C /end MEASUREMENT
/begin MEASUREMENT ETClb_tiETChkCor0_mp01 "Ansteuerdauer der Nullmenge der ZFC nach Korrektur durch die IMA für Raildruck-Kalibrierpunkt 0" SWORD InjTime_us 1 100 -13107.20 5000.00 ECU_ADDRESS 0xC000BC6E /end MEASUREMENT
/begin MEASUREMENT ETClb_tiETChkCor0_mp02 "Ansteuerdauer der Nullmenge der ZFC nach Korrektur durch die IMA für Raildruck-Kalibrierpunkt 0" SWORD InjTime_us 1 100 -13107.20 5000.00 ECU_ADDRESS 0xC000BC70 /end MEASUREMENT
/begin MEASUREMENT ETClb_tiETChkCor0_mp03 "Ansteuerdauer der Nullmenge der ZFC nach Korrektur durch die IMA für Raildruck-Kalibrierpunkt 0" SWORD InjTime_us 1 100 -13107.20 5000.00 ECU_ADDRESS 0xC000BC72 /end MEASUREMENT
/begin MEASUREMENT ETClb_tiETChkCor0_mp04 "Ansteuerdauer der Nullmenge der ZFC nach Korrektur durch die IMA für Raildruck-Kalibrierpunkt 0" SWORD InjTime_us 1 100 -13107.20 5000.00 ECU_ADDRESS 0xC000BC74 /end MEASUREMENT
/begin MEASUREMENT ETClb_tiETChkCor0_mp05 "Ansteuerdauer der Nullmenge der ZFC nach Korrektur durch die IMA für Raildruck-Kalibrierpunkt 0" SWORD InjTime_us 1 100 -13107.20 5000.00 ECU_ADDRESS 0xC000BC76 /end MEASUREMENT
/begin MEASUREMENT ETClb_tiETChkCor1_mp00 "Ansteuerdauer der Nullmenge der ZFC nach Korrektur durch die IMA für Raildruck-Kalibrierpunkt 1" SWORD InjTime_us 1 100 -13107.20 5000.00 ECU_ADDRESS 0xC000BC78 /end MEASUREMENT
/begin MEASUREMENT ETClb_tiETChkCor1_mp01 "Ansteuerdauer der Nullmenge der ZFC nach Korrektur durch die IMA für Raildruck-Kalibrierpunkt 1" SWORD InjTime_us 1 100 -13107.20 5000.00 ECU_ADDRESS 0xC000BC7A /end MEASUREMENT
/begin MEASUREMENT ETClb_tiETChkCor1_mp02 "Ansteuerdauer der Nullmenge der ZFC nach Korrektur durch die IMA für Raildruck-Kalibrierpunkt 1" SWORD InjTime_us 1 100 -13107.20 5000.00 ECU_ADDRESS 0xC000BC7C /end MEASUREMENT
/begin MEASUREMENT ETClb_tiETChkCor1_mp03 "Ansteuerdauer der Nullmenge der ZFC nach Korrektur durch die IMA für Raildruck-Kalibrierpunkt 1" SWORD InjTime_us 1 100 -13107.20 5000.00 ECU_ADDRESS 0xC000BC7E /end MEASUREMENT
/begin MEASUREMENT ETClb_tiETChkCor1_mp04 "Ansteuerdauer der Nullmenge der ZFC nach Korrektur durch die IMA für Raildruck-Kalibrierpunkt 1" SWORD InjTime_us 1 100 -13107.20 5000.00 ECU_ADDRESS 0xC000BC80 /end MEASUREMENT
/begin MEASUREMENT ETClb_tiETChkCor1_mp05 "Ansteuerdauer der Nullmenge der ZFC nach Korrektur durch die IMA für Raildruck-Kalibrierpunkt 1" SWORD InjTime_us 1 100 -13107.20 5000.00 ECU_ADDRESS 0xC000BC82 /end MEASUREMENT
/begin MEASUREMENT ETClb_tiETChkCor2_mp00 "Ansteuerdauer der Nullmenge der ZFC nach Korrektur durch die IMA für Raildruck-Kalibrierpunkt 0" SWORD InjTime_us 1 100 -13107.20 5000.00 ECU_ADDRESS 0xC000BC84 /end MEASUREMENT
/begin MEASUREMENT ETClb_tiETChkCor2_mp01 "Ansteuerdauer der Nullmenge der ZFC nach Korrektur durch die IMA für Raildruck-Kalibrierpunkt 0" SWORD InjTime_us 1 100 -13107.20 5000.00 ECU_ADDRESS 0xC000BC86 /end MEASUREMENT
/begin MEASUREMENT ETClb_tiETChkCor2_mp02 "Ansteuerdauer der Nullmenge der ZFC nach Korrektur durch die IMA für Raildruck-Kalibrierpunkt 0" SWORD InjTime_us 1 100 -13107.20 5000.00 ECU_ADDRESS 0xC000BC88 /end MEASUREMENT
/begin MEASUREMENT ETClb_tiETChkCor2_mp03 "Ansteuerdauer der Nullmenge der ZFC nach Korrektur durch die IMA für Raildruck-Kalibrierpunkt 0" SWORD InjTime_us 1 100 -13107.20 5000.00 ECU_ADDRESS 0xC000BC8A /end MEASUREMENT
/begin MEASUREMENT ETClb_tiETChkCor2_mp04 "Ansteuerdauer der Nullmenge der ZFC nach Korrektur durch die IMA für Raildruck-Kalibrierpunkt 0" SWORD InjTime_us 1 100 -13107.20 5000.00 ECU_ADDRESS 0xC000BC8C /end MEASUREMENT
/begin MEASUREMENT ETClb_tiETChkCor2_mp05 "Ansteuerdauer der Nullmenge der ZFC nach Korrektur durch die IMA für Raildruck-Kalibrierpunkt 0" SWORD InjTime_us 1 100 -13107.20 5000.00 ECU_ADDRESS 0xC000BC8E /end MEASUREMENT
/begin MEASUREMENT ETClb_tiETChkCor3_mp00 "Ansteuerdauer der Nullmenge der ZFC nach Korrektur durch die IMA für Raildruck-Kalibrierpunkt 3" SWORD InjTime_us 1 100 -13107.20 5000.00 ECU_ADDRESS 0xC000BC90 /end MEASUREMENT
/begin MEASUREMENT ETClb_tiETChkCor3_mp01 "Ansteuerdauer der Nullmenge der ZFC nach Korrektur durch die IMA für Raildruck-Kalibrierpunkt 3" SWORD InjTime_us 1 100 -13107.20 5000.00 ECU_ADDRESS 0xC000BC92 /end MEASUREMENT
/begin MEASUREMENT ETClb_tiETChkCor3_mp02 "Ansteuerdauer der Nullmenge der ZFC nach Korrektur durch die IMA für Raildruck-Kalibrierpunkt 3" SWORD InjTime_us 1 100 -13107.20 5000.00 ECU_ADDRESS 0xC000BC94 /end MEASUREMENT
/begin MEASUREMENT ETClb_tiETChkCor3_mp03 "Ansteuerdauer der Nullmenge der ZFC nach Korrektur durch die IMA für Raildruck-Kalibrierpunkt 3" SWORD InjTime_us 1 100 -13107.20 5000.00 ECU_ADDRESS 0xC000BC96 /end MEASUREMENT
/begin MEASUREMENT ETClb_tiETChkCor3_mp04 "Ansteuerdauer der Nullmenge der ZFC nach Korrektur durch die IMA für Raildruck-Kalibrierpunkt 3" SWORD InjTime_us 1 100 -13107.20 5000.00 ECU_ADDRESS 0xC000BC98 /end MEASUREMENT
/begin MEASUREMENT ETClb_tiETChkCor3_mp05 "Ansteuerdauer der Nullmenge der ZFC nach Korrektur durch die IMA für Raildruck-Kalibrierpunkt 3" SWORD InjTime_us 1 100 -13107.20 5000.00 ECU_ADDRESS 0xC000BC9A /end MEASUREMENT
/begin MEASUREMENT ETClb_tiETChkCor4_mp00 "Ansteuerdauer der Nullmenge der ZFC nach Korrektur durch die IMA für Raildruck-Kalibrierpunkt 4" SWORD InjTime_us 1 100 -13107.20 5000.00 ECU_ADDRESS 0xC000BC9C /end MEASUREMENT
/begin MEASUREMENT ETClb_tiETChkCor4_mp01 "Ansteuerdauer der Nullmenge der ZFC nach Korrektur durch die IMA für Raildruck-Kalibrierpunkt 4" SWORD InjTime_us 1 100 -13107.20 5000.00 ECU_ADDRESS 0xC000BC9E /end MEASUREMENT
/begin MEASUREMENT ETClb_tiETChkCor4_mp02 "Ansteuerdauer der Nullmenge der ZFC nach Korrektur durch die IMA für Raildruck-Kalibrierpunkt 4" SWORD InjTime_us 1 100 -13107.20 5000.00 ECU_ADDRESS 0xC000BCA0 /end MEASUREMENT
/begin MEASUREMENT ETClb_tiETChkCor4_mp03 "Ansteuerdauer der Nullmenge der ZFC nach Korrektur durch die IMA für Raildruck-Kalibrierpunkt 4" SWORD InjTime_us 1 100 -13107.20 5000.00 ECU_ADDRESS 0xC000BCA2 /end MEASUREMENT
/begin MEASUREMENT ETClb_tiETChkCor4_mp04 "Ansteuerdauer der Nullmenge der ZFC nach Korrektur durch die IMA für Raildruck-Kalibrierpunkt 4" SWORD InjTime_us 1 100 -13107.20 5000.00 ECU_ADDRESS 0xC000BCA4 /end MEASUREMENT
/begin MEASUREMENT ETClb_tiETChkCor4_mp05 "Ansteuerdauer der Nullmenge der ZFC nach Korrektur durch die IMA für Raildruck-Kalibrierpunkt 4" SWORD InjTime_us 1 100 -13107.20 5000.00 ECU_ADDRESS 0xC000BCA6 /end MEASUREMENT
/begin MEASUREMENT ETClb_tiETChkCor5_mp00 "Ansteuerdauer der Nullmenge der ZFC nach Korrektur durch die IMA für Raildruck-Kalibrierpunkt 5" SWORD InjTime_us 1 100 -13107.20 5000.00 ECU_ADDRESS 0xC000BCA8 /end MEASUREMENT
/begin MEASUREMENT ETClb_tiETChkCor5_mp01 "Ansteuerdauer der Nullmenge der ZFC nach Korrektur durch die IMA für Raildruck-Kalibrierpunkt 5" SWORD InjTime_us 1 100 -13107.20 5000.00 ECU_ADDRESS 0xC000BCAA /end MEASUREMENT
/begin MEASUREMENT ETClb_tiETChkCor5_mp02 "Ansteuerdauer der Nullmenge der ZFC nach Korrektur durch die IMA für Raildruck-Kalibrierpunkt 5" SWORD InjTime_us 1 100 -13107.20 5000.00 ECU_ADDRESS 0xC000BCAC /end MEASUREMENT
/begin MEASUREMENT ETClb_tiETChkCor5_mp03 "Ansteuerdauer der Nullmenge der ZFC nach Korrektur durch die IMA für Raildruck-Kalibrierpunkt 5" SWORD InjTime_us 1 100 -13107.20 5000.00 ECU_ADDRESS 0xC000BCAE /end MEASUREMENT
/begin MEASUREMENT ETClb_tiETChkCor5_mp04 "Ansteuerdauer der Nullmenge der ZFC nach Korrektur durch die IMA für Raildruck-Kalibrierpunkt 5" SWORD InjTime_us 1 100 -13107.20 5000.00 ECU_ADDRESS 0xC000BCB0 /end MEASUREMENT
/begin MEASUREMENT ETClb_tiETChkCor5_mp05 "Ansteuerdauer der Nullmenge der ZFC nach Korrektur durch die IMA für Raildruck-Kalibrierpunkt 5" SWORD InjTime_us 1 100 -13107.20 5000.00 ECU_ADDRESS 0xC000BCB2 /end MEASUREMENT
/begin MEASUREMENT ETClb_tiETChkCor6_mp00 "Ansteuerdauer der Nullmenge der ZFC nach Korrektur durch die IMA für Raildruck-Kalibrierpunkt 6" SWORD InjTime_us 1 100 -13107.20 5000.00 ECU_ADDRESS 0xC000BCB4 /end MEASUREMENT
/begin MEASUREMENT ETClb_tiETChkCor6_mp01 "Ansteuerdauer der Nullmenge der ZFC nach Korrektur durch die IMA für Raildruck-Kalibrierpunkt 6" SWORD InjTime_us 1 100 -13107.20 5000.00 ECU_ADDRESS 0xC000BCB6 /end MEASUREMENT
/begin MEASUREMENT ETClb_tiETChkCor6_mp02 "Ansteuerdauer der Nullmenge der ZFC nach Korrektur durch die IMA für Raildruck-Kalibrierpunkt 6" SWORD InjTime_us 1 100 -13107.20 5000.00 ECU_ADDRESS 0xC000BCB8 /end MEASUREMENT
/begin MEASUREMENT ETClb_tiETChkCor6_mp03 "Ansteuerdauer der Nullmenge der ZFC nach Korrektur durch die IMA für Raildruck-Kalibrierpunkt 6" SWORD InjTime_us 1 100 -13107.20 5000.00 ECU_ADDRESS 0xC000BCBA /end MEASUREMENT
/begin MEASUREMENT ETClb_tiETChkCor6_mp04 "Ansteuerdauer der Nullmenge der ZFC nach Korrektur durch die IMA für Raildruck-Kalibrierpunkt 6" SWORD InjTime_us 1 100 -13107.20 5000.00 ECU_ADDRESS 0xC000BCBC /end MEASUREMENT
/begin MEASUREMENT ETClb_tiETChkCor6_mp05 "Ansteuerdauer der Nullmenge der ZFC nach Korrektur durch die IMA für Raildruck-Kalibrierpunkt 6" SWORD InjTime_us 1 100 -13107.20 5000.00 ECU_ADDRESS 0xC000BCBE /end MEASUREMENT
/begin MEASUREMENT ETClb_tiETCor0_mp00 "Ansteuerdauerkorrekturwert der Ansteuerdauer-Kalibrierung für den Raildruck-Kalibrierpunkt 0" SWORD InjTime_us 1 100 -13107.20 5000.00 ECU_ADDRESS 0xC000BC00 /end MEASUREMENT
/begin MEASUREMENT ETClb_tiETCor0_mp01 "Ansteuerdauerkorrekturwert der Ansteuerdauer-Kalibrierung für den Raildruck-Kalibrierpunkt 0" SWORD InjTime_us 1 100 -13107.20 5000.00 ECU_ADDRESS 0xC000BC02 /end MEASUREMENT
/begin MEASUREMENT ETClb_tiETCor0_mp02 "Ansteuerdauerkorrekturwert der Ansteuerdauer-Kalibrierung für den Raildruck-Kalibrierpunkt 0" SWORD InjTime_us 1 100 -13107.20 5000.00 ECU_ADDRESS 0xC000BC04 /end MEASUREMENT
/begin MEASUREMENT ETClb_tiETCor0_mp03 "Ansteuerdauerkorrekturwert der Ansteuerdauer-Kalibrierung für den Raildruck-Kalibrierpunkt 0" SWORD InjTime_us 1 100 -13107.20 5000.00 ECU_ADDRESS 0xC000BC06 /end MEASUREMENT
/begin MEASUREMENT ETClb_tiETCor0_mp04 "Ansteuerdauerkorrekturwert der Ansteuerdauer-Kalibrierung für den Raildruck-Kalibrierpunkt 0" SWORD InjTime_us 1 100 -13107.20 5000.00 ECU_ADDRESS 0xC000BC08 /end MEASUREMENT
/begin MEASUREMENT ETClb_tiETCor0_mp05 "Ansteuerdauerkorrekturwert der Ansteuerdauer-Kalibrierung für den Raildruck-Kalibrierpunkt 0" SWORD InjTime_us 1 100 -13107.20 5000.00 ECU_ADDRESS 0xC000BC0A /end MEASUREMENT
/begin MEASUREMENT ETClb_tiETCor1_mp00 "Ansteuerdauerkorrekturwert der Ansteuerdauer-Kalibrierung für den Raildruck-Kalibrierpunkt 1" SWORD InjTime_us 1 100 -13107.20 5000.00 ECU_ADDRESS 0xC000BC0C /end MEASUREMENT
/begin MEASUREMENT ETClb_tiETCor1_mp01 "Ansteuerdauerkorrekturwert der Ansteuerdauer-Kalibrierung für den Raildruck-Kalibrierpunkt 1" SWORD InjTime_us 1 100 -13107.20 5000.00 ECU_ADDRESS 0xC000BC0E /end MEASUREMENT
/begin MEASUREMENT ETClb_tiETCor1_mp02 "Ansteuerdauerkorrekturwert der Ansteuerdauer-Kalibrierung für den Raildruck-Kalibrierpunkt 1" SWORD InjTime_us 1 100 -13107.20 5000.00 ECU_ADDRESS 0xC000BC10 /end MEASUREMENT
/begin MEASUREMENT ETClb_tiETCor1_mp03 "Ansteuerdauerkorrekturwert der Ansteuerdauer-Kalibrierung für den Raildruck-Kalibrierpunkt 1" SWORD InjTime_us 1 100 -13107.20 5000.00 ECU_ADDRESS 0xC000BC12 /end MEASUREMENT
/begin MEASUREMENT ETClb_tiETCor1_mp04 "Ansteuerdauerkorrekturwert der Ansteuerdauer-Kalibrierung für den Raildruck-Kalibrierpunkt 1" SWORD InjTime_us 1 100 -13107.20 5000.00 ECU_ADDRESS 0xC000BC14 /end MEASUREMENT
/begin MEASUREMENT ETClb_tiETCor1_mp05 "Ansteuerdauerkorrekturwert der Ansteuerdauer-Kalibrierung für den Raildruck-Kalibrierpunkt 1" SWORD InjTime_us 1 100 -13107.20 5000.00 ECU_ADDRESS 0xC000BC16 /end MEASUREMENT
/begin MEASUREMENT ETClb_tiETCor2_mp00 "Ansteuerdauerkorrekturwert der Ansteuerdauer-Kalibrierung für den Raildruck-Kalibrierpunkt 2" SWORD InjTime_us 1 100 -13107.20 5000.00 ECU_ADDRESS 0xC000BC18 /end MEASUREMENT
/begin MEASUREMENT ETClb_tiETCor2_mp01 "Ansteuerdauerkorrekturwert der Ansteuerdauer-Kalibrierung für den Raildruck-Kalibrierpunkt 2" SWORD InjTime_us 1 100 -13107.20 5000.00 ECU_ADDRESS 0xC000BC1A /end MEASUREMENT
/begin MEASUREMENT ETClb_tiETCor2_mp02 "Ansteuerdauerkorrekturwert der Ansteuerdauer-Kalibrierung für den Raildruck-Kalibrierpunkt 2" SWORD InjTime_us 1 100 -13107.20 5000.00 ECU_ADDRESS 0xC000BC1C /end MEASUREMENT
/begin MEASUREMENT ETClb_tiETCor2_mp03 "Ansteuerdauerkorrekturwert der Ansteuerdauer-Kalibrierung für den Raildruck-Kalibrierpunkt 2" SWORD InjTime_us 1 100 -13107.20 5000.00 ECU_ADDRESS 0xC000BC1E /end MEASUREMENT
/begin MEASUREMENT ETClb_tiETCor2_mp04 "Ansteuerdauerkorrekturwert der Ansteuerdauer-Kalibrierung für den Raildruck-Kalibrierpunkt 2" SWORD InjTime_us 1 100 -13107.20 5000.00 ECU_ADDRESS 0xC000BC20 /end MEASUREMENT
/begin MEASUREMENT ETClb_tiETCor2_mp05 "Ansteuerdauerkorrekturwert der Ansteuerdauer-Kalibrierung für den Raildruck-Kalibrierpunkt 2" SWORD InjTime_us 1 100 -13107.20 5000.00 ECU_ADDRESS 0xC000BC22 /end MEASUREMENT
/begin MEASUREMENT ETClb_tiETCur_mp00 "Aktuelle Ansteuerdauer der Ansteuerdauer-Kalibrierung für jeden Raildruck-Kalibrierpunkt" SWORD InjTime_us 1 100 -13107.20 5000.00 ECU_ADDRESS 0xC000BC24 /end MEASUREMENT
/begin MEASUREMENT ETClb_tiETCur_mp01 "Aktuelle Ansteuerdauer der Ansteuerdauer-Kalibrierung für jeden Raildruck-Kalibrierpunkt" SWORD InjTime_us 1 100 -13107.20 5000.00 ECU_ADDRESS 0xC000BC26 /end MEASUREMENT
/begin MEASUREMENT ETClb_tiETCur_mp02 "Aktuelle Ansteuerdauer der Ansteuerdauer-Kalibrierung für jeden Raildruck-Kalibrierpunkt" SWORD InjTime_us 1 100 -13107.20 5000.00 ECU_ADDRESS 0xC000BC28 /end MEASUREMENT
/begin MEASUREMENT ETClb_tiETMax00 "Ergebnis der Ansteuerdauerkalibrierungs-Einspritzungen" SWORD OneToOne 1 100 -32768.00 32767.00 ECU_ADDRESS 0xD0000950 /end MEASUREMENT
/begin MEASUREMENT ETClb_tiETMax01 "Ergebnis der Ansteuerdauerkalibrierungs-Einspritzungen" SWORD OneToOne 1 100 -32768.00 32767.00 ECU_ADDRESS 0xD0000952 /end MEASUREMENT
/begin MEASUREMENT ETClb_tiETMax02 "Ergebnis der Ansteuerdauerkalibrierungs-Einspritzungen" SWORD OneToOne 1 100 -32768.00 32767.00 ECU_ADDRESS 0xD0000954 /end MEASUREMENT
/begin MEASUREMENT ETClb_tiETMax03 "Ergebnis der Ansteuerdauerkalibrierungs-Einspritzungen" SWORD OneToOne 1 100 -32768.00 32767.00 ECU_ADDRESS 0xD0000956 /end MEASUREMENT
/begin MEASUREMENT ETClb_tiETMax04 "Ergebnis der Ansteuerdauerkalibrierungs-Einspritzungen" SWORD OneToOne 1 100 -32768.00 32767.00 ECU_ADDRESS 0xD0000958 /end MEASUREMENT
/begin MEASUREMENT ETClb_tiETMax05 "Ergebnis der Ansteuerdauerkalibrierungs-Einspritzungen" SWORD OneToOne 1 100 -32768.00 32767.00 ECU_ADDRESS 0xD000095A /end MEASUREMENT
/begin MEASUREMENT ETClb_tiETMin00 "Ergebnis der Ansteuerdauerkalibrierungs-Einspritzungen" SWORD OneToOne 1 100 -32768.00 32767.00 ECU_ADDRESS 0xD000095C /end MEASUREMENT
/begin MEASUREMENT ETClb_tiETMin01 "Ergebnis der Ansteuerdauerkalibrierungs-Einspritzungen" SWORD OneToOne 1 100 -32768.00 32767.00 ECU_ADDRESS 0xD000095E /end MEASUREMENT
/begin MEASUREMENT ETClb_tiETMin02 "Ergebnis der Ansteuerdauerkalibrierungs-Einspritzungen" SWORD OneToOne 1 100 -32768.00 32767.00 ECU_ADDRESS 0xD0000960 /end MEASUREMENT
/begin MEASUREMENT ETClb_tiETMin03 "Ergebnis der Ansteuerdauerkalibrierungs-Einspritzungen" SWORD OneToOne 1 100 -32768.00 32767.00 ECU_ADDRESS 0xD0000962 /end MEASUREMENT
/begin MEASUREMENT ETClb_tiETMin04 "Ergebnis der Ansteuerdauerkalibrierungs-Einspritzungen" SWORD OneToOne 1 100 -32768.00 32767.00 ECU_ADDRESS 0xD0000964 /end MEASUREMENT
/begin MEASUREMENT ETClb_tiETMin05 "Ergebnis der Ansteuerdauerkalibrierungs-Einspritzungen" SWORD OneToOne 1 100 -32768.00 32767.00 ECU_ADDRESS 0xD0000966 /end MEASUREMENT
/begin MEASUREMENT ETClb_tiETMinEff_mp00 "Ansteuerdauer der Nullmenge des aktuellen Zylinder für jeden Raildruck-Kalibrierpunkt" SWORD InjTime_us 1 100 -13107.20 5000.00 ECU_ADDRESS 0xC000BC54 /end MEASUREMENT
/begin MEASUREMENT ETClb_tiETMinEff_mp01 "Ansteuerdauer der Nullmenge des aktuellen Zylinder für jeden Raildruck-Kalibrierpunkt" SWORD InjTime_us 1 100 -13107.20 5000.00 ECU_ADDRESS 0xC000BC56 /end MEASUREMENT
/begin MEASUREMENT ETClb_tiETMinEff_mp02 "Ansteuerdauer der Nullmenge des aktuellen Zylinder für jeden Raildruck-Kalibrierpunkt" SWORD InjTime_us 1 100 -13107.20 5000.00 ECU_ADDRESS 0xC000BC58 /end MEASUREMENT
/begin MEASUREMENT Exh_pFld00 "" SWORD Pres_hPa 1 100 -32768.00 3500.00 ECU_ADDRESS 0xD0000A16 /end MEASUREMENT
/begin MEASUREMENT Exh_pFld01 "" SWORD Pres_hPa 1 100 -32768.00 3500.00 ECU_ADDRESS 0xD0000A18 /end MEASUREMENT
/begin MEASUREMENT Exh_pFld02 "" SWORD Pres_hPa 1 100 -32768.00 3500.00 ECU_ADDRESS 0xD0000A1A /end MEASUREMENT
/begin MEASUREMENT Exh_pFld03 "" SWORD Pres_hPa 1 100 -32768.00 3500.00 ECU_ADDRESS 0xD0000A1C /end MEASUREMENT
/begin MEASUREMENT Exh_pFld04 "" SWORD Pres_hPa 1 100 -32768.00 3500.00 ECU_ADDRESS 0xD0000A1E /end MEASUREMENT
/begin MEASUREMENT Exh_pFld05 "" SWORD Pres_hPa 1 100 -32768.00 3500.00 ECU_ADDRESS 0xD0000A20 /end MEASUREMENT
/begin MEASUREMENT Exh_pFld06 "" SWORD Pres_hPa 1 100 -32768.00 3500.00 ECU_ADDRESS 0xD0000A22 /end MEASUREMENT
/begin MEASUREMENT Exh_pFld07 "" SWORD Pres_hPa 1 100 -32768.00 3500.00 ECU_ADDRESS 0xD0000A24 /end MEASUREMENT
/begin MEASUREMENT Exh_rO2NoCat2Ds00 "Array zur Speicherung der O2-Werte aus Lambda- und NOx-Sensoren" SWORD O2 1 100 -0.3276800 0.3276700 ECU_ADDRESS 0xD0000A6E /end MEASUREMENT
/begin MEASUREMENT Exh_rO2NoCat2Ds01 "Array zur Speicherung der O2-Werte aus Lambda- und NOx-Sensoren" SWORD O2 1 100 -0.3276800 0.3276700 ECU_ADDRESS 0xD0000A70 /end MEASUREMENT
/begin MEASUREMENT Exh_rO2NOxNoCat2Ds00 "Array zur Speicherung der O2-Werte aus NOx-Sensoren (ausschließlich)" SWORD O2 1 100 -0.3276800 0.3276700 ECU_ADDRESS 0xD0000A68 /end MEASUREMENT
/begin MEASUREMENT Exh_rO2NOxNSCDs00 "Array zur Speicherung der O2-Werte aus NOx-Sensoren (ausschließlich)" SWORD O2 1 100 -0.3276800 0.3276700 ECU_ADDRESS 0xD0000A66 /end MEASUREMENT
/begin MEASUREMENT Exh_rO2NSCDs00 "Array zur Speicherung der O2-Werte aus Lambda- und NOx-Sensoren" SWORD O2 1 100 -0.3276800 0.3276700 ECU_ADDRESS 0xD0000A6A /end MEASUREMENT
/begin MEASUREMENT Exh_rO2NSCDs01 "Array zur Speicherung der O2-Werte aus Lambda- und NOx-Sensoren" SWORD O2 1 100 -0.3276800 0.3276700 ECU_ADDRESS 0xD0000A6C /end MEASUREMENT
/begin MEASUREMENT Exh_stO2NoCat2Ds00 "Array zur Speicherung des Gültigkeitsstatus der Lambda- und NOx-Sensoren" UBYTE OneToOne 1 100 0.00 255.0 ECU_ADDRESS 0xD0001E2A /end MEASUREMENT
/begin MEASUREMENT Exh_stO2NoCat2Ds01 "Array zur Speicherung des Gültigkeitsstatus der Lambda- und NOx-Sensoren" UBYTE OneToOne 1 100 0.00 255.0 ECU_ADDRESS 0xD0001E2B /end MEASUREMENT
/begin MEASUREMENT Exh_stO2NOxNoCat2Ds00 "Array zur Speicherung des Gültigkeitsstatus der NOx-Sensoren (ausschließlich)" UBYTE OneToOne 1 100 0.00 255.0 ECU_ADDRESS 0xD0001E27 /end MEASUREMENT
/begin MEASUREMENT Exh_stO2NOxNSCDs00 "Array zur Speicherung des Gültigkeitsstatus der NOx-Sensoren (ausschließlich)" UBYTE OneToOne 1 100 0.00 255.0 ECU_ADDRESS 0xD0001E26 /end MEASUREMENT
/begin MEASUREMENT Exh_stO2NSCDs00 "Array zur Speicherung des Gültigkeitsstatus der Lambda- und NOx-Sensoren" UBYTE OneToOne 1 100 0.00 255.0 ECU_ADDRESS 0xD0001E28 /end MEASUREMENT
/begin MEASUREMENT Exh_stO2NSCDs01 "Array zur Speicherung des Gültigkeitsstatus der Lambda- und NOx-Sensoren" UBYTE OneToOne 1 100 0.00 255.0 ECU_ADDRESS 0xD0001E29 /end MEASUREMENT
/begin MEASUREMENT Exh_tFld00 "" SWORD Temp_Cels 1 100 -3549.940 3003.560 ECU_ADDRESS 0xD0000A82 /end MEASUREMENT
/begin MEASUREMENT Exh_tFld01 "" SWORD Temp_Cels 1 100 -3549.940 3003.560 ECU_ADDRESS 0xD0000A84 /end MEASUREMENT
/begin MEASUREMENT Exh_tFld02 "" SWORD Temp_Cels 1 100 -3549.940 3003.560 ECU_ADDRESS 0xD0000A86 /end MEASUREMENT
/begin MEASUREMENT Exh_tFld03 "" SWORD Temp_Cels 1 100 -3549.940 3003.560 ECU_ADDRESS 0xD0000A88 /end MEASUREMENT
/begin MEASUREMENT Exh_tFld04 "" SWORD Temp_Cels 1 100 -3549.940 3003.560 ECU_ADDRESS 0xD0000A8A /end MEASUREMENT
/begin MEASUREMENT Exh_tFld05 "" SWORD Temp_Cels 1 100 -3549.940 3003.560 ECU_ADDRESS 0xD0000A8C /end MEASUREMENT
/begin MEASUREMENT Exh_tFld06 "" SWORD Temp_Cels 1 100 -3549.940 3003.560 ECU_ADDRESS 0xD0000A8E /end MEASUREMENT
/begin MEASUREMENT Exh_tFld07 "" SWORD Temp_Cels 1 100 -3549.940 3003.560 ECU_ADDRESS 0xD0000A90 /end MEASUREMENT
/begin MEASUREMENT Exh_tMonFld00 "" SWORD Temp_Cels 1 100 -3549.940 3003.560 ECU_ADDRESS 0xD0000A92 /end MEASUREMENT
/begin MEASUREMENT Exh_tMonFld01 "" SWORD Temp_Cels 1 100 -3549.940 3003.560 ECU_ADDRESS 0xD0000A94 /end MEASUREMENT
/begin MEASUREMENT Exh_tMonFld02 "" SWORD Temp_Cels 1 100 -3549.940 3003.560 ECU_ADDRESS 0xD0000A96 /end MEASUREMENT
/begin MEASUREMENT Exh_tSimFld00 "" SWORD Temp_Cels 1 100 -3549.940 3003.560 ECU_ADDRESS 0xD0000AAE /end MEASUREMENT
/begin MEASUREMENT Exh_tSimFld01 "" SWORD Temp_Cels 1 100 -3549.940 3003.560 ECU_ADDRESS 0xD0000AB0 /end MEASUREMENT
/begin MEASUREMENT Exh_tSimFld02 "" SWORD Temp_Cels 1 100 -3549.940 3003.560 ECU_ADDRESS 0xD0000AB2 /end MEASUREMENT
/begin MEASUREMENT e_sig_ews4_u3200 "" ULONG OneToOne 1 100 0.00 4294967295.00 ECU_ADDRESS 0xD00035F8 /end MEASUREMENT
/begin MEASUREMENT e_sig_ews4_u3201 "" ULONG OneToOne 1 100 0.00 4294967295.00 ECU_ADDRESS 0xD00035FC /end MEASUREMENT
/begin MEASUREMENT FBC_AACoef_mp00 "Antialiasingfilterkoeffizienten" FLOAT32_IEEE OneToOne 1 100 0.00 1.00000000 FORMAT "%10.8" ECU_ADDRESS 0xC000BCE4 /end MEASUREMENT
/begin MEASUREMENT FBC_AACoef_mp01 "Antialiasingfilterkoeffizienten" FLOAT32_IEEE OneToOne 1 100 0.00 1.00000000 FORMAT "%10.8" ECU_ADDRESS 0xC000BCE8 /end MEASUREMENT
/begin MEASUREMENT FBC_AACoef_mp02 "Antialiasingfilterkoeffizienten" FLOAT32_IEEE OneToOne 1 100 0.00 1.00000000 FORMAT "%10.8" ECU_ADDRESS 0xC000BCEC /end MEASUREMENT
/begin MEASUREMENT FBC_AACoef_mp03 "Antialiasingfilterkoeffizienten" FLOAT32_IEEE OneToOne 1 100 0.00 1.00000000 FORMAT "%10.8" ECU_ADDRESS 0xC000BCF0 /end MEASUREMENT
/begin MEASUREMENT FBC_AACoef_mp04 "Antialiasingfilterkoeffizienten" FLOAT32_IEEE OneToOne 1 100 0.00 1.00000000 FORMAT "%10.8" ECU_ADDRESS 0xC000BCF4 /end MEASUREMENT
/begin MEASUREMENT FBC_AACoef_mp05 "Antialiasingfilterkoeffizienten" FLOAT32_IEEE OneToOne 1 100 0.00 1.00000000 FORMAT "%10.8" ECU_ADDRESS 0xC000BCF8 /end MEASUREMENT
/begin MEASUREMENT FBC_AACoef_mp06 "Antialiasingfilterkoeffizienten" FLOAT32_IEEE OneToOne 1 100 0.00 1.00000000 FORMAT "%10.8" ECU_ADDRESS 0xC000BCFC /end MEASUREMENT
/begin MEASUREMENT FBC_AACoef_mp07 "Antialiasingfilterkoeffizienten" FLOAT32_IEEE OneToOne 1 100 0.00 1.00000000 FORMAT "%10.8" ECU_ADDRESS 0xC000BD00 /end MEASUREMENT
/begin MEASUREMENT FBC_AACoef_mp08 "Antialiasingfilterkoeffizienten" FLOAT32_IEEE OneToOne 1 100 0.00 1.00000000 FORMAT "%10.8" ECU_ADDRESS 0xC000BD04 /end MEASUREMENT
/begin MEASUREMENT FBC_AAIn00 "Segmentzeiten der Teilsegmente" FLOAT32_IEEE OneToOne 1 100 -150000000. 150000000. FORMAT "%10.0" ECU_ADDRESS 0xD0002D90 /end MEASUREMENT
/begin MEASUREMENT FBC_AAIn01 "Segmentzeiten der Teilsegmente" FLOAT32_IEEE OneToOne 1 100 -150000000. 150000000. FORMAT "%10.0" ECU_ADDRESS 0xD0002D94 /end MEASUREMENT
/begin MEASUREMENT FBC_AAIn02 "Segmentzeiten der Teilsegmente" FLOAT32_IEEE OneToOne 1 100 -150000000. 150000000. FORMAT "%10.0" ECU_ADDRESS 0xD0002D98 /end MEASUREMENT
/begin MEASUREMENT FBC_AAIn03 "Segmentzeiten der Teilsegmente" FLOAT32_IEEE OneToOne 1 100 -150000000. 150000000. FORMAT "%10.0" ECU_ADDRESS 0xD0002D9C /end MEASUREMENT
/begin MEASUREMENT FBC_AAPhiAbs_mp00 "absoluter Startwinkel des AntiAliasing-Winkels (FBC_AAPhiAbs_mp[0] ist der jüngste Wert)" SWORD OneToOne 1 100 -32768.00 32767.00 ECU_ADDRESS 0xC000BD08 /end MEASUREMENT
/begin MEASUREMENT FBC_AAPhiAbs_mp01 "absoluter Startwinkel des AntiAliasing-Winkels (FBC_AAPhiAbs_mp[0] ist der jüngste Wert)" SWORD OneToOne 1 100 -32768.00 32767.00 ECU_ADDRESS 0xC000BD0A /end MEASUREMENT
/begin MEASUREMENT FBC_AAPhiAbs_mp02 "absoluter Startwinkel des AntiAliasing-Winkels (FBC_AAPhiAbs_mp[0] ist der jüngste Wert)" SWORD OneToOne 1 100 -32768.00 32767.00 ECU_ADDRESS 0xC000BD0C /end MEASUREMENT
/begin MEASUREMENT FBC_AAPhiAbs_mp03 "absoluter Startwinkel des AntiAliasing-Winkels (FBC_AAPhiAbs_mp[0] ist der jüngste Wert)" SWORD OneToOne 1 100 -32768.00 32767.00 ECU_ADDRESS 0xC000BD0E /end MEASUREMENT
/begin MEASUREMENT FBC_dBPCaS00 "aktueller Bandpass Zählerkoeffizient f=fNW (gangabhängig)" FLOAT32_IEEE OneToOne 1 100 -5000.00000 5000.00000 FORMAT "%10.5" ECU_ADDRESS 0xD0002DA4 /end MEASUREMENT
/begin MEASUREMENT FBC_dBPCaS01 "aktueller Bandpass Zählerkoeffizient f=fNW (gangabhängig)" FLOAT32_IEEE OneToOne 1 100 -5000.00000 5000.00000 FORMAT "%10.5" ECU_ADDRESS 0xD0002DA8 /end MEASUREMENT
/begin MEASUREMENT FBC_dBPCaS02 "aktueller Bandpass Zählerkoeffizient f=fNW (gangabhängig)" FLOAT32_IEEE OneToOne 1 100 -5000.00000 5000.00000 FORMAT "%10.5" ECU_ADDRESS 0xD0002DAC /end MEASUREMENT
/begin MEASUREMENT FBC_dBPCaSOld_mp00 "Array mit zurückliegenden Bandpassausgängen" FLOAT32_IEEE OneToOne 1 100 -5000.00000 5000.00000 FORMAT "%10.5" ECU_ADDRESS 0xC000BCC0 /end MEASUREMENT
/begin MEASUREMENT FBC_dBPCaSOld_mp01 "Array mit zurückliegenden Bandpassausgängen" FLOAT32_IEEE OneToOne 1 100 -5000.00000 5000.00000 FORMAT "%10.5" ECU_ADDRESS 0xC000BCC4 /end MEASUREMENT
/begin MEASUREMENT FBC_dBPCaSOld_mp02 "Array mit zurückliegenden Bandpassausgängen" FLOAT32_IEEE OneToOne 1 100 -5000.00000 5000.00000 FORMAT "%10.5" ECU_ADDRESS 0xC000BCC8 /end MEASUREMENT
/begin MEASUREMENT FBC_DXSfn_mp00 "Ausgang des negativen Bewertungsfilter" SWORD FBC_Dxs_s16 1 100 -0.7812500 0.7812262 FORMAT "%9.7" ECU_ADDRESS 0xC000BD10 /end MEASUREMENT
/begin MEASUREMENT FBC_DXSfn_mp01 "Ausgang des negativen Bewertungsfilter" SWORD FBC_Dxs_s16 1 100 -0.7812500 0.7812262 FORMAT "%9.7" ECU_ADDRESS 0xC000BD12 /end MEASUREMENT
/begin MEASUREMENT FBC_DXSfn_mp02 "Ausgang des negativen Bewertungsfilter" SWORD FBC_Dxs_s16 1 100 -0.7812500 0.7812262 FORMAT "%9.7" ECU_ADDRESS 0xC000BD14 /end MEASUREMENT
/begin MEASUREMENT FBC_DXSfn_mp03 "Ausgang des negativen Bewertungsfilter" SWORD FBC_Dxs_s16 1 100 -0.7812500 0.7812262 FORMAT "%9.7" ECU_ADDRESS 0xC000BD16 /end MEASUREMENT
/begin MEASUREMENT FBC_DXSfn_mp04 "Ausgang des negativen Bewertungsfilter" SWORD FBC_Dxs_s16 1 100 -0.7812500 0.7812262 FORMAT "%9.7" ECU_ADDRESS 0xC000BD18 /end MEASUREMENT
/begin MEASUREMENT FBC_DXSfn_mp05 "Ausgang des negativen Bewertungsfilter" SWORD FBC_Dxs_s16 1 100 -0.7812500 0.7812262 FORMAT "%9.7" ECU_ADDRESS 0xC000BD1A /end MEASUREMENT
/begin MEASUREMENT FBC_DXSfn_mp06 "Ausgang des negativen Bewertungsfilter" SWORD FBC_Dxs_s16 1 100 -0.7812500 0.7812262 FORMAT "%9.7" ECU_ADDRESS 0xC000BD1C /end MEASUREMENT
/begin MEASUREMENT FBC_DXSfn_mp07 "Ausgang des negativen Bewertungsfilter" SWORD FBC_Dxs_s16 1 100 -0.7812500 0.7812262 FORMAT "%9.7" ECU_ADDRESS 0xC000BD1E /end MEASUREMENT
/begin MEASUREMENT FBC_DXSfn_mp08 "Ausgang des negativen Bewertungsfilter" SWORD FBC_Dxs_s16 1 100 -0.7812500 0.7812262 FORMAT "%9.7" ECU_ADDRESS 0xC000BD20 /end MEASUREMENT
/begin MEASUREMENT FBC_DXSfn_mp09 "Ausgang des negativen Bewertungsfilter" SWORD FBC_Dxs_s16 1 100 -0.7812500 0.7812262 FORMAT "%9.7" ECU_ADDRESS 0xC000BD22 /end MEASUREMENT
/begin MEASUREMENT FBC_DXSfn_mp10 "Ausgang des negativen Bewertungsfilter" SWORD FBC_Dxs_s16 1 100 -0.7812500 0.7812262 FORMAT "%9.7" ECU_ADDRESS 0xC000BD24 /end MEASUREMENT
/begin MEASUREMENT FBC_DXSfn_mp11 "Ausgang des negativen Bewertungsfilter" SWORD FBC_Dxs_s16 1 100 -0.7812500 0.7812262 FORMAT "%9.7" ECU_ADDRESS 0xC000BD26 /end MEASUREMENT
/begin MEASUREMENT FBC_DXSfp_mp00 "Ausgang des positiven Bewertungsfilter" SWORD FBC_Dxs_s16 1 100 -0.7812500 0.7812262 FORMAT "%9.7" ECU_ADDRESS 0xC000BD28 /end MEASUREMENT
/begin MEASUREMENT FBC_DXSfp_mp01 "Ausgang des positiven Bewertungsfilter" SWORD FBC_Dxs_s16 1 100 -0.7812500 0.7812262 FORMAT "%9.7" ECU_ADDRESS 0xC000BD2A /end MEASUREMENT
/begin MEASUREMENT FBC_DXSfp_mp02 "Ausgang des positiven Bewertungsfilter" SWORD FBC_Dxs_s16 1 100 -0.7812500 0.7812262 FORMAT "%9.7" ECU_ADDRESS 0xC000BD2C /end MEASUREMENT
/begin MEASUREMENT FBC_DXSfp_mp03 "Ausgang des positiven Bewertungsfilter" SWORD FBC_Dxs_s16 1 100 -0.7812500 0.7812262 FORMAT "%9.7" ECU_ADDRESS 0xC000BD2E /end MEASUREMENT
/begin MEASUREMENT FBC_DXSfp_mp04 "Ausgang des positiven Bewertungsfilter" SWORD FBC_Dxs_s16 1 100 -0.7812500 0.7812262 FORMAT "%9.7" ECU_ADDRESS 0xC000BD30 /end MEASUREMENT
/begin MEASUREMENT FBC_DXSfp_mp05 "Ausgang des positiven Bewertungsfilter" SWORD FBC_Dxs_s16 1 100 -0.7812500 0.7812262 FORMAT "%9.7" ECU_ADDRESS 0xC000BD32 /end MEASUREMENT
/begin MEASUREMENT FBC_DXSfp_mp06 "Ausgang des positiven Bewertungsfilter" SWORD FBC_Dxs_s16 1 100 -0.7812500 0.7812262 FORMAT "%9.7" ECU_ADDRESS 0xC000BD34 /end MEASUREMENT
/begin MEASUREMENT FBC_DXSfp_mp07 "Ausgang des positiven Bewertungsfilter" SWORD FBC_Dxs_s16 1 100 -0.7812500 0.7812262 FORMAT "%9.7" ECU_ADDRESS 0xC000BD36 /end MEASUREMENT
/begin MEASUREMENT FBC_DXSfp_mp08 "Ausgang des positiven Bewertungsfilter" SWORD FBC_Dxs_s16 1 100 -0.7812500 0.7812262 FORMAT "%9.7" ECU_ADDRESS 0xC000BD38 /end MEASUREMENT
/begin MEASUREMENT FBC_DXSfp_mp09 "Ausgang des positiven Bewertungsfilter" SWORD FBC_Dxs_s16 1 100 -0.7812500 0.7812262 FORMAT "%9.7" ECU_ADDRESS 0xC000BD3A /end MEASUREMENT
/begin MEASUREMENT FBC_DXSfp_mp10 "Ausgang des positiven Bewertungsfilter" SWORD FBC_Dxs_s16 1 100 -0.7812500 0.7812262 FORMAT "%9.7" ECU_ADDRESS 0xC000BD3C /end MEASUREMENT
/begin MEASUREMENT FBC_DXSfp_mp11 "Ausgang des positiven Bewertungsfilter" SWORD FBC_Dxs_s16 1 100 -0.7812500 0.7812262 FORMAT "%9.7" ECU_ADDRESS 0xC000BD3E /end MEASUREMENT
/begin MEASUREMENT FBC_DXSf_mp00 "relative,aktuelle gefilterte Zahnteilungsfehler (Adaptionsfilter)" SWORD FBC_Dxs_s16 1 100 -0.7812500 0.7812262 FORMAT "%9.7" ECU_ADDRESS 0xC000BD40 /end MEASUREMENT
/begin MEASUREMENT FBC_DXSf_mp01 "relative,aktuelle gefilterte Zahnteilungsfehler (Adaptionsfilter)" SWORD FBC_Dxs_s16 1 100 -0.7812500 0.7812262 FORMAT "%9.7" ECU_ADDRESS 0xC000BD42 /end MEASUREMENT
/begin MEASUREMENT FBC_DXSf_mp02 "relative,aktuelle gefilterte Zahnteilungsfehler (Adaptionsfilter)" SWORD FBC_Dxs_s16 1 100 -0.7812500 0.7812262 FORMAT "%9.7" ECU_ADDRESS 0xC000BD44 /end MEASUREMENT
/begin MEASUREMENT FBC_DXSf_mp03 "relative,aktuelle gefilterte Zahnteilungsfehler (Adaptionsfilter)" SWORD FBC_Dxs_s16 1 100 -0.7812500 0.7812262 FORMAT "%9.7" ECU_ADDRESS 0xC000BD46 /end MEASUREMENT
/begin MEASUREMENT FBC_DXSf_mp04 "relative,aktuelle gefilterte Zahnteilungsfehler (Adaptionsfilter)" SWORD FBC_Dxs_s16 1 100 -0.7812500 0.7812262 FORMAT "%9.7" ECU_ADDRESS 0xC000BD48 /end MEASUREMENT
/begin MEASUREMENT FBC_DXSf_mp05 "relative,aktuelle gefilterte Zahnteilungsfehler (Adaptionsfilter)" SWORD FBC_Dxs_s16 1 100 -0.7812500 0.7812262 FORMAT "%9.7" ECU_ADDRESS 0xC000BD4A /end MEASUREMENT
/begin MEASUREMENT FBC_DXSf_mp06 "relative,aktuelle gefilterte Zahnteilungsfehler (Adaptionsfilter)" SWORD FBC_Dxs_s16 1 100 -0.7812500 0.7812262 FORMAT "%9.7" ECU_ADDRESS 0xC000BD4C /end MEASUREMENT
/begin MEASUREMENT FBC_DXSf_mp07 "relative,aktuelle gefilterte Zahnteilungsfehler (Adaptionsfilter)" SWORD FBC_Dxs_s16 1 100 -0.7812500 0.7812262 FORMAT "%9.7" ECU_ADDRESS 0xC000BD4E /end MEASUREMENT
/begin MEASUREMENT FBC_DXSf_mp08 "relative,aktuelle gefilterte Zahnteilungsfehler (Adaptionsfilter)" SWORD FBC_Dxs_s16 1 100 -0.7812500 0.7812262 FORMAT "%9.7" ECU_ADDRESS 0xC000BD50 /end MEASUREMENT
/begin MEASUREMENT FBC_DXSf_mp09 "relative,aktuelle gefilterte Zahnteilungsfehler (Adaptionsfilter)" SWORD FBC_Dxs_s16 1 100 -0.7812500 0.7812262 FORMAT "%9.7" ECU_ADDRESS 0xC000BD52 /end MEASUREMENT
/begin MEASUREMENT FBC_DXSf_mp10 "relative,aktuelle gefilterte Zahnteilungsfehler (Adaptionsfilter)" SWORD FBC_Dxs_s16 1 100 -0.7812500 0.7812262 FORMAT "%9.7" ECU_ADDRESS 0xC000BD54 /end MEASUREMENT
/begin MEASUREMENT FBC_DXSf_mp11 "relative,aktuelle gefilterte Zahnteilungsfehler (Adaptionsfilter)" SWORD FBC_Dxs_s16 1 100 -0.7812500 0.7812262 FORMAT "%9.7" ECU_ADDRESS 0xC000BD56 /end MEASUREMENT
/begin MEASUREMENT FBC_DXSl_mp00 "relative, gefilterte Zahnteilungsfehler (Adaptionsfilter, eingelernte Werte)" SWORD FBC_Dxs_s16 1 100 -0.7812500 0.7812262 FORMAT "%9.7" ECU_ADDRESS 0xC000BD58 /end MEASUREMENT
/begin MEASUREMENT FBC_DXSl_mp01 "relative, gefilterte Zahnteilungsfehler (Adaptionsfilter, eingelernte Werte)" SWORD FBC_Dxs_s16 1 100 -0.7812500 0.7812262 FORMAT "%9.7" ECU_ADDRESS 0xC000BD5A /end MEASUREMENT
/begin MEASUREMENT FBC_DXSl_mp02 "relative, gefilterte Zahnteilungsfehler (Adaptionsfilter, eingelernte Werte)" SWORD FBC_Dxs_s16 1 100 -0.7812500 0.7812262 FORMAT "%9.7" ECU_ADDRESS 0xC000BD5C /end MEASUREMENT
/begin MEASUREMENT FBC_DXSl_mp03 "relative, gefilterte Zahnteilungsfehler (Adaptionsfilter, eingelernte Werte)" SWORD FBC_Dxs_s16 1 100 -0.7812500 0.7812262 FORMAT "%9.7" ECU_ADDRESS 0xC000BD5E /end MEASUREMENT
/begin MEASUREMENT FBC_DXSl_mp04 "relative, gefilterte Zahnteilungsfehler (Adaptionsfilter, eingelernte Werte)" SWORD FBC_Dxs_s16 1 100 -0.7812500 0.7812262 FORMAT "%9.7" ECU_ADDRESS 0xC000BD60 /end MEASUREMENT
/begin MEASUREMENT FBC_DXSl_mp05 "relative, gefilterte Zahnteilungsfehler (Adaptionsfilter, eingelernte Werte)" SWORD FBC_Dxs_s16 1 100 -0.7812500 0.7812262 FORMAT "%9.7" ECU_ADDRESS 0xC000BD62 /end MEASUREMENT
/begin MEASUREMENT FBC_DXSl_mp06 "relative, gefilterte Zahnteilungsfehler (Adaptionsfilter, eingelernte Werte)" SWORD FBC_Dxs_s16 1 100 -0.7812500 0.7812262 FORMAT "%9.7" ECU_ADDRESS 0xC000BD64 /end MEASUREMENT
/begin MEASUREMENT FBC_DXSl_mp07 "relative, gefilterte Zahnteilungsfehler (Adaptionsfilter, eingelernte Werte)" SWORD FBC_Dxs_s16 1 100 -0.7812500 0.7812262 FORMAT "%9.7" ECU_ADDRESS 0xC000BD66 /end MEASUREMENT
/begin MEASUREMENT FBC_DXSl_mp08 "relative, gefilterte Zahnteilungsfehler (Adaptionsfilter, eingelernte Werte)" SWORD FBC_Dxs_s16 1 100 -0.7812500 0.7812262 FORMAT "%9.7" ECU_ADDRESS 0xC000BD68 /end MEASUREMENT
/begin MEASUREMENT FBC_DXSl_mp09 "relative, gefilterte Zahnteilungsfehler (Adaptionsfilter, eingelernte Werte)" SWORD FBC_Dxs_s16 1 100 -0.7812500 0.7812262 FORMAT "%9.7" ECU_ADDRESS 0xC000BD6A /end MEASUREMENT
/begin MEASUREMENT FBC_DXSl_mp10 "relative, gefilterte Zahnteilungsfehler (Adaptionsfilter, eingelernte Werte)" SWORD FBC_Dxs_s16 1 100 -0.7812500 0.7812262 FORMAT "%9.7" ECU_ADDRESS 0xC000BD6C /end MEASUREMENT
/begin MEASUREMENT FBC_DXSl_mp11 "relative, gefilterte Zahnteilungsfehler (Adaptionsfilter, eingelernte Werte)" SWORD FBC_Dxs_s16 1 100 -0.7812500 0.7812262 FORMAT "%9.7" ECU_ADDRESS 0xC000BD6E /end MEASUREMENT
/begin MEASUREMENT FBC_DXS_mp00 "relative Zahnteilungsfehler (ungefiltert)" SWORD FBC_Dxs_s16 1 100 -0.7812500 0.7812262 FORMAT "%9.7" ECU_ADDRESS 0xC000BD70 /end MEASUREMENT
/begin MEASUREMENT FBC_DXS_mp01 "relative Zahnteilungsfehler (ungefiltert)" SWORD FBC_Dxs_s16 1 100 -0.7812500 0.7812262 FORMAT "%9.7" ECU_ADDRESS 0xC000BD72 /end MEASUREMENT
/begin COMPU_METHOD AngleCrS "" RAT_FUNC "%6.3" "deg CrS" COEFFS 0 45.5111111111 0 0 0 1 /end COMPU_METHOD
/begin COMPU_METHOD DFCDSQ_Verb "" TAB_VERB "%2.1" "-" COMPU_TAB_REF DFCDSQ_Verb /end COMPU_METHOD
/begin COMPU_VTAB DFCDSQ_Verb "" TAB_VERB 1214 0 "NoInhibit" 1 "DFC_ACCIPlausDrvAst" 2 "DFC_ACCIPlausTrqDes" 3 "DFC_AirCtlGovDvtEOMMax" 4 "DFC_AirCtlGovDvtEOMMin" 5 "DFC_AirCtlGovDvtMax" 6 "DFC_AirCtlGovDvtMin" 7 "DFC_AirCtlGovLPDvtMax" 8 "DFC_AirCtlGovLPDvtMin" 9 "DFC_AltIOComErr" 10 "DFC_AltIOComNpl" 11 "DFC_BusDiagBusOffFlexRay" 12 "DFC_BusDiagBusOffNodeA" 13 "DFC_BusDiagBusOffNodeB" 14 "DFC_BusDiagBusOffNodeC" 15 "DFC_BusDiagHwFlexRay" 16 "DFC_Cj945SpiCom1" 17 "DFC_ComACDemandSig_FA" 18 "DFC_ComACDemandTo_FA" 19 "DFC_ComATempSig_FA" 20 "DFC_ComATempTo_FA" 21 "DFC_ComATempTo_FX" 22 "DFC_ComBrkTrqSumChk_FX" 23 "DFC_ComBrkTrqSumCtr_FX" 24 "DFC_ComBrkTrqSumTo_FX" 25 "DFC_ComBtnDrvDynChk_FX" 26 "DFC_ComBtnDrvDynCtr_FX" 27 "DFC_ComBtnDrvDynTo_FX" 28 "DFC_ComButtonMSASig" 29 "DFC_ComButtonMSATo" 30 "DFC_ComCodierungPwrmngSig" 31 "DFC_ComCodierungPwrmngSig_FA" 32 "DFC_ComCrCtlLvrChk" 33 "DFC_ComCrCtlLvrCtr" 34 "DFC_ComCrCtlLvrSig" 35 "DFC_ComCrCtlLvrTo" 36 "DFC_ComCtrCrshSwoEkpSig_FA" 37 "DFC_ComCtrCrshSwoEkpTo_FA" 38 "DFC_ComCtrSecInt" 39 "DFC_ComDiaOBDGbxSig_A" 40 "DFC_ComDiaOBDGbxTo_A" 41 "DFC_ComFahrzeugtypSig" 42 "DFC_ComFahrzeugtypSig_FA" 43 "DFC_ComFllupGpwsupSig_FA" 44 "DFC_ComFllupGpwsupTo_FA" 45 "DFC_ComGbxDataChk_A" 46 "DFC_ComGbxDataChk_FA" 47 "DFC_ComGbxDataCtr_A" 48 "DFC_ComGbxDataCtr_FA" 49 "DFC_ComGbxDataSig_A" 50 "DFC_ComGbxDataSig_FA" 51 "DFC_ComGbxDataTo_A" 52 "DFC_ComGbxDataTo_FA" 53 "DFC_ComKlemmenChk_FA" 54 "DFC_ComKlemmenCtr_FA" 55 "DFC_ComKlemmenSig_FA" 56 "DFC_ComKlemmenTo_FA" 57 "DFC_ComLenkradwinkelSig" 58 "DFC_ComLenkradwinkelTo" 59 "DFC_ComMileageRangeSig_FA" 60 "DFC_ComMileageRangeTo_FA" 61 "DFC_ComPspSig" 62 "DFC_ComPspTo" 63 "DFC_ComRelTimeSig_FA" 64 "DFC_ComRelTimeTo_FA" 65 "DFC_ComRequestEMFChk" 66 "DFC_ComRequestEMFCtr" 67 "DFC_ComRequestEMFSig" 68 "DFC_ComRequestEMFTo" 69 "DFC_ComRpmWhlChk_FX" 70 "DFC_ComRpmWhlCtr_FX" 71 "DFC_ComRpmWhlTo_FX" 72 "DFC_ComSecCtrRelSig_FA" 73 "DFC_ComSecCtrRelTo_FA" 74 "DFC_ComSensNOxGndSig" 75 "DFC_ComSensNOxGndTo" 76 "DFC_ComSensNOxMode" 77 "DFC_ComSensNOxUbattSig" 78 "DFC_ComSensNOxUbattTo" 79 "DFC_ComShiftPaddleTo_FX" 80 "DFC_ComShutOffPSPSig" 81 "DFC_ComShutOffPSPTo" 82 "DFC_ComSlrdiGlbFZMTo_FA" 83 "DFC_ComSlrdiGlbFZMTo_FX" 84 "DFC_ComSpeedVehicleChk_FX" 85 "DFC_ComSpeedVehicleCtr_FX" 86 "DFC_ComSpeedVehicleTo_FX" 87 "DFC_ComStConintDSCChk_FX" 88 "DFC_ComStConintDSCCtr_FX" 89 "DFC_ComStConintDSCTo_FX" 90 "DFC_ComStatACFrontSig_FA" 91 "DFC_ComStatACFrontTo_FA" 92 "DFC_ComStatEkpSig_A" 93 "DFC_ComStatEkpTo_A" 94 "DFC_ComStatGearRevSig_FA" 95 "DFC_ComStatGearRevTo_FA" 96 "DFC_ComStatZVKlappenSig_FA" 97 "DFC_ComStatZVKlappenTo_FA" 98 "DFC_ComStateARSCtr" 99 "DFC_ComStateARSSig" 100 "DFC_ComStateARSTo" 101 "DFC_ComStateDscSig" 102 "DFC_ComStateDscTo" 103 "DFC_ComStateSeatSig" 104 "DFC_ComStateSeatSig_FA" 105 "DFC_ComStateSeatTo" 106 "DFC_ComStateSeatTo_FA" 107 "DFC_ComStatusEGSSig_A" 108 "DFC_ComStatusEGSSig_FA" 109 "DFC_ComStatusEGSTo_A" 110 "DFC_ComStatusEGSTo_FA" 111 "DFC_ComStatusEMFChk" 112 "DFC_ComStatusEMFCtr" 113 "DFC_ComStatusEMFSig" 114 "DFC_ComStatusEMFTo" 115 "DFC_ComStatusRGangSig" 116 "DFC_ComStatusRGangTo" 117 "DFC_ComSteeringAngleChk_FX" 118 "DFC_ComSteeringAngleCtr_FX" 119 "DFC_ComSteeringAngleTo_FX" 120 "DFC_ComTerminalChk" 121 "DFC_ComTerminalCtr" 122 "DFC_ComTerminalSig" 123 "DFC_ComTerminalTo" 124 "DFC_ComTimeDateSig_FA" 125 "DFC_ComTimeDateTo_FA" 126 "DFC_ComTrailerSig" 127 "DFC_ComTrailerSig_FA" 128 "DFC_ComTrailerTo" 129 "DFC_ComTrailerTo_FA" 130 "DFC_ComTrqDemCrshDrDyChk_FX" 131 "DFC_ComTrqDemCrshDrDyCtr_FX" 132 "DFC_ComTrqDemCrshDrDyTo_FX" 133 "DFC_ComTrqDemandDesSig" 134 "DFC_ComTrqDemandDesTo" 135 "DFC_ComTrqDemandDscChk" 136 "DFC_ComTrqDemandDscCtr" 137 "DFC_ComTrqDemandDscSig" 138 "DFC_ComTrqDemandDscTo" 139 "DFC_ComTrqDemandGbxChk_A" 140 "DFC_ComTrqDemandGbxChk_FA" 141 "DFC_ComTrqDemandGbxCtr_A" 142 "DFC_ComTrqDemandGbxCtr_FA" 143 "DFC_ComTrqDemandGbxSig_A" 144 "DFC_ComTrqDemandGbxSig_FA" 145 "DFC_ComTrqDemandGbxTo_A" 146 "DFC_ComTrqDemandGbxTo_FA" 147 "DFC_ComTrqWhlDemChk" 148 "DFC_ComTrqWhlDemCtr" 149 "DFC_ComTrqWhlDemFASChk_FX" 150 "DFC_ComTrqWhlDemFASCtr_FX" 151 "DFC_ComTrqWhlDemFASTo_FX" 152 "DFC_ComTrqWhlDemSig" 153 "DFC_ComTrqWhlDemTo" 154 "DFC_ComVelocityChk_FA" 155 "DFC_ComVelocityCtr_FA" 156 "DFC_ComVelocitySig" 157 "DFC_ComVelocitySig_FA" 158 "DFC_ComVelocityTo" 159 "DFC_ComVelocityTo_FA" 160 "DFC_ComVerbraucherTo" 161 "DFC_ComWMomPTStabChk_FX" 162 "DFC_ComWMomPTStabCtr_FX" 163 "DFC_ComWMomPTStabTo_FX" 164 "DFC_ComWheelSpeedSig" 165 "DFC_ComWheelSpeedTo" 166 "DFC_ComZvKlappenSig" 167 "DFC_ComZvKlappenTo" 168 "DFC_ComaDirectChk_FX" 169 "DFC_ComaDirectCtr_FX" 170 "DFC_ComaDirectTo_FX" 171 "DFC_ComaSideChk_FX" 172 "DFC_ComaSideCtr_FX" 173 "DFC_ComaSideTo_FX" 174 "DFC_Cy320SpiCom" 175 "DFC_ETCtlDvtInrMax" 176 "DFC_ETCtlDvtInrMin" 177 "DFC_ETCtlDvtOutrMax" 178 "DFC_ETCtlDvtOutrMin" 179 "DFC_FBCqDvtMax" 180 "DFC_FBCqDvtMin" 181 "DFC_Fan4WinErr1" 182 "DFC_Fan4WinErr2" 183 "DFC_Fan4WinErr3" 184 "DFC_Fan4WinErr4" 185 "DFC_FanSCG" 186 "DFC_FlFCBS" 187 "DFC_GlwEcuConfigErr" 188 "DFC_GlwEcuEepErr" 189 "DFC_GlwEcuFrmErr" 190 "DFC_GlwEcuGPCMFaultInfo" 191 "DFC_GlwEcuGPCMInfo" 192 "DFC_GlwEcuGk1HSS" 193 "DFC_GlwEcuGk1OL" 194 "DFC_GlwEcuGk1SC" 195 "DFC_GlwEcuGk1Wdst" 196 "DFC_GlwEcuGk2HSS" 197 "DFC_GlwEcuGk2OL" 198 "DFC_GlwEcuGk2SC" 199 "DFC_GlwEcuGk2Wdst" 200 "DFC_GlwEcuGk3HSS" 201 "DFC_GlwEcuGk3OL" 202 "DFC_GlwEcuGk3SC" 203 "DFC_GlwEcuGk3Wdst" 204 "DFC_GlwEcuGk4HSS" 205 "DFC_GlwEcuGk4OL" 206 "DFC_GlwEcuGk4SC" 207 "DFC_GlwEcuGk4Wdst" 208 "DFC_GlwEcuGk5HSS" 209 "DFC_GlwEcuGk5OL" 210 "DFC_GlwEcuGk5SC" 211 "DFC_GlwEcuGk5Wdst" 212 "DFC_GlwEcuGk6HSS" 213 "DFC_GlwEcuGk6OL" 214 "DFC_GlwEcuGk6SC" 215 "DFC_GlwEcuGk6Wdst" 216 "DFC_GlwEcuGndErr" 217 "DFC_GlwEcuIntErr" 218 "DFC_GlwEcuMsgTimeout" 219 "DFC_GlwEcuT30Err" 220 "DFC_GlwEcuTempErr" 221 "DFC_GlwEcuUdiffT30" 222 "DFC_IBSComErr" 223 "DFC_LubSRCOilFldtCrit" 224 "DFC_LubSRCOilFldtCritDflMin" 225 "DFC_LubSRCOilLvlCritMax" 226 "DFC_LubSRCOilLvlCritMin" 227 "DFC_LubSRCTot" 228 "DFC_MonUMaxSupply1" 229 "DFC_MonUMinSupply1" 230 "DFC_OilComNpl" 231 "DFC_PCBS" 232 "DFC_PCBSPFltChg" 233 "DFC_PCRGovDvtLPMax" 234 "DFC_PCRGovDvtLPMin" 235 "DFC_PCRGovDvtMax" 236 "DFC_PCRGovDvtMin" 237 "DFC_PFltAPSPlausMAX" 238 "DFC_PFltAPSPlausMIN" 239 "DFC_PFltBPSPlausMAX" 240 "DFC_PFltBPSPlausMIN" 241 "DFC_PFltOvldInhRgn" 242 "DFC_PFltOvldTrqLim" 243 "DFC_PFltPresPlausMAX" 244 "DFC_PFltPresPlausMIN" 245 "DFC_PFltTraRpmRdc" 246 "DFC_PFlt_tOxiPreMax" 247 "DFC_PFlt_tOxiPreMaxRgn" 248 "DFC_PFlt_tOxiPreNpl" 249 "DFC_PFlt_tPreMax" 250 "DFC_PFlt_tPreMaxRgn" 251 "DFC_PFlt_tPreNpl" 252 "DFC_PFltmSotDiffMAX" 253 "DFC_PFltmSotDiffMIN" 254 "DFC_PFltmSotDiffSIG" 255 "DFC_PIntkVUsEnvPPls" 256 "DFC_PresPlausDblDef" 257 "DFC_RailCPC1" 258 "DFC_RailCPC3" 259 "DFC_RailCPC4" 260 "DFC_RailMeUn0" 261 "DFC_RailMeUn1" 262 "DFC_RailMeUn2" 263 "DFC_RailMeUn22" 264 "DFC_RailMeUn3" 265 "DFC_RailMeUn4" 266 "DFC_RailMeUn42" 267 "DFC_RailMeUn5" 268 "DFC_RailPCV0" 269 "DFC_RailPCV1" 270 "DFC_RailPCV2" 271 "DFC_RailPCV22" 272 "DFC_RailPCV3" 273 "DFC_RailPCV4" 274 "DFC_RailPCV42" 275 "DFC_RailPMonStrt" 276 "DFC_SSpMon1" 277 "DFC_SSpMon2" 278 "DFC_SSpMon3" 279 "DFC_ThrVlv4WinErr1" 280 "DFC_ThrVlv4WinErr2" 281 "DFC_ThrVlv4WinErr3" 282 "DFC_ThrVlv4WinErr4" 283 "DFC_ThrVlvSCG" 284 "DFC_Tle6232Spi1" 285 "DFC_TrbCh4WinErr1" 286 "DFC_TrbCh4WinErr2" 287 "DFC_TrbCh4WinErr3" 288 "DFC_TrbCh4WinErr4" 289 "DFC_TrbChSCG" 290 "DFC_TrbChSRCMax" 291 "DFC_TrbChSRCMin" 292 "DFC_WaHtEl4WinErr1" 293 "DFC_WaHtEl4WinErr2" 294 "DFC_WaHtEl4WinErr3" 295 "DFC_WaHtEl4WinErr4" 296 "DFC_WaHtElSCG" 297 "DFC_ETClbETFltMax_0" 298 "DFC_ETClbETFltMax_1" 299 "DFC_ETClbETFltMax_2" 300 "DFC_ETClbETFltMax_3" 301 "DFC_ETClbETFltMax_4" 302 "DFC_ETClbETFltMax_5" 303 "DFC_ETClbETFltMin_0" 304 "DFC_ETClbETFltMin_1" 305 "DFC_ETClbETFltMin_2" 306 "DFC_ETClbETFltMin_3" 307 "DFC_ETClbETFltMin_4" 308 "DFC_ETClbETFltMin_5" 309 "DFC_InjCrvInjLimChrgBal" 310 "DFC_InjCrvInjLimQntBal" 311 "DFC_InjCrvInjLimSys" 312 "DFC_InjCrvNumInjRtmLim" 313 "DFC_LSUHtCoupSig" 314 "DFC_AFS_SSpShOffOL" 315 "DFC_AFS_SSpShOffOvrTemp" 316 "DFC_AFS_SSpShOffSCB" 317 "DFC_AFS_SSpShOffSCG" 318 "DFC_AirCCmprOL" 319 "DFC_AirCCmprOvrTemp" 320 "DFC_AirCCmprSCB" 321 "DFC_AirCCmprSCG" 322 "DFC_CByVlvOL" 323 "DFC_CByVlvOvrTemp" 324 "DFC_CByVlvSCB" 325 "DFC_CByVlvSCG" 326 "DFC_CThmstOL" 327 "DFC_CThmstOvrTemp" 328 "DFC_CThmstSCB" 329 "DFC_CThmstSCG" 330 "DFC_DSMDummy" 331 "DFC_EBxFanOL" 332 "DFC_EBxFanOvrTemp" 333 "DFC_EBxFanSCB" 334 "DFC_EBxFanSCG" 335 "DFC_ECBVlvOL" 336 "DFC_ECBVlvOvrTemp" 337 "DFC_ECBVlvSCB" 338 "DFC_ECBVlvSCG" 339 "DFC_EMDmpOL_0" 340 "DFC_EMDmpOL_1" 341 "DFC_EMDmpOvrTemp_0" 342 "DFC_EMDmpOvrTemp_1" 343 "DFC_EMDmpSCB_0" 344 "DFC_EMDmpSCB_1" 345 "DFC_EMDmpSCG_0" 346 "DFC_EMDmpSCG_1" 347 "DFC_EngStAOL" 348 "DFC_EngStAOvrTemp" 349 "DFC_EngStASCB" 350 "DFC_EngStASCG" 351 "DFC_FanOL" 352 "DFC_FanOvrTemp" 353 "DFC_FanSCB" 354 "DFC_FlFltHtOL" 355 "DFC_FlFltHtOvrTemp" 356 "DFC_FlFltHtSCB" 357 "DFC_FlFltHtSCG" 358 "DFC_LSUHtrMax" 359 "DFC_LSUHtrMin" 360 "DFC_LSUHtrNpl" 361 "DFC_LSUHtrSig" 362 "DFC_LSUtExcMax" 363 "DFC_LSUtExcMin" 364 "DFC_MeUnOL" 365 "DFC_MeUnSCB" 366 "DFC_MeUnSRCMax" 367 "DFC_MeUnSRCMin" 368 "DFC_PCVOL" 369 "DFC_PCVSCB" 370 "DFC_PCVSRCMax" 371 "DFC_PCVSRCMin" 372 "DFC_RailPSRCMax" 373 "DFC_RailPSRCMin" 374 "DFC_ShtrOL" 375 "DFC_ShtrOvrTemp" 376 "DFC_ShtrSCB" 377 "DFC_ShtrSCG" 378 "DFC_StrtOL" 379 "DFC_StrtOvrTemp" 380 "DFC_StrtSCB" 381 "DFC_StrtSCG" 382 "DFC_ThrVlvOL" 383 "DFC_ThrVlvOvrTemp" 384 "DFC_ThrVlvSCB" 385 "DFC_TrbChOL" 386 "DFC_TrbChOvrTemp" 387 "DFC_TrbChSCB" 388 "DFC_UDosVlvOL" 389 "DFC_UDosVlvOvrTemp" 390 "DFC_UDosVlvSCB" 391 "DFC_UDosVlvSCG" 392 "DFC_UPmpMotOL" 393 "DFC_UPmpMotOvrTemp" 394 "DFC_UPmpMotSCB" 395 "DFC_UPmpMotSCG" 396 "DFC_WaHtElOL" 397 "DFC_WaHtElOvrTemp" 398 "DFC_WaHtElSCB" 399 "DFC_IVActrUChSRCMax" 400 "DFC_IVActrUChSRCMin" 401 "DFC_IVActrVltgSRCMax" 402 "DFC_IVActrVltgSRCMin" 403 "DFC_IVDiaTunDet" 404 "DFC_IVPSplyStopDCDC" 405 "DFC_IVPSplyVltgSRCMax" 406 "DFC_IVPSplyVltgSRCMin" 407 "DFC_SCREtaErr" 408 "DFC_SCREtaErr1" 409 "DFC_SCREtaErr2" 410 "DFC_SCRMonMetCtlPresErr" 411 "DFC_SCRMonPresBuildUpErr" 412 "DFC_SCRMonPresRdcErr" 413 "DFC_AFSOffsDrftMax" 414 "DFC_AFSOffsDrftMin" 415 "DFC_AFSSRCCorMax" 416 "DFC_AFSSRCCorMin" 417 "DFC_AFSSRCRawMax" 418 "DFC_AFSSRCRawMin" 419 "DFC_AFSSetyDrftMax" 420 "DFC_AFSSetyDrftMin" 421 "DFC_AirCSwtNpl" 422 "DFC_AirCSwtSig" 423 "DFC_BattUSRCMax" 424 "DFC_BattUSRCMin" 425 "DFC_BrkNpl" 426 "DFC_BrkPSRCMax" 427 "DFC_BrkPSRCMin" 428 "DFC_CEngDsTSRCMax" 429 "DFC_CEngDsTSRCMin" 430 "DFC_CrCUIDet" 431 "DFC_ECBVlvSRCMax" 432 "DFC_ECBVlvSRCMin" 433 "DFC_ECUOvrTemp" 434 "DFC_EGRVlvGovDvtMax" 435 "DFC_EGRVlvGovDvtMin" 436 "DFC_EGRVlvHBrgOpnLd" 437 "DFC_EGRVlvHBrgOvrCurr" 438 "DFC_EGRVlvHBrgOvrTemp" 439 "DFC_EGRVlvHBrgShCirBatt1" 440 "DFC_EGRVlvHBrgShCirBatt2" 441 "DFC_EGRVlvHBrgShCirGnd1" 442 "DFC_EGRVlvHBrgShCirGnd2" 443 "DFC_EGRVlvHBrgShCirOvrLd" 444 "DFC_EGRVlvHBrgTempOvrCurr" 445 "DFC_EGRVlvHBrgUndrVltg" 446 "DFC_EGRVlvLPGovDvtMax" 447 "DFC_EGRVlvLPGovDvtMin" 448 "DFC_EGRVlvLPHBrgOpnLd" 449 "DFC_EGRVlvLPHBrgOvrCurr" 450 "DFC_EGRVlvLPHBrgOvrTemp" 451 "DFC_EGRVlvLPHBrgShCirBatt1" 452 "DFC_EGRVlvLPHBrgShCirBatt2" 453 "DFC_EGRVlvLPHBrgShCirGnd1" 454 "DFC_EGRVlvLPHBrgShCirGnd2" 455 "DFC_EGRVlvLPHBrgShCirOvrLd" 456 "DFC_EGRVlvLPHBrgTempOvrCurr" 457 "DFC_EGRVlvLPHBrgUndrVltg" 458 "DFC_EGRVlvLPOL" 459 "DFC_EGRVlvLPSCB" 460 "DFC_EGRVlvLPSCG" 461 "DFC_EGRVlvLPSRCMax" 462 "DFC_EGRVlvLPSRCMin" 463 "DFC_EGRVlvOL" 464 "DFC_EGRVlvSCB" 465 "DFC_EGRVlvSCG" 466 "DFC_EGRVlvSRCMax" 467 "DFC_EGRVlvSRCMin" 468 "DFC_EngPrtOvrSpd" 469 "DFC_EngSpdOL" 470 "DFC_EngSpdSCB" 471 "DFC_EngSpdSCG" 472 "DFC_EnhSRCMaxPPFltDiff" 473 "DFC_EnhSRCMaxT1ExhTMon" 474 "DFC_EnhSRCMaxT2ExhTMon" 475 "DFC_EnhSRCMaxT3ExhTMon" 476 "DFC_EnhSRCMinPPFltDiff" 477 "DFC_EnhSRCMinT1ExhTMon" 478 "DFC_EnhSRCMinT2ExhTMon" 479 "DFC_EnhSRCMinT3ExhTMon" 480 "DFC_EnvPSRCMax" 481 "DFC_EnvPSRCMin" 482 "DFC_ExhTMonPlaus" 483 "DFC_ExhTMonPlausPos1" 484 "DFC_ExhTMonPlausPos2" 485 "DFC_ExhTMonPlausPos3" 486 "DFC_ExhTMonT1Plaus" 487 "DFC_ExhTMonT2Plaus" 488 "DFC_ExhTMonT3Plaus" 489 "DFC_FlFltDsPSRCMax" 490 "DFC_FlFltDsPSRCMin" 491 "DFC_FlFltSig" 492 "DFC_FlFltUsPSRCMax" 493 "DFC_FlFltUsPSRCMin" 494 "DFC_FuelTSRCMax" 495 "DFC_FuelTSRCMin" 496 "DFC_GbxNPosPPerSRCMax" 497 "DFC_GbxNPosPPerSRCMin" 498 "DFC_GbxNPosPdcycSRCMax" 499 "DFC_GbxNPosPdcycSRCMin" 500 "DFC_InjVlvPresMin" 501 "DFC_LSUCircNernstSig" 502 "DFC_LSUCircPmpCurSig" 503 "DFC_LSUCircVirtGndSig" 504 "DFC_LSUO2Max" 505 "DFC_LSUO2Min" 506 "DFC_LSUSPIBattLowMin" 507 "DFC_LSUWireSCB" 508 "DFC_LSUWireSCG" 509 "DFC_MeUnSCG" 510 "DFC_NSCDsCmpChk" 511 "DFC_NSCDsLamBinSRCMax" 512 "DFC_NSCDsLamBinSRCMin" 513 "DFC_NSCDsLamLinSRCMax" 514 "DFC_NSCDsLamLinSRCMin" 515 "DFC_NSCDsLamPlausMax" 516 "DFC_NSCDsLamPlausMin" 517 "DFC_NSCDsNOxSRCMax" 518 "DFC_NSCDsNOxSRCMin" 519 "DFC_NSCDsOpCir" 520 "DFC_NSCDsShCir" 521 "DFC_NoCat2DsCmpChk" 522 "DFC_NoCat2DsLamBinSRCMax" 523 "DFC_NoCat2DsLamBinSRCMin" 524 "DFC_NoCat2DsLamLinSRCMax" 525 "DFC_NoCat2DsLamLinSRCMin" 526 "DFC_NoCat2DsLamPlausMax" 527 "DFC_NoCat2DsLamPlausMin" 528 "DFC_NoCat2DsNOxSRCMax" 529 "DFC_NoCat2DsNOxSRCMin" 530 "DFC_NoCat2DsOpCir" 531 "DFC_NoCat2DsShCir" 532 "DFC_NplDynPPFltDiff" 533 "DFC_NplHsChngPPFltDiff" 534 "DFC_NplHsLnPPFltDiff" 535 "DFC_NplTOxiCatUs" 536 "DFC_NplTPFltUs" 537 "DFC_NplTTrbnUs" 538 "DFC_OilPSwmpSRCMax" 539 "DFC_OilPSwmpSRCMin" 540 "DFC_PCVSCG" 541 "DFC_PFltCharPDiffMin" 542 "DFC_PFltDstrMin" 543 "DFC_PFltEngPrt" 544 "DFC_PFltRgnPerm" 545 "DFC_PFltSRCMaxFlwRstn" 546 "DFC_PFltSRCMinFlwRstn" 547 "DFC_PFltSotMsDvtMax" 548 "DFC_PFltSotMsDvtMin" 549 "DFC_PFltSotMsMax" 550 "DFC_PIntkVUsSRCMax" 551 "DFC_PIntkVUsSRCMin" 552 "DFC_SRCHighAPP1" 553 "DFC_SRCHighAPP2" 554 "DFC_SRCLowAPP1" 555 "DFC_SRCLowAPP2" 556 "DFC_SRCMaxPPFltDiff" 557 "DFC_SRCMaxPPFltUs" 558 "DFC_SRCMaxTECU" 559 "DFC_SRCMaxTOxiCatUs" 560 "DFC_SRCMaxTPFltUs" 561 "DFC_SRCMaxTTrbnUs" 562 "DFC_SRCMaxUCatUsT" 563 "DFC_SRCMaxUPmpP" 564 "DFC_SRCMinPPFltDiff" 565 "DFC_SRCMinPPFltUs" 566 "DFC_SRCMinTECU" 567 "DFC_SRCMinTOxiCatUs" 568 "DFC_SRCMinTPFltUs" 569 "DFC_SRCMinTTrbnUs" 570 "DFC_SRCMinUCatUsT" 571 "DFC_SRCMinUPmpP" 572 "DFC_SigUCatUsT" 573 "DFC_SigUPmpP" 574 "DFC_SyncAPP" 575 "DFC_T15Npl" 576 "DFC_TAFSDtyCycHi" 577 "DFC_TAFSDtyCycLo" 578 "DFC_TAFSPerHi" 579 "DFC_TAFSPerLo" 580 "DFC_TCACDsSRCMax" 581 "DFC_TCACDsSRCMin" 582 "DFC_ThrVlvSRCMax" 583 "DFC_ThrVlvSRCMin" 584 "DFC_TrbChLPOL" 585 "DFC_TrbChLPSCB" 586 "DFC_TrbChLPSCG" 587 "DFC_UHtrPLOL" 588 "DFC_UHtrPLSCB" 589 "DFC_UHtrPLSCG" 590 "DFC_UHtrPLSRCMaxDia" 591 "DFC_UHtrPLSRCMinDia" 592 "DFC_UHtrTnkOL" 593 "DFC_UHtrTnkSCB" 594 "DFC_UHtrTnkSCG" 595 "DFC_UHtrTnkSRCMaxDia" 596 "DFC_UHtrTnkSRCMinDia" 597 "DFC_URevVlvOL" 598 "DFC_URevVlvSCB" 599 "DFC_URevVlvSCG" 600 "DFC_UTnkTSRCMax" 601 "DFC_UTnkTSRCMin" 602 "DFC_UTnkTSig" 603 "DFC_VSwVlvGovDvtMax" 604 "DFC_VSwVlvGovDvtMin" 605 "DFC_VSwVlvHBrgOpnLd" 606 "DFC_VSwVlvHBrgOvrCurr" 607 "DFC_VSwVlvHBrgOvrTemp" 608 "DFC_VSwVlvHBrgShCirBatt1" 609 "DFC_VSwVlvHBrgShCirBatt2" 610 "DFC_VSwVlvHBrgShCirGnd1" 611 "DFC_VSwVlvHBrgShCirGnd2" 612 "DFC_VSwVlvHBrgShCirOvrLd" 613 "DFC_VSwVlvHBrgTempOvrCurr" 614 "DFC_VSwVlvHBrgUndrVltg" 615 "DFC_VSwVlvOL" 616 "DFC_VSwVlvSCB" 617 "DFC_VSwVlvSCG" 618 "DFC_VSwVlvSRCMax" 619 "DFC_VSwVlvSRCMin" 620 "DFC_ClthNpl" 621 "DFC_ETClbETMax_0" 622 "DFC_ETClbETMax_1" 623 "DFC_ETClbETMax_2" 624 "DFC_ETClbETMax_3" 625 "DFC_ETClbETMax_4" 626 "DFC_ETClbETMax_5" 627 "DFC_ETClbETMin_0" 628 "DFC_ETClbETMin_1" 629 "DFC_ETClbETMin_2" 630 "DFC_ETClbETMin_3" 631 "DFC_ETClbETMin_4" 632 "DFC_ETClbETMin_5" 633 "DFC_IVActrEnrgMax_0" 634 "DFC_IVActrEnrgMax_1" 635 "DFC_IVActrEnrgMax_2" 636 "DFC_IVActrEnrgMax_3" 637 "DFC_IVActrEnrgMax_4" 638 "DFC_IVActrEnrgMax_5" 639 "DFC_IVActrEnrgMax_6" 640 "DFC_IVActrEnrgMax_7" 641 "DFC_IVActrEnrgMin_0" 642 "DFC_IVActrEnrgMin_1" 643 "DFC_IVActrEnrgMin_2" 644 "DFC_IVActrEnrgMin_3" 645 "DFC_IVActrEnrgMin_4" 646 "DFC_IVActrEnrgMin_5" 647 "DFC_IVActrEnrgMin_6" 648 "DFC_IVActrEnrgMin_7" 649 "DFC_IVActrEnrgPlaus_0" 650 "DFC_IVActrEnrgPlaus_1" 651 "DFC_IVActrEnrgPlaus_2" 652 "DFC_IVActrEnrgPlaus_3" 653 "DFC_IVActrEnrgPlaus_4" 654 "DFC_IVActrEnrgPlaus_5" 655 "DFC_IVActrEnrgPlaus_6" 656 "DFC_IVActrEnrgPlaus_7" 657 "DFC_IVCtlTiDiff_0" 658 "DFC_IVCtlTiDiff_1" 659 "DFC_IVCtlTiDiff_2" 660 "DFC_IVCtlTiDiff_3" 661 "DFC_IVCtlTiDiff_4" 662 "DFC_IVCtlTiDiff_5" 663 "DFC_IVCtlUDiffUp_0" 664 "DFC_IVCtlUDiffUp_1" 665 "DFC_IVCtlUDiffUp_2" 666 "DFC_IVCtlUDiffUp_3" 667 "DFC_IVCtlUDiffUp_4" 668 "DFC_IVCtlUDiffUp_5" 669 "DFC_IVCtlUUp_0" 670 "DFC_IVCtlUUp_1" 671 "DFC_IVCtlUUp_2" 672 "DFC_IVCtlUUp_3" 673 "DFC_IVCtlUUp_4" 674 "DFC_IVCtlUUp_5" 675 "DFC_IVDiaBnkShCir_0" 676 "DFC_IVDiaBnkShCir_1" 677 "DFC_IVDiaBnkShCirChSwt_0" 678 "DFC_IVDiaBnkShCirChSwt_1" 679 "DFC_IVDiaChp_0" 680 "DFC_IVDiaChp_1" 681 "DFC_IVDiaCylNoCls_0" 682 "DFC_IVDiaCylNoCls_1" 683 "DFC_IVDiaCylNoCls_2" 684 "DFC_IVDiaCylNoCls_3" 685 "DFC_IVDiaCylNoCls_4" 686 "DFC_IVDiaCylNoCls_5" 687 "DFC_IVDiaCylNoLd_0" 688 "DFC_IVDiaCylNoLd_1" 689 "DFC_IVDiaCylNoLd_2" 690 "DFC_IVDiaCylNoLd_3" 691 "DFC_IVDiaCylNoLd_4" 692 "DFC_IVDiaCylNoLd_5" 693 "DFC_IVDiaCylShCir_0" 694 "DFC_IVDiaCylShCir_1" 695 "DFC_IVDiaCylShCir_2" 696 "DFC_IVDiaCylShCir_3" 697 "DFC_IVDiaCylShCir_4" 698 "DFC_IVDiaCylShCir_5" 699 "DFC_IVDiaCylShCirHSLS_0" 700 "DFC_IVDiaCylShCirHSLS_1" 701 "DFC_IVDiaCylShCirHSLS_2" 702 "DFC_IVDiaCylShCirHSLS_3" 703 "DFC_IVDiaCylShCirHSLS_4" 704 "DFC_IVDiaCylShCirHSLS_5" 705 "DFC_IVDiaCylShCirMeas_0" 706 "DFC_IVDiaCylShCirMeas_1" 707 "DFC_IVDiaCylShCirMeas_2" 708 "DFC_IVDiaCylShCirMeas_3" 709 "DFC_IVDiaCylShCirMeas_4" 710 "DFC_IVDiaCylShCirMeas_5" 711 "DFC_LSUDynChk" 712 "DFC_LSUO2ClbMax" 713 "DFC_LSUO2ClbMin" 714 "DFC_LSUO2PlausMaxFLd" 715 "DFC_LSUO2PlausMaxOvrRun" 716 "DFC_LSUO2PlausMaxPartLd" 717 "DFC_LSUO2PlausMinFLd" 718 "DFC_LSUO2PlausMinOvrRun" 719 "DFC_LSUO2PlausMinPartLd" 720 "DFC_LSURiClbMax" 721 "DFC_LSURiClbMin" 722 "DFC_LSUWireIPSig" 723 "DFC_Layer_BSDMax" 724 "DFC_Layer_BSDMin" 725 "DFC_Layer_BSDNpl" 726 "DFC_Layer_BSDSig" 727 "DFC_Layer_FltMngTstMax" 728 "DFC_Layer_FltMngTstMin" 729 "DFC_Layer_FltMngTstNpl" 730 "DFC_Layer_FltMngTstSig" 731 "DFC_Layer_GENELBMax" 732 "DFC_Layer_GENELBMin" 733 "DFC_Layer_GENELBNpl" 734 "DFC_Layer_GENELBSig" 735 "DFC_Layer_GENELMax" 736 "DFC_Layer_GENELMin" 737 "DFC_Layer_GENELNpl" 738 "DFC_Layer_GENELSig" 739 "DFC_Layer_GENHTBMax" 740 "DFC_Layer_GENHTBMin" 741 "DFC_Layer_GENHTBNpl" 742 "DFC_Layer_GENHTBSig" 743 "DFC_Layer_GENHTMax" 744 "DFC_Layer_GENHTMin" 745 "DFC_Layer_GENHTNpl" 746 "DFC_Layer_GENHTSig" 747 "DFC_Layer_GENKOMMMax" 748 "DFC_Layer_GENKOMMMin" 749 "DFC_Layer_GENKOMMNpl" 750 "DFC_Layer_GENKOMMSig" 751 "DFC_Layer_GENMECHMax" 752 "DFC_Layer_GENMECHMin" 753 "DFC_Layer_GENMECHNpl" 754 "DFC_Layer_GENMECHSig" 755 "DFC_Layer_GENMax" 756 "DFC_Layer_GENMin" 757 "DFC_Layer_GENNpl" 758 "DFC_Layer_GENREGUPLMax" 759 "DFC_Layer_GENREGUPLMin" 760 "DFC_Layer_GENREGUPLNpl" 761 "DFC_Layer_GENREGUPLSig" 762 "DFC_Layer_GENSig" 763 "DFC_Layer_GENUPLMax" 764 "DFC_Layer_GENUPLMin" 765 "DFC_Layer_GENUPLNpl" 766 "DFC_Layer_GENUPLSig" 767 "DFC_Layer_IBS1Max" 768 "DFC_Layer_IBS1Min" 769 "DFC_Layer_IBS1Npl" 770 "DFC_Layer_IBS1Sig" 771 "DFC_Layer_IBS2Max" 772 "DFC_Layer_IBS2Min" 773 "DFC_Layer_IBS2Npl" 774 "DFC_Layer_IBS2Sig" 775 "DFC_Layer_IBS3Max" 776 "DFC_Layer_IBS3Min" 777 "DFC_Layer_IBS3Npl" 778 "DFC_Layer_IBS3Sig" 779 "DFC_Layer_MANDETEKMax" 780 "DFC_Layer_MANDETEKMin" 781 "DFC_Layer_MANDETEKNpl" 782 "DFC_Layer_MANDETEKSig" 783 "DFC_Layer_NDR1Max" 784 "DFC_Layer_NDR1Min" 785 "DFC_Layer_NDR1Npl" 786 "DFC_Layer_NDR1Sig" 787 "DFC_Layer_NDR2Max" 788 "DFC_Layer_NDR2Min" 789 "DFC_Layer_NDR2Npl" 790 "DFC_Layer_NDR2Sig" 791 "DFC_Layer_NGLERNMax" 792 "DFC_Layer_NGLERNMin" 793 "DFC_Layer_NGLERNNpl" 794 "DFC_Layer_NGLERNSig" 795 "DFC_Layer_PMBATTMax" 796 "DFC_Layer_PMBATTMin" 797 "DFC_Layer_PMBATTNpl" 798 "DFC_Layer_PMBATTSig" 799 "DFC_Layer_PMBNMax" 800 "DFC_Layer_PMBNMin" 801 "DFC_Layer_PMBNNpl" 802 "DFC_Layer_PMBNSig" 803 "DFC_Layer_PMRUHVERLMax" 804 "DFC_Layer_PMRUHVERLMin" 805 "DFC_Layer_PMRUHVERLNpl" 806 "DFC_Layer_PMRUHVERLSig" 807 "DFC_Layer_QLTMax" 808 "DFC_Layer_QLTMin" 809 "DFC_Layer_QLTNpl" 810 "DFC_Layer_QLTSig" 811 "DFC_Layer_TOENSMax" 812 "DFC_Layer_TOENSMin" 813 "DFC_Layer_TOENSNpl" 814 "DFC_Layer_TOENSSig" 815 "DFC_MonLimCurr" 816 "DFC_MonLimLead" 817 "DFC_MonLimSet" 818 "DFC_NSCDsNOxOfsMax" 819 "DFC_NSCDsNOxOfsMin" 820 "DFC_NSCDsNOxPlausMin" 821 "DFC_NoCat2DsNOxOfsMax" 822 "DFC_NoCat2DsNOxOfsMin" 823 "DFC_NoCat2DsNOxPlausMin" 824 "DFC_PCVNoStrt" 825 "DFC_RailPGradMon" 826 "DFC_SCRPODPresBuildUp" 827 "DFC_AFSDrftIdlAdjVal" 828 "DFC_AFSDrftLdAdjVal" 829 "DFC_AdcIADC0Cal" 830 "DFC_AdcIADC0Conv" 831 "DFC_AdcIADC1Cal" 832 "DFC_AdcIADC1Conv" 833 "DFC_CmbChbMisfireMax_0" 834 "DFC_CmbChbMisfireMax_1" 835 "DFC_CmbChbMisfireMax_2" 836 "DFC_CmbChbMisfireMax_3" 837 "DFC_CmbChbMisfireMax_4" 838 "DFC_CmbChbMisfireMax_5" 839 "DFC_CmbChbMisfireMul" 840 "DFC_EGRVlvLPOfsNeutr" 841 "DFC_EGRVlvOfsNeutr" 842 "DFC_FMAErrModMax" 843 "DFC_FMAErrModMin" 844 "DFC_FlSysTnkLo" 845 "DFC_GbxNPosPlaus" 846 "DFC_I14229_ROETst_Appl" 847 "DFC_I14229_ROETst_Netw" 848 "DFC_I14229_ROE_BufFull" 849 "DFC_IVAdjDiaIVAdj" 850 "DFC_IVAdjIVA_0" 851 "DFC_IVAdjIVA_1" 852 "DFC_IVAdjIVA_2" 853 "DFC_IVAdjIVA_3" 854 "DFC_IVAdjIVA_4" 855 "DFC_IVAdjIVA_5" 856 "DFC_IVPSplyDCDCOff_0" 857 "DFC_IVPSplyDCDCOff_1" 858 "DFC_IVPSplyDCDCOff_2" 859 "DFC_IVPSplyDCDCOff_3" 860 "DFC_InjCtlAdjQntEEPCS" 861 "DFC_LSUSPISig" 862 "DFC_Layer_Dummy" 863 "DFC_NplEnvPSensPPFltDiff" 864 "DFC_NplPresSensPPFltDiff" 865 "DFC_OilLvlPlaus" 866 "DFC_OilTOutLvl" 867 "DFC_PCVfacAdaptMax" 868 "DFC_PCVfacAdaptMin" 869 "DFC_SensFrzPPFltUs" 870 "DFC_SensMonUTnkLvl" 871 "DFC_T15Sig" 872 "DFC_AirCtlRmpTOut" 873 "DFC_BrkPPlaus" 874 "DFC_CEngDsTDynTst" 875 "DFC_EEPEraseErr" 876 "DFC_EEPRdErr" 877 "DFC_EEPWrErr" 878 "DFC_EGRVlvJamVlvClsd" 879 "DFC_EGRVlvJamVlvOpn" 880 "DFC_EGRVlvLPJamVlvClsd" 881 "DFC_EGRVlvLPJamVlvOpn" 882 "DFC_EGRVlvLPLgTDrft" 883 "DFC_EGRVlvLPOfsLrnJamVlv" 884 "DFC_EGRVlvLPShTDrft" 885 "DFC_EGRVlvLgTDrft" 886 "DFC_EGRVlvOfsLrnJamVlv" 887 "DFC_EGRVlvShTDrft" 888 "DFC_EngICO" 889 "DFC_EpmCaSI1ErrSig" 890 "DFC_EpmCaSI1NoSig" 891 "DFC_EpmCaSI1OfsErr" 892 "DFC_EpmCrSErrSig" 893 "DFC_EpmCrSNoSig" 894 "DFC_IVPlausComprTst" 895 "DFC_IVPlausRunUpTst" 896 "DFC_InjCrvShOffTst" 897 "DFC_LayerEnSavModProd" 898 "DFC_LayerEnSavModRep" 899 "DFC_LayerEnSavModShip" 900 "DFC_MRlyErlyOpng" 901 "DFC_MRlyStk" 902 "DFC_MeUnActrTst" 903 "DFC_MoCADCCmp" 904 "DFC_MoCADCTst" 905 "DFC_MoCADCVltgRatio" 906 "DFC_MoCComErrCnt" 907 "DFC_MoCComSPI" 908 "DFC_MoCROMErrXPg" 909 "DFC_MoCSOPHwNoRdy" 910 "DFC_MoCSOPLoLi" 911 "DFC_MoCSOPMM" 912 "DFC_MoCSOPTimeOut" 913 "DFC_MoCSOPUpLi" 914 "DFC_MoFAPP" 915 "DFC_MoFESpd" 916 "DFC_MoFInjDatPhi" 917 "DFC_MoFInjDatQnt" 918 "DFC_MoFInjQnt" 919 "DFC_MoFMode1PoI1" 920 "DFC_MoFMode1PoI2" 921 "DFC_MoFMode2PoI1" 922 "DFC_MoFMode2PoI2" 923 "DFC_MoFOvR" 924 "DFC_MoFQntCor" 925 "DFC_MoFRailP" 926 "DFC_MoFTrqCmp" 927 "DFC_NSCDsHtrSetP" 928 "DFC_NoCat2DsHtrSetP" 929 "DFC_PCVActrTst" 930 "DFC_PhyModNonMonMapNpl" 931 "DFC_RailHpTst" 932 "DFC_RailPOfsTstMax" 933 "DFC_RailPOfsTstMin" 934 "DFC_SIA_E1max" 935 "DFC_SIA_E1min" 936 "DFC_SIA_E1npl" 937 "DFC_SIA_E1sig" 938 "DFC_SIA_E2max" 939 "DFC_SIA_E2min" 940 "DFC_SIA_E2npl" 941 "DFC_SIA_E2sig" 942 "DFC_SIA_E3max" 943 "DFC_SIA_E3min" 944 "DFC_SIA_E3npl" 945 "DFC_SIA_E3sig" 946 "DFC_SIA_E4max" 947 "DFC_SIA_E4min" 948 "DFC_SIA_E4npl" 949 "DFC_SIA_E4sig" 950 "DFC_SWReset_0" 951 "DFC_SWReset_1" 952 "DFC_SWReset_2" 953 "DFC_ShtrAKKMax" 954 "DFC_ShtrAKKMin" 955 "DFC_ShtrAKKNpl" 956 "DFC_ShtrPKKMax" 957 "DFC_StopCntTmr" 958 "DFC_ThrVlvMon" 959 "DFC_VSwVlvJamVlv" 960 "DFC_VSwVlvLgTDrft" 961 "DFC_VSwVlvOfsLrnJamVlv" 962 "DFC_VSwVlvOfsNeutr" 963 "DFC_VSwVlvShTDrft" 964 "DFC_VSwVlvSpgDef" 965 "DSQ_AFS" 966 "DSQ_AFS_SSpShOffActr" 967 "DSQ_AirCCmprActr" 968 "DSQ_BattU" 969 "DSQ_BrkP" 970 "DSQ_CByVlvActr" 971 "DSQ_CEngDsT" 972 "DSQ_CThmstActr" 973 "DSQ_Com_aDirect" 974 "DSQ_Com_aSide" 975 "DSQ_Com_ctrDay" 976 "DSQ_Com_ctrSec" 977 "DSQ_Com_ctrSecAbs" 978 "DSQ_Com_dDay" 979 "DSQ_Com_dMonth" 980 "DSQ_Com_dYear" 981 "DSQ_Com_dphiStWhlAg" 982 "DSQ_Com_dvolPspDes" 983 "DSQ_Com_iHiLimCurr" 984 "DSQ_Com_iLoLimCurr" 985 "DSQ_Com_iPsp" 986 "DSQ_Com_iZrLimCurr" 987 "DSQ_Com_idParkConsumer" 988 "DSQ_Com_idVerbraucher" 989 "DSQ_Com_lFlTnkQntLow" 990 "DSQ_Com_lSum" 991 "DSQ_Com_nDKG" 992 "DSQ_Com_nGbxOut" 993 "DSQ_Com_nPsp" 994 "DSQ_Com_nRqIdlg" 995 "DSQ_Com_nTSC" 996 "DSQ_Com_nWhl" 997 "DSQ_Com_nWhlFL" 998 "DSQ_Com_nWhlFR" 999 "DSQ_Com_nWhlRL" 1000 "DSQ_Com_nWhlRR" 1001 "DSQ_Com_pBrkSys" 1002 "DSQ_Com_phiStWhlAg" 1003 "DSQ_Com_rACFanDem" 1004 "DSQ_Com_rHtFlowReq" 1005 "DSQ_Com_rLamLinRecGndRaw" 1006 "DSQ_Com_rLamLinRecUbattRaw" 1007 "DSQ_Com_rNOxCat2DsGndRaw" 1008 "DSQ_Com_rNOxCat2DsUbattRaw" 1009 "DSQ_Com_rPspSetPoint" 1010 "DSQ_Com_rPwrSpCons" 1011 "DSQ_Com_rTrq" 1012 "DSQ_Com_stAC" 1013 "DSQ_Com_stACEFan" 1014 "DSQ_Com_stARS" 1015 "DSQ_Com_stAcpd" 1016 "DSQ_Com_stBattClass" 1017 "DSQ_Com_stBonnet" 1018 "DSQ_Com_stBrkTrqDVCHQl" 1019 "DSQ_Com_stButtonMSA" 1020 "DSQ_Com_stCat2DsGndRaw" 1021 "DSQ_Com_stCat2DsUbattRaw" 1022 "DSQ_Com_stClCtr" 1023 "DSQ_Com_stClassPwr" 1024 "DSQ_Com_stClth" 1025 "DSQ_Com_stClthOpen" 1026 "DSQ_Com_stClthRaw" 1027 "DSQ_Com_stCrCtlKombi" 1028 "DSQ_Com_stCrCtlLvr" 1029 "DSQ_Com_stDSC" 1030 "DSQ_Com_stDecellDSC" 1031 "DSQ_Com_stDiagPsp" 1032 "DSQ_Com_stDoorDriver" 1033 "DSQ_Com_stDrWghSeat" 1034 "DSQ_Com_stDrvAssist" 1035 "DSQ_Com_stDrvDyn" 1036 "DSQ_Com_stDrvPrgQl" 1037 "DSQ_Com_stDynDisp" 1038 "DSQ_Com_stEngStop" 1039 "DSQ_Com_stErrAFS" 1040 "DSQ_Com_stErrStrg" 1041 "DSQ_Com_stFlTnkQntRes" 1042 "DSQ_Com_stFolDyn" 1043 "DSQ_Com_stGbxOBD" 1044 "DSQ_Com_stGear" 1045 "DSQ_Com_stGearBck" 1046 "DSQ_Com_stHDC" 1047 "DSQ_Com_stKeyVld" 1048 "DSQ_Com_stLckGbxDemQl" 1049 "DSQ_Com_stLmpPrkBrk" 1050 "DSQ_Com_stMSALmp" 1051 "DSQ_Com_stModDKG" 1052 "DSQ_Com_stNOxErrGndRaw" 1053 "DSQ_Com_stNOxErrUbattRaw" 1054 "DSQ_Com_stPBrComf" 1055 "DSQ_Com_stPBrHold" 1056 "DSQ_Com_stPBrHyd" 1057 "DSQ_Com_stPBrkSysQl" 1058 "DSQ_Com_stPHtr" 1059 "DSQ_Com_stParkConsumer" 1060 "DSQ_Com_stPsp" 1061 "DSQ_Com_stPspCntr" 1062 "DSQ_Com_stRaceStrt" 1063 "DSQ_Com_stReqMSA" 1064 "DSQ_Com_stRevGear" 1065 "DSQ_Com_stSTEQl" 1066 "DSQ_Com_stSeason" 1067 "DSQ_Com_stShftIdctrDemRglX" 1068 "DSQ_Com_stShiftPdl" 1069 "DSQ_Com_stShutOffPSP" 1070 "DSQ_Com_stSleepBus" 1071 "DSQ_Com_stSleepConst" 1072 "DSQ_Com_stSleepDest" 1073 "DSQ_Com_stSleepRdy" 1074 "DSQ_Com_stStrg" 1075 "DSQ_Com_stStrtClth" 1076 "DSQ_Com_stStrtLck" 1077 "DSQ_Com_stT15" 1078 "DSQ_Com_stT15Hw" 1079 "DSQ_Com_stT50" 1080 "DSQ_Com_stTRadio" 1081 "DSQ_Com_stTSC" 1082 "DSQ_Com_stTerminal" 1083 "DSQ_Com_stTrailer" 1084 "DSQ_Com_stTrqAFS" 1085 "DSQ_Com_stTrqDSCDes" 1086 "DSQ_Com_stTrqFil" 1087 "DSQ_Com_stTrqGbxDes" 1088 "DSQ_Com_stTrqGbxLim" 1089 "DSQ_Com_stTrqStbDesQl" 1090 "DSQ_Com_stTrqStrg" 1091 "DSQ_Com_stTrqWhl" 1092 "DSQ_Com_stTrqWhlDemFASQl" 1093 "DSQ_Com_stTrqWhlDesQl" 1094 "DSQ_Com_stTypBody" 1095 "DSQ_Com_stUnVel" 1096 "DSQ_Com_stVehCond" 1097 "DSQ_Com_stVehDrvCond" 1098 "DSQ_Com_stVerbraucher" 1099 "DSQ_Com_stphiStWhlAg" 1100 "DSQ_Com_swtAC" 1101 "DSQ_Com_swtDrBltb" 1102 "DSQ_Com_tEnvT" 1103 "DSQ_Com_tGbxOil" 1104 "DSQ_Com_tiPostRunPwrSpl" 1105 "DSQ_Com_trqAC" 1106 "DSQ_Com_trqAFS" 1107 "DSQ_Com_trqAFSDes" 1108 "DSQ_Com_trqARSCur" 1109 "DSQ_Com_trqARSDes" 1110 "DSQ_Com_trqAdjrDKG" 1111 "DSQ_Com_trqBrkDVCH" 1112 "DSQ_Com_trqClthDKG" 1113 "DSQ_Com_trqDSCDes" 1114 "DSQ_Com_trqDVCHRise" 1115 "DSQ_Com_trqGbxDes" 1116 "DSQ_Com_trqGbxFrc" 1117 "DSQ_Com_trqGbxMax" 1118 "DSQ_Com_trqGbxMaxRaw" 1119 "DSQ_Com_trqStbDes" 1120 "DSQ_Com_trqStrg" 1121 "DSQ_Com_trqStrgDes" 1122 "DSQ_Com_trqTarDKG" 1123 "DSQ_Com_trqTarDrvDyn" 1124 "DSQ_Com_trqTarDrvDynDes" 1125 "DSQ_Com_trqTarDrvDynMax" 1126 "DSQ_Com_trqWhlDes" 1127 "DSQ_Com_uLamBinGndRaw" 1128 "DSQ_Com_uLamBinUbattRaw" 1129 "DSQ_Com_uPsp" 1130 "DSQ_Com_uT30Psp" 1131 "DSQ_Com_v" 1132 "DSQ_Com_vBd" 1133 "DSQ_Com_vDspl" 1134 "DSQ_Com_vVeh" 1135 "DSQ_Com_volFlTnkQnt" 1136 "DSQ_Com_volFlTnkQntLH" 1137 "DSQ_Com_volFlTnkQntRH" 1138 "DSQ_DSMInhibitAlways" 1139 "DSQ_EBxFan" 1140 "DSQ_ECBVlvActr" 1141 "DSQ_ECBVlvSens" 1142 "DSQ_EGRVlvActr" 1143 "DSQ_EGRVlvLPActr" 1144 "DSQ_EGRVlvLPSens" 1145 "DSQ_EGRVlvSens" 1146 "DSQ_EMDmp_0" 1147 "DSQ_EMDmp_1" 1148 "DSQ_EngPrtFWOsc" 1149 "DSQ_EngStAActr" 1150 "DSQ_EnvP" 1151 "DSQ_EnvT" 1152 "DSQ_ErrLmpActrMIL" 1153 "DSQ_ErrLmpActrSVS" 1154 "DSQ_FanActr" 1155 "DSQ_FlFltDsP" 1156 "DSQ_FlFltHtActr" 1157 "DSQ_FlFltUsP" 1158 "DSQ_FuelLvl_vol" 1159 "DSQ_FuelT" 1160 "DSQ_GbxNPosPls" 1161 "DSQ_IVDiast" 1162 "DSQ_InjVlvInjCo" 1163 "DSQ_InjVlvPresMin" 1164 "DSQ_LAYER2EDCMSAStp" 1165 "DSQ_LSUO2" 1166 "DSQ_Layer_rCtrPwrSpCos" 1167 "DSQ_MRly" 1168 "DSQ_MeUnActr" 1169 "DSQ_NSCDsRLamO2" 1170 "DSQ_NoCat2DsO2Val" 1171 "DSQ_O2ValNSCDs" 1172 "DSQ_O2ValNoCat2Ds" 1173 "DSQ_OilPSwmp" 1174 "DSQ_PCVActr" 1175 "DSQ_PIntkVUs" 1176 "DSQ_PPFltDiff" 1177 "DSQ_PPFltUs" 1178 "DSQ_RailShutOffDblCtl" 1179 "DSQ_RailShutOffMeUnCtl" 1180 "DSQ_SOPTstInjShOff" 1181 "DSQ_ShtrActr" 1182 "DSQ_StrtActr" 1183 "DSQ_TAFS" 1184 "DSQ_TCACDs" 1185 "DSQ_TECU" 1186 "DSQ_TOxiCatUs" 1187 "DSQ_TPFltUs" 1188 "DSQ_TTrbnUs" 1189 "DSQ_ThrVlvActr" 1190 "DSQ_ThrVlvSens" 1191 "DSQ_TrbChActr" 1192 "DSQ_TrbChLPActr" 1193 "DSQ_TrbChSens" 1194 "DSQ_TrbnDsRLamO2" 1195 "DSQ_UCatUsT" 1196 "DSQ_UDosVlvActr" 1197 "DSQ_UHtrPL" 1198 "DSQ_UHtrPLDia" 1199 "DSQ_UHtrTnk" 1200 "DSQ_UHtrTnkDia" 1201 "DSQ_UPmpMotActr" 1202 "DSQ_UPmpP" 1203 "DSQ_URevVlv" 1204 "DSQ_UTnkLvl" 1205 "DSQ_UTnkT" 1206 "DSQ_VSwVlvActr" 1207 "DSQ_VSwVlvSens" 1208 "DSQ_WaHtElActr" 1209 "DSQ_stAPP" 1210 "DSQ_stAPP1" 1211 "DSQ_stAPP2" 1212 "DSQ_stLSUSrvTstDem" 1213 "DSQ_stSrvOpLSUAdap" DEFAULT_VALUE "---" /end COMPU_VTAB
/begin COMPU_METHOD DFC_OneToOne "" RAT_FUNC "%6.0" "-" COEFFS 0 1 0 0 0 1 /end COMPU_METHOD
/begin COMPU_METHOD DFES_OneToOne "" RAT_FUNC "%6.0" "-" COEFFS 0 1 0 0 0 1 /end COMPU_METHOD
/begin COMPU_METHOD DFES_stCheck_Verb "" TAB_VERB "%6.3" "-" COMPU_TAB_REF DFES_stCheck_Verb /end COMPU_METHOD
/begin COMPU_VTAB DFES_stCheck_Verb "" TAB_VERB 128 0 "OkNoTst" 1 "OkTested" 2 "OkHealed" 3 "OkRstNoTst" 4 "DefectNoTst" 5 "DefectDelay" 6 "Defect" 7 "DefectRstNoTst" 16 "SC_OkNoTst" 17 "SC_OkTested" 18 "SC_OkHealed" 19 "SC_OkRstNoTst" 20 "SC_DefectNoTst" 21 "SC_DefectDelay" 22 "SC_Defect" 23 "SC_DefectRstNoTst" 32 "FC_OkNoTst" 33 "FC_OkTested" 34 "FC_OkHealed" 35 "FC_OkRstNoTst" 36 "FC_DefectNoTst" 37 "FC_DefectDelay" 38 "FC_Defect" 39 "FC_DefectRstNoTst" 48 "FC_SC_OkNoTst" 49 "FC_SC_OkTested" 50 "FC_SC_OkHealed" 51 "FC_SC_OkRstNoTst" 52 "FC_SC_DefectNoTst" 53 "FC_SC_DefectDelay" 54 "FC_SC_Defect" 55 "FC_SC_DefectRstNoTst" 64 "_OkNoTst" 65 "_OkTested" 66 "_OkHealed" 67 "_OkRstNoTst" 68 "_DefectNoTst" 69 "_DefectDelay" 70 "_Defect" 71 "_DefectRstNoTst" 80 "_SC_OkNoTst" 81 "_SC_OkTested" 82 "_SC_OkHealed" 83 "_SC_OkRstNoTst" 84 "_SC_DefectNoTst" 85 "_SC_DefectDelay" 86 "_SC_Defect" 87 "_SC_DefectRstNoTst" 96 "_FC_OkNoTst" 97 "_FC_OkTested" 98 "_FC_OkHealed" 99 "_FC_OkRstNoTst" 100 "_FC_DefectNoTst" 101 "_FC_DefectDelay" 102 "_FC_Defect" 103 "_FC_DefectRstNoTst" 112 "_FC_SC_OkNoTst" 113 "_FC_SC_OkTested" 114 "_FC_SC_OkHealed" 115 "_FC_SC_OkRstNoTst" 116 "_FC_SC_DefectNoTst" 117 "_FC_SC_DefectDelay" 118 "_FC_SC_Defect" 119 "_FC_SC_DefectRstNoTst" 128 "-OkNoTst" 129 "-OkTested" 130 "-OkHealed" 131 "-OkRstNoTst" 132 "-DefectNoTst" 133 "-DefectDelay" 134 "-Defect" 135 "-DefectRstNoTst" 144 "-SC_OkNoTst" 145 "-SC_OkTested" 146 "-SC_OkHealed" 147 "-SC_OkRstNoTst" 148 "-SC_DefectNoTst" 149 "-SC_DefectDelay" 150 "-SC_Defect" 151 "-SC_DefectRstNoTst" 160 "-FC_OkNoTst" 161 "-FC_OkTested" 162 "-FC_OkHealed" 163 "-FC_OkRstNoTst" 164 "-FC_DefectNoTst" 165 "-FC_DefectDelay" 166 "-FC_Defect" 167 "-FC_DefectRstNoTst" 176 "-FC_SC_OkNoTst" 177 "-FC_SC_OkTested" 178 "-FC_SC_OkHealed" 179 "-FC_SC_OkRstNoTst" 180 "-FC_SC_DefectNoTst" 181 "-FC_SC_DefectDelay" 182 "-FC_SC_Defect" 183 "-FC_SC_DefectRstNoTst" 192 "-_OkNoTst" 193 "-_OkTested" 194 "-_OkHealed" 195 "-_OkRstNoTst" 196 "-_DefectNoTst" 197 "-_DefectDelay" 198 "-_Defect" 199 "-_DefectRstNoTst" 208 "-_SC_OkNoTst" 209 "-_SC_OkTested" 210 "-_SC_OkHealed" 211 "-_SC_OkRstNoTst" 212 "-_SC_DefectNoTst" 213 "-_SC_DefectDelay" 214 "-_SC_Defect" 215 "-_SC_DefectRstNoTst" 224 "-_FC_OkNoTst" 225 "-_FC_OkTested" 226 "-_FC_OkHealed" 227 "-_FC_OkRstNoTst" 228 "-_FC_DefectNoTst" 229 "-_FC_DefectDelay" 230 "-_FC_Defect" 231 "-_FC_DefectRstNoTst" 240 "-_FC_SC_OkNoTst" 241 "-_FC_SC_OkTested" 242 "-_FC_SC_OkHealed" 243 "-_FC_SC_OkRstNoTst" 244 "-_FC_SC_DefectNoTst" 245 "-_FC_SC_DefectDelay" 246 "-_FC_SC_Defect" 247 "-_FC_SC_DefectRstNoTst" /end COMPU_VTAB
/begin COMPU_METHOD DFES_stCnt_Verb "" TAB_VERB "%6.3" "-" COMPU_TAB_REF DFES_stCnt_Verb /end COMPU_METHOD
/begin COMPU_VTAB DFES_stCnt_Verb "" TAB_VERB 36 0 "SVS_NONE__MIL_NONE" 1 "SVS_NONE__MIL_HLC_TRG" 2 "SVS_NONE__MIL_HLC_ELAP" 3 "SVS_NONE__MIL_FLC_CNT" 4 "SVS_NONE__MIL_FLC_TIME" 5 "SVS_NONE__MIL_HLC_TIME" 16 "SVS_HLC_TRG__MIL_NONE" 17 "SVS_HLC_TRG__MIL_HLC_TRG" 18 "SVS_HLC_TRG__MIL_HLC_ELAP" 19 "SVS_HLC_TRG__MIL_FLC_CNT" 20 "SVS_HLC_TRG__MIL_FLC_TIME" 21 "SVS_HLC_TRG__MIL_HLC_TIME" 32 "SVS_HLC_ELAP__MIL_NONE" 33 "SVS_HLC_ELAP__MIL_HLC_TRG" 34 "SVS_HLC_ELAP__MIL_HLC_ELAP" 35 "SVS_HLC_ELAP__MIL_FLC_CNT" 36 "SVS_HLC_ELAP__MIL_FLC_TIME" 37 "SVS_HLC_ELAP__MIL_HLC_TIME" 48 "SVS_FLC_CNT__MIL_NONE" 49 "SVS_FLC_CNT__MIL_HLC_TRG" 50 "SVS_FLC_CNT__MIL_HLC_ELAP" 51 "SVS_FLC_CNT__MIL_FLC_CNT" 52 "SVS_FLC_CNT__MIL_FLC_TIME" 53 "SVS_FLC_CNT__MIL_HLC_TIME" 64 "SVS_FLC_TIME__MIL_NONE" 65 "SVS_FLC_TIME__MIL_HLC_TRG" 66 "SVS_FLC_TIME__MIL_HLC_ELAP" 67 "SVS_FLC_TIME__MIL_FLC_CNT" 68 "SVS_FLC_TIME__MIL_FLC_TIME" 69 "SVS_FLC_TIME__MIL_HLC_TIME" 80 "SVS_HLC_TIME__MIL_NONE" 81 "SVS_HLC_TIME__MIL_HLC_TRG" 82 "SVS_HLC_TIME__MIL_HLC_ELAP" 83 "SVS_HLC_TIME__MIL_FLC_CNT" 84 "SVS_HLC_TIME__MIL_FLC_TIME" 85 "SVS_HLC_TIME__MIL_HLC_TIME" /end COMPU_VTAB
/begin COMPU_METHOD DFES_stEntry_Verb "" TAB_VERB "%6.3" "-" COMPU_TAB_REF DFES_stEntry_Verb /end COMPU_METHOD
/begin COMPU_VTAB DFES_stEntry_Verb "" TAB_VERB 60 0 "NoEntry" 1 "Erased" 2 "PrivateTemporary" 3 "SVSOff_FreezeFrameOnly" 4 "SVSOff_DelayActiveDefect" 5 "SVSOff_ServiceNoDefect" 6 "SVSOff_ServiceDefect" 7 "SVSOff_ServiceHistoryDefect" 8 "SVSOff_ServiceHistoryNoDefect" 9 "SVSOff_DelayActiveNoDefect" 10 "SVSOff_PendingDefect" 11 "SVSOff_DebouncedDefect" 12 "SVSOff_HistoryPendingDefect" 13 "SVSOff_HealingNoDefect" 14 "SVSOff_HistoryNoDefect" 16 "DelD_NoEntry" 17 "DelD_Erased" 18 "DelD_PrivateTemporary" 19 "SVSOff_DelD_FreezeFrameOnly" 20 "SVSOff_DelD_DelayActiveDefect" 21 "SVSOff_DelD_ServiceNoDefect" 22 "SVSOff_DelD_ServiceDefect" 23 "SVSOff_DelD_ServiceHistoryDefect" 24 "SVSOff_DelD_ServiceHistoryNoDefect" 25 "SVSOff_DelD_DelayActiveNoDefect" 26 "SVSOff_DelD_PendingDefect" 27 "SVSOff_DelD_DebouncedDefect" 28 "SVSOff_DelD_HistoryPendingDefect" 29 "SVSOff_DelD_HealingNoDefect" 30 "SVSOff_DelD_HistoryNoDefect" 128 "SVSOn_NoEntry" 129 "SVSOn_Erased" 130 "SVSOn_PrivateTemporary" 131 "SVSOn_FreezeFrameOnly" 132 "SVSOn_DelayActiveDefect" 133 "SVSOn_ServiceNoDefect" 134 "SVSOn_ServiceDefect" 135 "SVSOn_ServiceHistoryDefect" 136 "SVSOn_ServiceHistoryNoDefect" 137 "SVSOn_DelayActiveNoDefect" 138 "SVSOn_PendingDefect" 139 "SVSOn_DebouncedDefect" 140 "SVSOn_HistoryPendingDefect" 141 "SVSOn_HealingNoDefect" 142 "HistoryNoDefect" 144 "SVSOn_DelD_NoEntry" 145 "SVSOn_DelD_Erased" 146 "SVSOn_DelD_PrivateTemporary" 147 "SVSOn_DelD_FreezeFrameOnly" 148 "SVSOn_DelD_DelayActiveDefect" 149 "SVSOn_DelD_ServiceNoDefect" 150 "SVSOn_DelD_ServiceDefect" 151 "SVSOn_DelD_ServiceHistoryDefect" 152 "SVSOn_DelD_ServiceHistoryNoDefect" 153 "SVSOn_DelD_DelayActiveNoDefect" 154 "SVSOn_DelD_PendingDefect" 155 "SVSOn_DelD_DebouncedDefect" 156 "SVSOn_DelD_HistoryPendingDefect" 157 "SVSOn_DelD_HealingNoDefect" 158 "DelD_HistoryNoDefect" /end COMPU_VTAB
/begin COMPU_METHOD DIUMPR_ti100ms "" RAT_FUNC "%6.3" "s" COEFFS 0 10 0 0 0 1 /end COMPU_METHOD
/begin COMPU_METHOD DSMDur_StDispl_Verb "" TAB_VERB "%6.3" "-" COMPU_TAB_REF DSMDur_StDispl_Verb /end COMPU_METHOD
/begin COMPU_VTAB DSMDur_StDispl_Verb "" TAB_VERB 3 0 "NotEnabled" 1 "CountingEnabled" 2 "ResetCondition" /end COMPU_VTAB
/begin COMPU_METHOD DtyCyc "" RAT_FUNC "%5.2" "%" COEFFS 0 100 0 0 0 1 /end COMPU_METHOD
/begin COMPU_METHOD EpmCaS_stAdap_State "" TAB_VERB "%6.3" "" COMPU_TAB_REF EpmCaS_stAdap_State /end COMPU_METHOD
/begin COMPU_VTAB EpmCaS_stAdap_State "" TAB_VERB 5 0 "EPMCAS_STNOADAP" 1 "EPMCAS_STERRADAP" 2 "EPMCAS_STADAP" 3 "EPMCAS_STADAPSTOP" 4 "EPMCAS_STFULLADAP" /end COMPU_VTAB
/begin COMPU_METHOD EpmCaS_stOfsErr_Val "" TAB_VERB "%6.3" "" COMPU_TAB_REF EpmCaS_stOfsErr_Val /end COMPU_METHOD
/begin COMPU_VTAB EpmCaS_stOfsErr_Val "" TAB_VERB 6 0 "EPMCAS_OFS_AMBI" 1 "EPMCAS_OFS_NOEQUI_EDGE" 2 "EPMCAS_OFS_LOWEQUI_EDGE" 3 "EPMCAS_OFS_NOREFPOS" 4 "EPMCAS_OFS_EXCEED" 5 "EPMCAS_OFS_OK" /end COMPU_VTAB
/begin COMPU_METHOD EpmCas_stOfs_State "" TAB_VERB "%6.3" "" COMPU_TAB_REF EpmCas_stOfs_State /end COMPU_METHOD
/begin COMPU_VTAB EpmCas_stOfs_State "" TAB_VERB 2 0 "EPMCAS_OFS_WAITSEG" 1 "EPMCAS_OFS_SEGCALC" /end COMPU_VTAB
/begin COMPU_METHOD EpmSyn_EdgeFailTypes "" TAB_VERB "%6.3" "" COMPU_TAB_REF EpmSyn_EdgeFailTypes /end COMPU_METHOD
/begin COMPU_VTAB EpmSyn_EdgeFailTypes "" TAB_VERB 3 0 "EPMSYN_EDGE_OK" 1 "EPMSYN_EDGE_EARLY" 2 "EPMSYN_EDGE_LATE" /end COMPU_VTAB
/begin COMPU_METHOD EpmSyn_stCaSPosComp "" TAB_VERB "%6.3" "" COMPU_TAB_REF EpmSyn_stCaSPosComp /end COMPU_METHOD
/begin COMPU_VTAB EpmSyn_stCaSPosComp "" TAB_VERB 9 0 "EPMSYN_CASPOS_NOTVALID" 1 "EPMSYN_SIGTAB_NOUPDATE" 2 "EPMSYN_SIGTAB_AMBI" 5 "EPMSYN_CASPOS_VALID" 10 "EPMSYN_WRONG_SEG_LEN" 11 "EPMSYN_SIGTAB_END" 12 "EPMSYN_SIGTAB_SEQ" 13 "EPMSYN_EXCEED_TOLC" 20 "EPMSYN_CASPOS_SWTOFF" /end COMPU_VTAB
/begin COMPU_METHOD EpmSyn_stRRComp "" TAB_VERB "%6.3" "" COMPU_TAB_REF EpmSyn_stRRComp /end COMPU_METHOD
/begin COMPU_VTAB EpmSyn_stRRComp "" TAB_VERB 2 0 "EPMSYN_FORWARDS" 1 "EPMSYN_BACKWARDS" /end COMPU_VTAB
/begin COMPU_METHOD ESC_stSchdSx_CntnrNames_t "" TAB_VERB "%6.3" "" COMPU_TAB_REF ESC_stSchdSx_CntnrNames_t /end COMPU_METHOD
/begin COMPU_VTAB ESC_stSchdSx_CntnrNames_t "" TAB_VERB 19 0 "ESC_syncPre_Cntnr" 1 "ESC_syncCommon_Cntnr" 2 "ESC_syncLiGov_Cntnr" 3 "ESC_syncASD_Cntnr" 4 "ESC_syncUpdate_Cntnr" 5 "ESC_syncS0_A_Cntnr" 6 "ESC_syncS0_B_Cntnr" 7 "ESC_syncS1_A_Cntnr" 8 "ESC_syncS1_B_Cntnr" 9 "ESC_syncFBC_Cntnr" 10 "ESC_syncJoint_Cntnr" 11 "ESC_syncUnitInjector_Cntnr" 12 "ESC_syncPost_Cntnr" 13 "ESC_syncCPP_Cntnr" 14 "ESC_syncPSC_Cntnr" 15 "ESC_syncS0_Rmt_Cntnr" 16 "ESC_syncS1_Rmt_Cntnr" 17 "ESC_ERROR_UNDEF_CNTNR" 255 "ESC_NoSched" /end COMPU_VTAB
/begin COMPU_METHOD ETClb_Eval_State "" TAB_VERB "%6.3" "-" COMPU_TAB_REF ETClb_Eval_State /end COMPU_METHOD
/begin COMPU_VTAB ETClb_Eval_State "" TAB_VERB 3 0 "ETCLB_ST_EVAL_INIT" 1 "ETCLB_ST_EVAL_ADD" 2 "ETCLB_ST_EVAL_SUB" /end COMPU_VTAB
/begin COMPU_METHOD Fact "" RAT_FUNC "%6.5" "-" COEFFS 0 8192 0 0 0 1 /end COMPU_METHOD
/begin COMPU_METHOD Fact_EGT "" RAT_FUNC "%6.5" "-" COEFFS 0 1000 0 0 0 1 /end COMPU_METHOD
/begin COMPU_METHOD FAN_ATSINTVMOD_SY_Compu "" TAB_VERB "%6.3" "" COMPU_TAB_REF FAN_ATSINTVMOD_SY_Compu /end COMPU_METHOD
/begin COMPU_VTAB FAN_ATSINTVMOD_SY_Compu "" TAB_VERB 2 0 "False" 1 "True" /end COMPU_VTAB
/begin COMPU_METHOD FBC_Dxs_s16 "" RAT_FUNC "%7.6" "%" COEFFS 0 41943.04 0 0 0 1 /end COMPU_METHOD
/begin COMPU_METHOD FlConsum_ul "" RAT_FUNC "%6.2" "ul" COEFFS 0 1 0 0 0 1 /end COMPU_METHOD
/begin COMPU_METHOD FlConsum_ul_1 "" RAT_FUNC "%6.5" "ul" COEFFS 0 1000 0 0 0 1 /end COMPU_METHOD
/begin COMPU_METHOD FMA_SWTQNTAIRCTLCOR_SY_Compu "" TAB_VERB "%6.3" "" COMPU_TAB_REF FMA_SWTQNTAIRCTLCOR_SY_Compu /end COMPU_METHOD
/begin COMPU_VTAB FMA_SWTQNTAIRCTLCOR_SY_Compu "" TAB_VERB 2 0 "FUELLQUANTITY" 1 "AIRMASS" /end COMPU_VTAB
/begin COMPU_METHOD GC_Volt "" RAT_FUNC "%6.2" "mV" COEFFS 0 0.2046 0 0 0 1 /end COMPU_METHOD
/begin COMPU_METHOD GDI_SY_Compu "" TAB_VERB "%6.3" "" COMPU_TAB_REF GDI_SY_Compu /end COMPU_METHOD
/begin COMPU_VTAB GDI_SY_Compu "" TAB_VERB 2 0 "GDI_NO" 1 "GDI" /end COMPU_VTAB
/begin COMPU_METHOD GSSYS_TYPEEXHFLW_SY_Compu "" TAB_NOINTP "%6.3" "" COMPU_TAB_REF GSSYS_TYPEEXHFLW_SY_Compu /end COMPU_METHOD
/begin COMPU_TAB GSSYS_TYPEEXHFLW_SY_Compu "" TAB_NOINTP 8 0 0 1 1 2 2 3 3 4 4 5 5 6 6 7 7 /end COMPU_TAB
/begin COMPU_METHOD HtFlw_Fl "" RAT_FUNC "%6.2" "J/s" COEFFS 0 1 0 0 0 1 /end COMPU_METHOD
/begin COMPU_METHOD ident "" RAT_FUNC "%3.1" "-" COEFFS 0 1 0 0 0 1 /end COMPU_METHOD
/begin COMPU_METHOD InjTime_us "" RAT_FUNC "%5.1" "us" COEFFS 0 2.5 0 0 0 1 /end COMPU_METHOD
/begin COMPU_METHOD Ki_PrcEGRRmp_2_Prc "" RAT_FUNC "%7.6" "1/s" COEFFS 0 26843.5456 0 0 0 1 /end COMPU_METHOD
/begin COMPU_METHOD Ki_Temp2EGTFact "" RAT_FUNC "%8.7" "-" COEFFS 0 429496.7296 0 0 0 1 /end COMPU_METHOD
/begin COMPU_METHOD Kp_LmbdRec2InjMass_1 "" RAT_FUNC "%6.4" "mg/stroke" COEFFS 0 81.92 0 0 0 1 /end COMPU_METHOD
/begin COMPU_METHOD LengthCpp "" RAT_FUNC "%8.7" "m" COEFFS 0 100000 0 0 0 1 /end COMPU_METHOD
/begin COMPU_METHOD LengthFine "" RAT_FUNC "%6.5" "m" COEFFS 0 1000 0 0 0 1 /end COMPU_METHOD
/begin COMPU_METHOD LUB_CRITOILLVLMSK_SY_Compu "" TAB_VERB "%6.3" "" COMPU_TAB_REF LUB_CRITOILLVLMSK_SY_Compu /end COMPU_METHOD
/begin COMPU_VTAB LUB_CRITOILLVLMSK_SY_Compu "" TAB_VERB 2 1 "ONE" 2 "TWO" /end COMPU_VTAB
/begin COMPU_METHOD MOCCPU_FIT_SY_Compu "" TAB_VERB "%6.3" "" COMPU_TAB_REF MOCCPU_FIT_SY_Compu /end COMPU_METHOD
/begin COMPU_VTAB MOCCPU_FIT_SY_Compu "" TAB_VERB 2 0 "CHISTE_TEST" 1 "FIT_TEST" /end COMPU_VTAB
/begin COMPU_METHOD NSC_CT_SENSORS_SY_Compu "" TAB_NOINTP "%6.3" "" COMPU_TAB_REF NSC_CT_SENSORS_SY_Compu /end COMPU_METHOD
/begin COMPU_TAB NSC_CT_SENSORS_SY_Compu "" TAB_NOINTP 5 0 0 1 1 2 2 3 3 4 4 /end COMPU_TAB
/begin COMPU_METHOD O2 "" RAT_FUNC "%6.5" "-" COEFFS 0 100000 0 0 0 1 /end COMPU_METHOD
/begin COMPU_METHOD O2MassPerTime "" RAT_FUNC "%6.4" "Kg/h" COEFFS 0 100 0 0 0 1 /end COMPU_METHOD
/begin COMPU_METHOD OBD_PHYSMEDM_SY_Compu "" TAB_VERB "%6.3" "" COMPU_TAB_REF OBD_PHYSMEDM_SY_Compu /end COMPU_METHOD
/begin COMPU_VTAB OBD_PHYSMEDM_SY_Compu "" TAB_VERB 2 0 "OBD_PHYSMEDM_CAN" 1 "OBD_PHYSMEDM_KLINE" /end COMPU_VTAB
/begin COMPU_METHOD OILPLMP_DIGOUT_SY_Compu "" TAB_VERB "%6.3" "" COMPU_TAB_REF OILPLMP_DIGOUT_SY_Compu /end COMPU_METHOD
/begin COMPU_VTAB OILPLMP_DIGOUT_SY_Compu "" TAB_VERB 2 0 "0" 1 "1" /end COMPU_VTAB
/begin COMPU_METHOD OneToOne "" RAT_FUNC "%6.0" "-" COEFFS 0 1 0 0 0 1 /end COMPU_METHOD
/begin COMPU_METHOD OneToOne_us "" RAT_FUNC "%6.2" "us" COEFFS 0 1 0 0 0 1 /end COMPU_METHOD
/begin COMPU_METHOD PERMSPLYSYS_SY_Compu "" TAB_VERB "%6.3" "" COMPU_TAB_REF PERMSPLYSYS_SY_Compu /end COMPU_METHOD
/begin COMPU_VTAB PERMSPLYSYS_SY_Compu "" TAB_VERB 2 0 "FALSE" 1 "TRUE" /end COMPU_VTAB
/begin COMPU_METHOD Per_Dur "" RAT_FUNC "%6.2" "usec" COEFFS 0 1 0 0 0 1 /end COMPU_METHOD
/begin COMPU_METHOD Pres_hPa "" RAT_FUNC "%5.1" "hPa" COEFFS 0 1 0 0 0 1 /end COMPU_METHOD
/begin COMPU_METHOD Temp_Cels "" RAT_FUNC "%5.1" "deg C" COEFFS 0 10 2731.4 0 0 1 /end COMPU_METHOD
/begin COMPU_METHOD TimeGPTATick "" RAT_FUNC "%6.4" "ns" COEFFS 0 20 0 0 0 1 /end COMPU_METHOD
/end MODULE
/end PROJECT

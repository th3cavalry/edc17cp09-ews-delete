ASAP2_VERSION 1 4
/begin PROJECT P_574 "EDC17_CP09"
/begin HEADER "" VERSION "V8KB" PROJECT_NO P_574 /end HEADER
/begin MODULE DIM ""
/begin MOD_COMMON "" BYTE_ORDER MSB_LAST ALIGNMENT_BYTE 1 ALIGNMENT_WORD 2 ALIGNMENT_LONG 4 ALIGNMENT_FLOAT32_IEEE 4 /end MOD_COMMON
/begin CHARACTERISTIC BrkP_ctPlausErr_C "" VALUE 0x80063318 Val_Wu8 255.0 OneToOne 0.00 255.0 /end CHARACTERISTIC
/begin CHARACTERISTIC BrkP_ctPlausInc_C "" VALUE 0x80063319 Val_Wu8 255.0 OneToOne 0.00 255.0 /end CHARACTERISTIC
/begin CHARACTERISTIC BrkP_pDfl_C "" VALUE 0x8006331A Val_Ws16 250.0000 Pres_bar -50.00000 200.0000 FORMAT "%8.4" EXTENDED_LIMITS -32768.00 32767.00 /end CHARACTERISTIC
/begin CHARACTERISTIC BrkP_pDiffMin_C "" VALUE 0x8006331C Val_Ws16 250.0000 Pres_bar -50.00000 200.0000 FORMAT "%8.4" EXTENDED_LIMITS -32768.00 32767.00 /end CHARACTERISTIC
/begin CHARACTERISTIC BrkP_pTransf_CUR "" CURVE 0x80037A5E Cur_Xs16Ws16 250.0000 Pres_bar -50.00000 200.0000 FORMAT "%8.4" EXTENDED_LIMITS -32768.00 32767.00
 /begin AXIS_DESCR STD_AXIS BrkP_uRaw Volt 2 0.00 5200.000 EXTENDED_LIMITS -6553.600 6553.400 DEPOSIT ABSOLUTE /end AXIS_DESCR
/end CHARACTERISTIC
/begin CHARACTERISTIC BrkP_RmpSlp.Pos_C "/" VALUE 0x80063320 Kw_Ws32 32767949.9817 RmpPres_bar 50.0030517578 32767999.9847 FORMAT "%13.4" EXTENDED_LIMITS -32768000.0000 32767999.9847 /end CHARACTERISTIC
/begin CHARACTERISTIC BrkP_RmpSlp.Neg_C "/" VALUE 0x80063324 Kw_Ws32 32767949.9817 RmpPres_bar 50.0030517578 32767999.9847 FORMAT "%13.4" EXTENDED_LIMITS -32768000.0000 32767999.9847 /end CHARACTERISTIC
/begin CHARACTERISTIC BrkP_SRC.uMin_C "/" VALUE 0x80037A68 Kw_Ws16 200.0000 Volt 0.00 200.0000 EXTENDED_LIMITS -6553.600 6553.400 /end CHARACTERISTIC
/begin CHARACTERISTIC BrkP_SRC.uMax_C "/" VALUE 0x80037A6A Kw_Ws16 3200.000 Volt 2000.000 5200.000 EXTENDED_LIMITS -6553.600 6553.400 /end CHARACTERISTIC
/begin CHARACTERISTIC BrkP_swtRecDeAct_C "" VALUE 0x80037A6C Val_Wu8 1.000 OneToOne 0.00 1.000 EXTENDED_LIMITS 0.00 255.0 /end CHARACTERISTIC
/begin CHARACTERISTIC BrkP_swtSensPrs_C "" VALUE 0x80063328 Val_Wu8 255.0 OneToOne 0.00 255.0 /end CHARACTERISTIC
/begin CHARACTERISTIC BrkP_tiRecDeb_C "" VALUE 0x80037A6E Val_Ws16 1000.000 Time_ms 0.00 1000.000 EXTENDED_LIMITS -327680.0 327670.0 /end CHARACTERISTIC
/begin CHARACTERISTIC BrkP_TransStg.Dfl_C "/" VALUE 0x8006332A Kw_Ws16 250.0000 Pres_bar -50.00000 200.0000 FORMAT "%8.4" EXTENDED_LIMITS -32768.00 32767.00 /end CHARACTERISTIC
/begin CHARACTERISTIC BrkP_TransStg.stSensId_C "/" VALUE 0x8006332C Kw_Wu8 255.0 OneToOne 0.00 255.0 /end CHARACTERISTIC
/begin CHARACTERISTIC Brk_ctPlaDef_C "Defektschwelle dese Unplausibilitätszählers" VALUE 0x8006330C Kw_Wu8 255.0 OneToOne 0.00 255.0 /end CHARACTERISTIC
/begin CHARACTERISTIC Brk_MnDeb.tiHiLo_C "This is LONG-NAME/" VALUE 0x80037A70 Kw_Ws16 655350.0 TimeDeb -327680.0 327670.0 /end CHARACTERISTIC
/begin CHARACTERISTIC Brk_MnDeb.tiLoHi_C "This is LONG-NAME/" VALUE 0x80037A72 Kw_Ws16 655350.0 TimeDeb -327680.0 327670.0 /end CHARACTERISTIC
/begin CHARACTERISTIC Brk_RedDeb.tiHiLo_C "This is LONG-NAME/" VALUE 0x80037A74 Kw_Ws16 655350.0 TimeDeb -327680.0 327670.0 /end CHARACTERISTIC
/begin CHARACTERISTIC Brk_RedDeb.tiLoHi_C "This is LONG-NAME/" VALUE 0x80037A76 Kw_Ws16 655350.0 TimeDeb -327680.0 327670.0 /end CHARACTERISTIC
/begin CHARACTERISTIC Brk_stDflVal_C "Redundanter Bremskontakt-Vorgabewert" VALUE 0x8006330D Val_Wu8 3.000 OneToOne 0.00 3.000 EXTENDED_LIMITS 0.00 255.0 /end CHARACTERISTIC
/begin CHARACTERISTIC Brk_swtRedSensPrs_C "Schalter redundanter Bremskontakt vorhanden (1 = vorhanden, 0 = nicht vorhanden)" VALUE 0x8006330E Val_Wu8 1.000 OneToOne 0.00 1.000 EXTENDED_LIMITS 0.00 255.0 /end CHARACTERISTIC
/begin CHARACTERISTIC Brk_tiDebPlaStat_C "Entprellzeit zur Erkennung auf statische Unplausibilität" VALUE 0x80063310 Kw_Wu16 655350.0 Time_ms 0.00 655350.0 /end CHARACTERISTIC
/begin CHARACTERISTIC Brk_tiDebPla_C "Entprellzeit zur Erkennung auf Unplausibilität" VALUE 0x80063312 Kw_Wu16 655350.0 Time_ms 0.00 655350.0 /end CHARACTERISTIC
/begin CHARACTERISTIC Brk_tiDebResPla_C "Entprellzeit zur Erkennung auf Plausibilität" VALUE 0x80063314 Kw_Wu16 655350.0 Time_ms 0.00 655350.0 /end CHARACTERISTIC
/begin CHARACTERISTIC BusDiag_mskstNodeA_C "" VALUE 0x800636B0 Val_Wu16 65535.00 OneToOne 0.00 65535.00 /end CHARACTERISTIC
/begin CHARACTERISTIC BusDiag_mskstNodeB_C "" VALUE 0x800636B2 Val_Wu16 65535.00 OneToOne 0.00 65535.00 /end CHARACTERISTIC
/begin CHARACTERISTIC BusDiag_mskstNodeC_C "" VALUE 0x800636B4 Val_Wu16 65535.00 OneToOne 0.00 65535.00 /end CHARACTERISTIC
/begin CHARACTERISTIC BusDiag_tiNextInitNodeA_C "" VALUE 0x800636B6 Val_Wu16 5000.000 Time_ms 0.00 5000.000 EXTENDED_LIMITS 0.00 655350.0 /end CHARACTERISTIC
/begin CHARACTERISTIC BusDiag_tiNextInitNodeB_C "" VALUE 0x800636B8 Val_Wu16 5000.000 Time_ms 0.00 5000.000 EXTENDED_LIMITS 0.00 655350.0 /end CHARACTERISTIC
/begin CHARACTERISTIC BusDiag_tiNextInitNodeC_C "" VALUE 0x800636BA Val_Wu16 5000.000 Time_ms 0.00 5000.000 EXTENDED_LIMITS 0.00 655350.0 /end CHARACTERISTIC
/begin CHARACTERISTIC Com_aSideMax_C "" VALUE 0x80037A4C Val_Ws16 65.53500 Acc -32.76800 32.76700 FORMAT "%8.5" /end CHARACTERISTIC
/begin CHARACTERISTIC Com_aSideMin_C "" VALUE 0x80037A4E Val_Ws16 65.53500 Acc -32.76800 32.76700 FORMAT "%8.5" /end CHARACTERISTIC
/begin CHARACTERISTIC Com_stMskLenkradwinkelSig_C "" VALUE 0x80037A3C Val_Wu16 65535.00 OneToOne 0.00 65535.00 /end CHARACTERISTIC
/begin CHARACTERISTIC Com_stMskStateDscSig_C "" VALUE 0x80037A3E Val_Wu16 65535.00 OneToOne 0.00 65535.00 /end CHARACTERISTIC
/begin CHARACTERISTIC Com_stMskTrqDemandDscSig_C "" VALUE 0x80037A40 Val_Wu16 65535.00 OneToOne 0.00 65535.00 /end CHARACTERISTIC
/begin CHARACTERISTIC Com_stMskVelocitySig_C "" VALUE 0x80037A42 Val_Wu16 65535.00 OneToOne 0.00 65535.00 /end CHARACTERISTIC
/begin CHARACTERISTIC Com_stMskWheelSpeedSig_C "" VALUE 0x80037A44 Val_Wu16 65535.00 OneToOne 0.00 65535.00 /end CHARACTERISTIC
/begin CHARACTERISTIC Com_swtBrPWhl_FX_C "" VALUE 0x80037A5A Val_Wu8 1.000 OneToOne 0.00 1.000 EXTENDED_LIMITS 0.00 255.0 /end CHARACTERISTIC
/begin CHARACTERISTIC Com_swtCalcVehN_C "" VALUE 0x80037A59 Val_Wu8 255.0 OneToOne 0.00 255.0 /end CHARACTERISTIC
/begin CHARACTERISTIC Com_swtCalcVehVBd_C "" VALUE 0x80037A50 Val_Wu8 255.0 OneToOne 0.00 255.0 /end CHARACTERISTIC
/begin CHARACTERISTIC Com_swtCalcVehV_C "" VALUE 0x80037A51 Val_Wu8 255.0 OneToOne 0.00 255.0 /end CHARACTERISTIC
/begin CHARACTERISTIC Com_swtLenkradwinkel_C "" VALUE 0x80037A46 Val_Wu8 1.000 OneToOne 0.00 1.000 EXTENDED_LIMITS 0.00 255.0 /end CHARACTERISTIC
/begin CHARACTERISTIC Com_swtRpmWhl_FX_C "" VALUE 0x80037A5B Val_Wu8 1.000 OneToOne 0.00 1.000 EXTENDED_LIMITS 0.00 255.0 /end CHARACTERISTIC
/begin CHARACTERISTIC Com_swtStateDsc_C "" VALUE 0x80037A47 Val_Wu8 1.000 OneToOne 0.00 1.000 EXTENDED_LIMITS 0.00 255.0 /end CHARACTERISTIC
/begin CHARACTERISTIC Com_swtStConintDSC_FX_C "" VALUE 0x80037A5C Val_Wu8 1.000 OneToOne 0.00 1.000 EXTENDED_LIMITS 0.00 255.0 /end CHARACTERISTIC
/begin CHARACTERISTIC Com_swtTrqDemandDsc_C "" VALUE 0x80037A48 Val_Wu8 1.000 OneToOne 0.00 1.000 EXTENDED_LIMITS 0.00 255.0 /end CHARACTERISTIC
/begin CHARACTERISTIC Com_swtVelocity_C "" VALUE 0x80037A49 Val_Wu8 1.000 OneToOne 0.00 1.000 EXTENDED_LIMITS 0.00 255.0 /end CHARACTERISTIC
/begin CHARACTERISTIC Com_swtVelocity_FA_C "" VALUE 0x80037A58 Val_Wu8 255.0 OneToOne 0.00 255.0 /end CHARACTERISTIC
/begin CHARACTERISTIC Com_swtWheelSpeed_C "" VALUE 0x80037A4A Val_Wu8 1.000 OneToOne 0.00 1.000 EXTENDED_LIMITS 0.00 255.0 /end CHARACTERISTIC
/begin CHARACTERISTIC Com_swtWMomPTStab_FX_C "" VALUE 0x80037A5D Val_Wu8 1.000 OneToOne 0.00 1.000 EXTENDED_LIMITS 0.00 255.0 /end CHARACTERISTIC
/begin CHARACTERISTIC Com_tiFltADirect_C "" VALUE 0x80037A54 Val_Ws32 4294.9662960 TimeDelay_s 0.0010000000689 4294.9672960 FORMAT "%12.7" EXTENDED_LIMITS 0.000002000000001 4294.9672960 /end CHARACTERISTIC
/begin CHARACTERISTIC KF_DTW_QN "KF deltaT - Me - Nkw" MAP 0x80063330 MapTKF_SW_SW_SW 655.350 Def_t_sw_q0p01 -327.680 327.670 FORMAT "%7.3"
 /begin AXIS_DESCR STD_AXIS Nkw Def_n_sw_q1p0 5 -32768. 32767. FORMAT "%5.0" DEPOSIT ABSOLUTE /end AXIS_DESCR
 /begin AXIS_DESCR STD_AXIS Me_ist Def_me_sw_q0p01 5 -327.6800 327.6700 FORMAT "%8.4" DEPOSIT ABSOLUTE /end AXIS_DESCR
/end CHARACTERISTIC
/begin CHARACTERISTIC KF_DTW_TWA "KF deltaT - Nkw - TWand-Tans" MAP 0x80063378 MapTKF_SW_SW_SW 655.350 Def_t_sw_q0p01 -327.680 327.670 FORMAT "%7.3"
 /begin AXIS_DESCR STD_AXIS Nkw Def_n_sw_q1p0 5 -32768. 32767. FORMAT "%5.0" DEPOSIT ABSOLUTE /end AXIS_DESCR
 /begin AXIS_DESCR STD_AXIS Y_KF_DTW_TWA_no_input_quantity Def_t_sw_q0p01 5 -327.680 327.670 FORMAT "%7.3" DEPOSIT ABSOLUTE /end AXIS_DESCR
/end CHARACTERISTIC
/begin CHARACTERISTIC KF_TAIRMHFMS "KF deltaT - TWand-Tans - Ml im Schub" MAP 0x800633C0 MapTKF_SW_SW_SW 655.350 Def_t_sw_q0p01 -327.680 327.670 FORMAT "%7.3"
 /begin AXIS_DESCR STD_AXIS X_KF_TAIRMHFMS_no_input_quantity Def_t_sw_q0p01 5 -327.680 327.670 FORMAT "%7.3" DEPOSIT ABSOLUTE /end AXIS_DESCR
 /begin AXIS_DESCR STD_AXIS Ml Def_ml_sw_q0p1 5 -3276.80 3276.70 FORMAT "%7.2" DEPOSIT ABSOLUTE /end AXIS_DESCR
/end CHARACTERISTIC
/begin CHARACTERISTIC KF_TAIR_MHFM "KF deltaT - TWand-Tans - Ml" MAP 0x80063408 MapTKF_SW_SW_SW 655.350 Def_t_sw_q0p01 -327.680 327.670 FORMAT "%7.3"
 /begin AXIS_DESCR STD_AXIS X_KF_TAIR_MHFM_no_input_quantity Def_t_sw_q0p01 5 -327.680 327.670 FORMAT "%7.3" DEPOSIT ABSOLUTE /end AXIS_DESCR
 /begin AXIS_DESCR STD_AXIS Ml Def_ml_sw_q0p1 5 -3276.80 3276.70 FORMAT "%7.2" DEPOSIT ABSOLUTE /end AXIS_DESCR
/end CHARACTERISTIC
/begin CHARACTERISTIC KF_TWPST_MAP "KF TWand - Nkw - Me von Prüfstand" MAP 0x80063450 MapTKF_SW_SW_SW 6553.5 Def_t_sw_q0p1 -3276.8 3276.7 FORMAT "%6.1"
 /begin AXIS_DESCR STD_AXIS Nkw Def_n_sw_q1p0 16 -32768. 32767. FORMAT "%5.0" DEPOSIT ABSOLUTE /end AXIS_DESCR
 /begin AXIS_DESCR STD_AXIS Me_ist Def_me_sw_q0p01 16 -327.6800 327.6700 FORMAT "%8.4" DEPOSIT ABSOLUTE /end AXIS_DESCR
/end CHARACTERISTIC
/begin CHARACTERISTIC KL_COOLING "KL Abkuehlverhalten" CURVE 0x80063692 CurTKL_UW_VV_UB 0.99609 Def_f_ub_b1 0.00 0.99609 FORMAT "%7.5"
 /begin AXIS_DESCR STD_AXIS Tn_abstell Def_dez_uw_q1 6 0.00 65535. FORMAT "%5.0" DEPOSIT ABSOLUTE /end AXIS_DESCR
/end CHARACTERISTIC
/begin CHARACTERISTIC K_BRWTDA "Berechnete Wandtemp oder Diff zu MAP" VALUE 0x800636A6 Val_Wu8 255. ident 0.00 255. FORMAT "%3.0" /end CHARACTERISTIC
/begin CHARACTERISTIC K_BRWTKINT "BRWT K-Integrator" VALUE 0x800636A8 Val_Wu16 65535. Def_dez_uw_q1 0.00 65535. FORMAT "%5.0" /end CHARACTERISTIC
/begin CHARACTERISTIC K_ENGSTSTRT "Engine Status Start warten auf Startabwurf" VALUE 0x800636AA Val_Wu8 255. Def_dez_ub_q1 0.00 255. FORMAT "%3.0" /end CHARACTERISTIC
/begin CHARACTERISTIC K_QMIN "Minimale Einspritzmenge" VALUE 0x800636AC Val_Ws16 655.3500 Def_me_sw_q0p01 -327.6800 327.6700 FORMAT "%8.4" /end CHARACTERISTIC
/begin CHARACTERISTIC S_BRWT "Aktivierung der Funktion Brennraumwandtemperatur" VALUE 0x800636AE Val_Wu8 255. ident 0.00 255. FORMAT "%3.0" /end CHARACTERISTIC
/begin MEASUREMENT BrkP_bEval "" UBYTE OneToOne 1 100 0.00 1.000 BIT_MASK 0x20 ECU_ADDRESS 0xD00003BD /end MEASUREMENT
/begin MEASUREMENT BrkP_bRec "" UBYTE OneToOne 1 100 0.00 1.000 BIT_MASK 0x2 ECU_ADDRESS 0xD00003BE /end MEASUREMENT
/begin MEASUREMENT BrkP_bRecActv "" UBYTE OneToOne 1 100 0.00 1.000 BIT_MASK 0x1 ECU_ADDRESS 0xD00003C7 /end MEASUREMENT
/begin MEASUREMENT BrkP_ctPlausError "" UBYTE OneToOne 1 100 0.00 255.0 ECU_ADDRESS 0xD0001C20 /end MEASUREMENT
/begin MEASUREMENT BrkP_p "" SWORD Pres_bar 1 100 -32768.00 32767.00 FORMAT "%8.2" ECU_ADDRESS 0xD0000670 /end MEASUREMENT
/begin MEASUREMENT BrkP_pDiffPlaus_mp "" SWORD Pres_bar 1 100 -32768.00 32767.00 FORMAT "%8.2" ECU_ADDRESS 0xC0009AC2 /end MEASUREMENT
/begin MEASUREMENT BrkP_pHiLoEdge "" SWORD Pres_bar 1 100 -32768.00 32767.00 FORMAT "%8.2" ECU_ADDRESS 0xD0000672 /end MEASUREMENT
/begin MEASUREMENT BrkP_pLoHiEdge "" SWORD Pres_bar 1 100 -32768.00 32767.00 FORMAT "%8.2" ECU_ADDRESS 0xD0000674 /end MEASUREMENT
/begin MEASUREMENT BrkP_pSens "" SWORD Pres_bar 1 100 -32768.00 32767.00 FORMAT "%8.2" ECU_ADDRESS 0xD0000676 /end MEASUREMENT
/begin MEASUREMENT BrkP_pSys "" SWORD Pres_bar 1 100 -32768.00 32767.00 FORMAT "%8.2" ECU_ADDRESS 0xD0000678 /end MEASUREMENT
/begin MEASUREMENT BrkP_stPlausActv "" UBYTE OneToOne 1 100 0.00 255.0 ECU_ADDRESS 0xD0001C21 /end MEASUREMENT
/begin MEASUREMENT BrkP_stRec "" UBYTE OneToOne 1 100 0.00 255.0 ECU_ADDRESS 0xD0001C22 /end MEASUREMENT
/begin MEASUREMENT BrkP_stSensErr "" UBYTE OneToOne 1 100 0.00 255.0 ECU_ADDRESS 0xD0001C23 /end MEASUREMENT
/begin MEASUREMENT BrkP_uRaw "" SWORD Volt 1 100 -6553.600 6553.400 ECU_ADDRESS 0xD000067A /end MEASUREMENT
/begin MEASUREMENT Brk_ctPla_mp "Unplausibilitätszähler" UWORD OneToOne 1 100 0.00 65535.00 ECU_ADDRESS 0xC0009AC4 /end MEASUREMENT
/begin MEASUREMENT Brk_st "Meldung Bremse betätigt" UBYTE OneToOne 1 100 0.00 255.0 ECU_ADDRESS 0xD0001C24 /end MEASUREMENT
/begin MEASUREMENT Brk_stDeb_mp "Bremskontaktschalter - Status Fehlerentprellung Plausibilitaetspruefung" UBYTE OneToOne 1 100 0.00 255.0 ECU_ADDRESS 0xC000B0AE /end MEASUREMENT
/begin MEASUREMENT Brk_stFreeze_mp "" UBYTE OneToOne 1 100 0.00 255.0 ECU_ADDRESS 0xC000B0AF /end MEASUREMENT
/begin MEASUREMENT Brk_stMn "Digitalsignal Bremskontakt entprellt" UBYTE OneToOne 1 100 0.00 255.0 ECU_ADDRESS 0xD0001C25 /end MEASUREMENT
/begin MEASUREMENT Brk_stMnRaw "Rohwert Bremskontakt nicht entprellt" UBYTE OneToOne 1 100 0.00 255.0 ECU_ADDRESS 0xD0001C26 /end MEASUREMENT
/begin MEASUREMENT Brk_stRed "Redundanter Bremskontakt Aktivinformation" UBYTE OneToOne 1 100 0.00 255.0 ECU_ADDRESS 0xD0001C27 /end MEASUREMENT
/begin MEASUREMENT Brk_stRedRaw "Rohwert redundanter Bremskontakt nicht entprellt" UBYTE OneToOne 1 100 0.00 255.0 ECU_ADDRESS 0xD0001C28 /end MEASUREMENT
/begin MEASUREMENT Brk_stResPla_mp "Zustandsbits zum Rücksetzen der Unplausibilität" UBYTE OneToOne 1 100 0.00 255.0 ECU_ADDRESS 0xC000B0B0 /end MEASUREMENT
/begin MEASUREMENT Brk_tiDebPlaStat_mp "Statische Entprellzeit des Plausibilitäts-Check" UWORD Time_ms 1 100 0.00 655350.0 ECU_ADDRESS 0xC0009AC6 /end MEASUREMENT
/begin MEASUREMENT BusDiag_stFadeOut "" UBYTE OneToOne 1 100 0.00 255.0 ECU_ADDRESS 0xD0001C29 /end MEASUREMENT
/begin MEASUREMENT BusDiag_stFlexRay_mp "" UWORD BusDiag_FlexRayState 1 100 0.00 10.0000000000 FORMAT "%13.10" ECU_ADDRESS 0xC0009AE2 /end MEASUREMENT
/begin MEASUREMENT BusDiag_stNodeA_mp "" UWORD OneToOne 1 100 0.00 65535.00 ECU_ADDRESS 0xC0009AE4 /end MEASUREMENT
/begin MEASUREMENT BusDiag_stNodeB_mp "" UWORD OneToOne 1 100 0.00 65535.00 ECU_ADDRESS 0xC0009AE6 /end MEASUREMENT
/begin MEASUREMENT BusDiag_stNodeC_mp "" UWORD OneToOne 1 100 0.00 65535.00 ECU_ADDRESS 0xC0009AE8 /end MEASUREMENT
/begin MEASUREMENT Com_aDirect "" SWORD Acc 1 100 -32.76800 32.76700 FORMAT "%8.5" ECU_ADDRESS 0xD0000754 /end MEASUREMENT
/begin MEASUREMENT Com_aDirectFlt "" SWORD Acc 1 100 -32.76800 32.76700 FORMAT "%8.5" ECU_ADDRESS 0xD0000756 /end MEASUREMENT
/begin MEASUREMENT Com_aSide "" SWORD Acc 1 100 -32.76800 32.76700 FORMAT "%8.5" ECU_ADDRESS 0xD0000758 /end MEASUREMENT
/begin MEASUREMENT Com_dBrkTrqSumCHK_FX "" UBYTE OneToOne 1 100 0.00 255.0 ECU_ADDRESS 0xD0001C7A /end MEASUREMENT
/begin MEASUREMENT Com_dBrkTrqSumCTR_FX "" UWORD OneToOne 1 100 0.00 65535.00 ECU_ADDRESS 0xD00014FA /end MEASUREMENT
/begin MEASUREMENT Com_dnWhlCHK_FX "" UBYTE OneToOne 1 100 0.00 255.0 ECU_ADDRESS 0xD0001CC1 /end MEASUREMENT
/begin MEASUREMENT Com_dnWhlCTR_FX "" UWORD OneToOne 1 100 0.00 65535.00 ECU_ADDRESS 0xD000157A /end MEASUREMENT
/begin MEASUREMENT Com_dphiStWhlAg "" SWORD AngleVelStWhl 1 100 -1024.000 1023.969 FORMAT "%8.3" ECU_ADDRESS 0xD0000762 /end MEASUREMENT
/begin MEASUREMENT Com_dphiStWhlAgRaw "" SLONG AngleVelStWhl 1 100 -67108864.0000 67108863.9688 FORMAT "%13.4" ECU_ADDRESS 0xD0002E3C /end MEASUREMENT
/begin MEASUREMENT Com_dstDSCCHK_FX "" UBYTE OneToOne 1 100 0.00 255.0 ECU_ADDRESS 0xD0001CC2 /end MEASUREMENT
/begin MEASUREMENT Com_dstDSCCTR_FX "" UWORD OneToOne 1 100 0.00 65535.00 ECU_ADDRESS 0xD000157E /end MEASUREMENT
/begin MEASUREMENT Com_dTrqDemandDscCHK "" UBYTE OneToOne 1 100 0.00 255.0 ECU_ADDRESS 0xD0001CA9 /end MEASUREMENT
/begin MEASUREMENT Com_dTrqDemandDscCTR "" UWORD OneToOne 1 100 0.00 65535.00 ECU_ADDRESS 0xD000154E /end MEASUREMENT
/begin MEASUREMENT Com_dVelocityCHK_FA "" UBYTE OneToOne 1 100 0.00 255.0 ECU_ADDRESS 0xD0001CB2 /end MEASUREMENT
/begin MEASUREMENT Com_dVelocityCTR_FA "" UWORD OneToOne 1 100 0.00 65535.00 ECU_ADDRESS 0xD0001560 /end MEASUREMENT
/begin MEASUREMENT Com_dWhlMomPTStabCHK_FX "" UBYTE OneToOne 1 100 0.00 255.0 ECU_ADDRESS 0xD0001CB3 /end MEASUREMENT
/begin MEASUREMENT Com_dWhlMomPTStabCTR_FX "" UWORD OneToOne 1 100 0.00 65535.00 ECU_ADDRESS 0xD0001562 /end MEASUREMENT
/begin MEASUREMENT Com_nWhl "" SWORD EngN 1 100 -16384.00 16383.50 ECU_ADDRESS 0xD000079A /end MEASUREMENT
/begin MEASUREMENT Com_nWhlFL "" SWORD EngN 1 100 -16384.00 16383.50 ECU_ADDRESS 0xD000079C /end MEASUREMENT
/begin MEASUREMENT Com_nWhlFL_FX "" SWORD EngN 1 100 -16384.00 16383.50 ECU_ADDRESS 0xD000079E /end MEASUREMENT
/begin MEASUREMENT Com_nWhlFR "" SWORD EngN 1 100 -16384.00 16383.50 ECU_ADDRESS 0xD00007A0 /end MEASUREMENT
/begin MEASUREMENT Com_nWhlFR_FX "" SWORD EngN 1 100 -16384.00 16383.50 ECU_ADDRESS 0xD00007A2 /end MEASUREMENT
/begin MEASUREMENT Com_nWhlRL "" SWORD EngN 1 100 -16384.00 16383.50 ECU_ADDRESS 0xD00007A4 /end MEASUREMENT
/begin MEASUREMENT Com_nWhlRL_FX "" SWORD EngN 1 100 -16384.00 16383.50 ECU_ADDRESS 0xD00007A6 /end MEASUREMENT
/begin MEASUREMENT Com_nWhlRR "" SWORD EngN 1 100 -16384.00 16383.50 ECU_ADDRESS 0xD00007A8 /end MEASUREMENT
/begin MEASUREMENT Com_nWhlRR_FX "" SWORD EngN 1 100 -16384.00 16383.50 ECU_ADDRESS 0xD00007AA /end MEASUREMENT
/begin MEASUREMENT Com_pBrkSys "" SWORD Pres_bar 1 100 -32768.00 32767.00 FORMAT "%8.2" ECU_ADDRESS 0xD00007B0 /end MEASUREMENT
/begin MEASUREMENT Com_pBrkSys_FX "" SWORD Pres_bar 1 100 -32768.00 32767.00 FORMAT "%8.2" ECU_ADDRESS 0xD00007B2 /end MEASUREMENT
/begin MEASUREMENT Com_phiStWhlAg "" SWORD AngleStWhl 1 100 -1024.000 1023.969 FORMAT "%8.3" ECU_ADDRESS 0xD00007B8 /end MEASUREMENT
/begin MEASUREMENT Com_phiStWhlAgRaw "" SLONG AngleStWhl 1 100 -67108864.0000 67108863.9688 FORMAT "%13.4" ECU_ADDRESS 0xD0002E4C /end MEASUREMENT
/begin MEASUREMENT Com_stBrkTrqDVCHQl "" UBYTE OneToOne 1 100 0.00 255.0 ECU_ADDRESS 0xD0001CDC /end MEASUREMENT
/begin MEASUREMENT Com_stBrkTrqDVCHQl_FX "" UBYTE OneToOne 1 100 0.00 255.0 ECU_ADDRESS 0xD0001CDD /end MEASUREMENT
/begin MEASUREMENT Com_stClCtr "" UBYTE OneToOne 1 100 0.00 255.0 ECU_ADDRESS 0xD0001CE5 /end MEASUREMENT
/begin MEASUREMENT Com_stClCtr_FX "" UBYTE OneToOne 1 100 0.00 255.0 ECU_ADDRESS 0xD0001CE6 /end MEASUREMENT
/begin MEASUREMENT Com_stDecellDSC "" UBYTE OneToOne 1 100 0.00 255.0 ECU_ADDRESS 0xD0001CF7 /end MEASUREMENT
/begin MEASUREMENT Com_stDecellDSC_FX "" UBYTE OneToOne 1 100 0.00 255.0 ECU_ADDRESS 0xD0001CF8 /end MEASUREMENT
/begin MEASUREMENT Com_stDSC "" UBYTE OneToOne 1 100 0.00 255.0 ECU_ADDRESS 0xD0001CF5 /end MEASUREMENT
/begin MEASUREMENT Com_stDSC_FX "" UBYTE OneToOne 1 100 0.00 255.0 ECU_ADDRESS 0xD0001CF6 /end MEASUREMENT
/begin MEASUREMENT Com_stLckGbxDemQl_FX "" UBYTE OneToOne 1 100 0.00 255.0 ECU_ADDRESS 0xD0001D2A /end MEASUREMENT
/begin MEASUREMENT Com_stPBrkSysQl "" UBYTE OneToOne 1 100 0.00 255.0 ECU_ADDRESS 0xD0001D46 /end MEASUREMENT
/begin MEASUREMENT Com_stPBrkSysQl_FX "" UBYTE OneToOne 1 100 0.00 255.0 ECU_ADDRESS 0xD0001D47 /end MEASUREMENT
/begin MEASUREMENT Com_stphiStWhlAg "" UBYTE OneToOne 1 100 0.00 255.0 ECU_ADDRESS 0xD0001DB0 /end MEASUREMENT
/begin MEASUREMENT Com_stTrqDSCDes "" UBYTE OneToOne 1 100 0.00 255.0 ECU_ADDRESS 0xD0001D8E /end MEASUREMENT
/begin MEASUREMENT Com_stTrqStbDesQl "" UBYTE OneToOne 1 100 0.00 255.0 ECU_ADDRESS 0xD0001D99 /end MEASUREMENT
/begin MEASUREMENT Com_stTrqStbDesQl_FX "" UBYTE OneToOne 1 100 0.00 255.0 ECU_ADDRESS 0xD0001D9A /end MEASUREMENT
/begin MEASUREMENT Com_stVehDrvCond "" UBYTE OneToOne 1 100 0.00 255.0 ECU_ADDRESS 0xD0001DAA /end MEASUREMENT
/begin MEASUREMENT Com_stVehDrvCond_FA "" UBYTE OneToOne 1 100 0.00 255.0 ECU_ADDRESS 0xD0001DAB /end MEASUREMENT
/begin MEASUREMENT Com_trqBrkDVCH "" SLONG Trq 1 100 -214748364.800 214748364.700 ECU_ADDRESS 0xD0002E60 /end MEASUREMENT
/begin MEASUREMENT Com_trqBrkDVCH_FX "" SLONG Trq 1 100 -214748364.800 214748364.700 ECU_ADDRESS 0xD0002E64 /end MEASUREMENT
/begin MEASUREMENT Com_trqDSCDes "" SWORD Trq 1 100 -3276.800 3276.700 ECU_ADDRESS 0xD000081E /end MEASUREMENT
/begin MEASUREMENT Com_trqStbDes "" SLONG TrqPrpHigh 1 100 -214748364.800 214748364.700 ECU_ADDRESS 0xD0002E6C /end MEASUREMENT
/begin MEASUREMENT Com_trqStbDes_FX "" SLONG TrqPrpHigh 1 100 -214748364.800 214748364.700 ECU_ADDRESS 0xD0002E70 /end MEASUREMENT
/begin MEASUREMENT Com_v "" SWORD Vel 1 100 -327.6800 327.6700 ECU_ADDRESS 0xD0000866 /end MEASUREMENT
/begin MEASUREMENT Com_vBd "" SWORD Vel 1 100 -327.6800 327.6700 ECU_ADDRESS 0xD0000868 /end MEASUREMENT
/begin MEASUREMENT Com_vVeh "" SLONG Vel 1 100 -21474836.4800 21474836.4700 ECU_ADDRESS 0xD0002E88 /end MEASUREMENT
/begin MEASUREMENT Com_vVeh_FA "" SLONG Vel 1 100 -21474836.4800 21474836.4700 ECU_ADDRESS 0xD0002E8C /end MEASUREMENT
/begin MEASUREMENT Com_vWheelFL "" SWORD Vel 1 100 -327.6800 327.6700 ECU_ADDRESS 0xD000086C /end MEASUREMENT
/begin MEASUREMENT Com_vWheelFR "" SWORD Vel 1 100 -327.6800 327.6700 ECU_ADDRESS 0xD000086E /end MEASUREMENT
/begin MEASUREMENT Com_vWheelRL "" SWORD Vel 1 100 -327.6800 327.6700 ECU_ADDRESS 0xD0000870 /end MEASUREMENT
/begin MEASUREMENT Com_vWheelRR "" SWORD Vel 1 100 -327.6800 327.6700 ECU_ADDRESS 0xD0000872 /end MEASUREMENT
/begin MEASUREMENT T_brw "Temp Brennraumwand" SWORD Def_t_sw_q0p1 1 100 -50.200 899.80 FORMAT "%6.2" ECU_ADDRESS 0xC0009AC8 /end MEASUREMENT
/begin MEASUREMENT T_brwd1 "Tempdiff aus KF QN" SWORD Def_t_sw_q0p01 1 100 -327.680 327.670 FORMAT "%7.3" ECU_ADDRESS 0xC0009ACA /end MEASUREMENT
/begin MEASUREMENT T_brwd2 "Tempdiff aus KF HFM" SWORD Def_t_sw_q0p01 1 100 -327.680 327.670 FORMAT "%7.3" ECU_ADDRESS 0xC0009ACC /end MEASUREMENT
/begin MEASUREMENT T_brwd3 "Tempdiff aus KF HFMS" SWORD Def_t_sw_q0p01 1 100 -327.680 327.670 FORMAT "%7.3" ECU_ADDRESS 0xC0009ACE /end MEASUREMENT
/begin MEASUREMENT T_brwd4 "Tempdiff aus KF TWA" SWORD Def_t_sw_q0p01 1 100 -327.680 327.670 FORMAT "%7.3" ECU_ADDRESS 0xC0009AD0 /end MEASUREMENT
/begin MEASUREMENT T_brwdg "Summe Tempdiff aus Kennfeldern" SWORD Def_t_sw_q0p01 1 100 -327.680 327.670 FORMAT "%7.3" ECU_ADDRESS 0xC0009AD2 /end MEASUREMENT
/begin MEASUREMENT T_brwdiff "Temperatur Brennraumwand Differenz MAP zu calc" SWORD Def_t_sw_q0p1 1 100 -50.200 899.80 FORMAT "%6.2" ECU_ADDRESS 0xC0009AD4 /end MEASUREMENT
/begin MEASUREMENT T_brwnv "Temp Brennraumwand NV" SWORD Def_t_sw_q0p1 1 100 -50.200 899.80 FORMAT "%6.2" ECU_ADDRESS 0xC0009AD6 /end MEASUREMENT
/begin MEASUREMENT T_brwsd "Start Tempdiff Tmot zu T_brw" SWORD Def_t_sw_q0p1 1 100 -3276.8 3276.7 FORMAT "%6.1" ECU_ADDRESS 0xC0009AD8 /end MEASUREMENT
/begin MEASUREMENT T_brwsde "Abgeklungene Tempdiff Tmot zu T_brw" SWORD Def_t_sw_q0p1 1 100 -3276.8 3276.7 FORMAT "%6.1" ECU_ADDRESS 0xC0009ADA /end MEASUREMENT
/begin MEASUREMENT VehMot_stBrkPed "Information Bremspedal betätigt" UBYTE OneToOne 1 100 0.00 255.0 ECU_ADDRESS 0xD00025B5 /end MEASUREMENT
/begin MEASUREMENT X_KF_TAIRMHFMS_no_input_quantity "This variable is artificially generated, since DAMOS does not (yet) support 'NO_INPUT_QUANTITY' references at PaVaSt files. It is exclusively referenced by the X axis of calibration parameter 'KF_TAIRMHFMS'." SWORD Def_t_sw_q0p01 1 100 -327.680 327.670 FORMAT "%7.3" ECU_ADDRESS 0xC0009ADC /end MEASUREMENT
/begin MEASUREMENT X_KF_TAIR_MHFM_no_input_quantity "This variable is artificially generated, since DAMOS does not (yet) support 'NO_INPUT_QUANTITY' references at PaVaSt files. It is exclusively referenced by the X axis of calibration parameter 'KF_TAIR_MHFM'." SWORD Def_t_sw_q0p01 1 100 -327.680 327.670 FORMAT "%7.3" ECU_ADDRESS 0xC0009ADE /end MEASUREMENT
/begin MEASUREMENT Y_KF_DTW_TWA_no_input_quantity "This variable is artificially generated, since DAMOS does not (yet) support 'NO_INPUT_QUANTITY' references at PaVaSt files. It is exclusively referenced by the Y axis of calibration parameter 'KF_DTW_TWA'." SWORD Def_t_sw_q0p01 1 100 -327.680 327.670 FORMAT "%7.3" ECU_ADDRESS 0xC0009AE0 /end MEASUREMENT
/begin FUNCTION BrkECU "" /begin SUB_FUNCTION BrkECU_Can BrkECU_co BrkECU_swt BrkECU_fa BrkECU_fx /end SUB_FUNCTION /end FUNCTION
/begin FUNCTION BrkECU_Can ""
 /begin DEF_CHARACTERISTIC Com_stMskLenkradwinkelSig_C Com_stMskStateDscSig_C Com_stMskTrqDemandDscSig_C Com_stMskVelocitySig_C Com_stMskWheelSpeedSig_C Com_swtLenkradwinkel_C Com_swtStateDsc_C Com_swtTrqDemandDsc_C Com_swtVelocity_C Com_swtWheelSpeed_C /end DEF_CHARACTERISTIC
 /begin OUT_MEASUREMENT Com_v /end OUT_MEASUREMENT
/end FUNCTION
/begin FUNCTION BrkECU_co ""
 /begin DEF_CHARACTERISTIC Com_aSideMax_C Com_aSideMin_C Com_swtCalcVehVBd_C Com_swtCalcVehV_C Com_tiFltADirect_C /end DEF_CHARACTERISTIC
 /begin IN_MEASUREMENT Com_stTrqStbDesQl Com_trqStbDes Com_v PT_rTrq PT_trqLos StbIntv_bDCSIntv StbIntv_bDCSNeutr StbIntv_bTCSIntv StbIntv_bTCSNeutr StbIntv_trqDCSDes StbIntv_trqTCSDes StbIntv_trqTCSLead VehMot_rTrqDfftl /end IN_MEASUREMENT
 /begin OUT_MEASUREMENT Com_aDirect Com_aDirectFlt Com_aSide Com_dphiStWhlAg Com_dphiStWhlAgRaw Com_dTrqDemandDscCHK Com_dTrqDemandDscCTR Com_pBrkSys Com_phiStWhlAg Com_phiStWhlAgRaw Com_stClCtr Com_stDecellDSC Com_stDSC Com_stphiStWhlAg Com_stTrqDSCDes Com_stVehDrvCond Com_trqDSCDes Com_vBd Com_vVeh Com_vWheelFL Com_vWheelFR Com_vWheelRL Com_vWheelRR /end OUT_MEASUREMENT
/end FUNCTION
/begin FUNCTION BrkECU_fa "" /begin DEF_CHARACTERISTIC Com_swtVelocity_FA_C /end DEF_CHARACTERISTIC
 /begin OUT_MEASUREMENT Com_dVelocityCHK_FA Com_dVelocityCTR_FA Com_stVehDrvCond_FA Com_vVeh_FA /end OUT_MEASUREMENT
/end FUNCTION
/begin FUNCTION BrkECU_flex "" /begin DEF_CHARACTERISTIC Com_swtCalcVehN_C /end DEF_CHARACTERISTIC
 /begin OUT_MEASUREMENT Com_nWhl Com_nWhlFL Com_nWhlFR Com_nWhlRL Com_nWhlRR Com_stBrkTrqDVCHQl Com_stPBrkSysQl Com_stTrqStbDesQl Com_trqBrkDVCH Com_trqStbDes /end OUT_MEASUREMENT
/end FUNCTION
/begin FUNCTION BrkECU_fx ""
 /begin DEF_CHARACTERISTIC Com_swtBrPWhl_FX_C Com_swtRpmWhl_FX_C Com_swtStConintDSC_FX_C Com_swtWMomPTStab_FX_C /end DEF_CHARACTERISTIC
 /begin OUT_MEASUREMENT Com_dBrkTrqSumCHK_FX Com_dBrkTrqSumCTR_FX Com_dnWhlCHK_FX Com_dnWhlCTR_FX Com_dstDSCCHK_FX Com_dstDSCCTR_FX Com_dWhlMomPTStabCHK_FX Com_dWhlMomPTStabCTR_FX Com_nWhlFL_FX Com_nWhlFR_FX Com_nWhlRL_FX Com_nWhlRR_FX Com_pBrkSys_FX Com_stBrkTrqDVCHQl_FX Com_stClCtr_FX Com_stDecellDSC_FX Com_stDSC_FX Com_stLckGbxDemQl_FX Com_stPBrkSysQl_FX Com_stTrqStbDesQl_FX Com_trqBrkDVCH_FX Com_trqStbDes_FX /end OUT_MEASUREMENT
/end FUNCTION
/begin FUNCTION BrkECU_swt ""
 /begin IN_MEASUREMENT Com_nWhlFL Com_nWhlFL_FX Com_nWhlFR Com_nWhlFR_FX Com_nWhlRL Com_nWhlRL_FX Com_nWhlRR Com_nWhlRR_FX Com_pBrkSys Com_pBrkSys_FX Com_stBrkTrqDVCHQl Com_stBrkTrqDVCHQl_FX Com_stClCtr Com_stClCtr_FX Com_stDecellDSC Com_stDecellDSC_FX Com_stDSC Com_stDSC_FX Com_stLckGbxDemQl Com_stLckGbxDemQl_FX Com_stPBrkSysQl Com_stPBrkSysQl_FX Com_stVehDrvCond Com_stVehDrvCond_FA Com_trqBrkDVCH Com_trqBrkDVCH_FX Com_vVeh Com_vVeh_FA /end IN_MEASUREMENT
/end FUNCTION
/begin FUNCTION BrkPed_SetData "" /begin IN_MEASUREMENT Brk_st /end IN_MEASUREMENT /begin OUT_MEASUREMENT VehMot_stBrkPed /end OUT_MEASUREMENT /end FUNCTION
/begin FUNCTION BrkP_dd ""
 /begin DEF_CHARACTERISTIC BrkP_pTransf_CUR BrkP_SRC.uMin_C BrkP_SRC.uMax_C BrkP_swtRecDeAct_C BrkP_tiRecDeb_C /end DEF_CHARACTERISTIC
 /begin OUT_MEASUREMENT BrkP_bEval BrkP_bRec BrkP_bRecActv BrkP_pSens BrkP_stRec BrkP_uRaw /end OUT_MEASUREMENT
/end FUNCTION
/begin FUNCTION brkp_vd ""
 /begin DEF_CHARACTERISTIC BrkP_ctPlausErr_C BrkP_ctPlausInc_C BrkP_pDfl_C BrkP_pDiffMin_C BrkP_RmpSlp.Pos_C BrkP_RmpSlp.Neg_C BrkP_swtSensPrs_C BrkP_TransStg.Dfl_C BrkP_TransStg.stSensId_C /end DEF_CHARACTERISTIC
 /begin IN_MEASUREMENT BrkP_stRec Brk_st /end IN_MEASUREMENT
 /begin OUT_MEASUREMENT BrkP_ctPlausError BrkP_p BrkP_pHiLoEdge BrkP_pLoHiEdge BrkP_pSys BrkP_stPlausActv BrkP_stSensErr /end OUT_MEASUREMENT
 /begin LOC_MEASUREMENT BrkP_pDiffPlaus_mp /end LOC_MEASUREMENT
/end FUNCTION
/begin FUNCTION Brk_DD ""
 /begin DEF_CHARACTERISTIC Brk_MnDeb.tiHiLo_C Brk_MnDeb.tiLoHi_C Brk_RedDeb.tiHiLo_C Brk_RedDeb.tiLoHi_C /end DEF_CHARACTERISTIC
/end FUNCTION
/begin FUNCTION brk_VD ""
 /begin DEF_CHARACTERISTIC Brk_ctPlaDef_C Brk_stDflVal_C Brk_swtRedSensPrs_C Brk_tiDebPlaStat_C Brk_tiDebPla_C Brk_tiDebResPla_C /end DEF_CHARACTERISTIC
 /begin IN_MEASUREMENT Com_stBrk /end IN_MEASUREMENT
 /begin OUT_MEASUREMENT Brk_st Brk_stMn Brk_stMnRaw Brk_stRed Brk_stRedRaw /end OUT_MEASUREMENT
 /begin LOC_MEASUREMENT Brk_ctPla_mp Brk_stDeb_mp Brk_stFreeze_mp Brk_stResPla_mp Brk_tiDebPlaStat_mp /end LOC_MEASUREMENT
/end FUNCTION
/begin FUNCTION brwt ""
 /begin DEF_CHARACTERISTIC KF_DTW_QN KF_DTW_TWA KF_TAIRMHFMS KF_TAIR_MHFM KF_TWPST_MAP KL_COOLING K_BRWTDA K_BRWTKINT K_ENGSTSTRT K_QMIN S_BRWT /end DEF_CHARACTERISTIC
 /begin IN_MEASUREMENT Me_ist Ml Nkw Tn_abstell /end IN_MEASUREMENT
 /begin OUT_MEASUREMENT T_brw T_brwd1 T_brwd2 T_brwd3 T_brwd4 T_brwdg T_brwdiff T_brwnv T_brwsd T_brwsde X_KF_TAIRMHFMS_no_input_quantity X_KF_TAIR_MHFM_no_input_quantity Y_KF_DTW_TWA_no_input_quantity /end OUT_MEASUREMENT
/end FUNCTION
/begin FUNCTION Bss "" /end FUNCTION
/begin FUNCTION busdiag_busoff ""
 /begin DEF_CHARACTERISTIC BusDiag_mskstNodeA_C BusDiag_mskstNodeB_C BusDiag_mskstNodeC_C BusDiag_tiNextInitNodeA_C BusDiag_tiNextInitNodeB_C BusDiag_tiNextInitNodeC_C /end DEF_CHARACTERISTIC
 /begin OUT_MEASUREMENT BusDiag_stFadeOut /end OUT_MEASUREMENT
 /begin LOC_MEASUREMENT BusDiag_stFlexRay_mp BusDiag_stNodeA_mp BusDiag_stNodeB_mp BusDiag_stNodeC_mp /end LOC_MEASUREMENT
/end FUNCTION
/begin FUNCTION BypCan "" /end FUNCTION
/begin COMPU_METHOD Acc "" RAT_FUNC "%6.5" "m/s^2" COEFFS 0 1000 0 0 0 1 /end COMPU_METHOD
/begin COMPU_METHOD AngleStWhl "" RAT_FUNC "%6.4" "deg StWhl" COEFFS 0 32 0 0 0 1 /end COMPU_METHOD
/begin COMPU_METHOD AngleVelStWhl "" RAT_FUNC "%6.4" "deg StWhl/s" COEFFS 0 32 0 0 0 1 /end COMPU_METHOD
/begin COMPU_METHOD BusDiag_FlexRayState "" TAB_VERB "%6.3" "" COMPU_TAB_REF BusDiag_FlexRayState /end COMPU_METHOD
/begin COMPU_VTAB BusDiag_FlexRayState "" TAB_VERB 11 0 "STATE_UNDEFINED_0" 1 "STATE_CONFIG" 2 "STATE_DEFAULT_CONFIG" 3 "STATE_HALT" 4 "STATE_NORMAL_ACTIVE" 5 "STATE_NORMAL_PASSIVE" 6 "STATE_READY" 7 "STATE_STARTUP" 8 "STATE_WAKEUP" 9 "STATE_FREEZE" 10 "STATE_UNDEFINED" /end COMPU_VTAB
/begin COMPU_METHOD Def_dez_ub_q1 "" RAT_FUNC "%3.1" "-" COEFFS 0 1 0 0 0 1 /end COMPU_METHOD
/begin COMPU_METHOD Def_dez_uw_q1 "" RAT_FUNC "%5.2" "-" COEFFS 0 1 0 0 0 1 /end COMPU_METHOD
/begin COMPU_METHOD Def_f_ub_b1 "" RAT_FUNC "%6.4" "-" COEFFS 0 256 0 0 0 1 /end COMPU_METHOD
/begin COMPU_METHOD Def_me_sw_q0p01 "" RAT_FUNC "%8.5" "mg/cyc" COEFFS 0 100 0 0 0 1 /end COMPU_METHOD
/begin COMPU_METHOD Def_ml_sw_q0p1 "" RAT_FUNC "%7.4" "mg/Hub" COEFFS 0 10 0 0 0 1 /end COMPU_METHOD
/begin COMPU_METHOD Def_n_sw_q1p0 "" RAT_FUNC "%5.2" "Upm" COEFFS 0 1 0 0 0 1 /end COMPU_METHOD
/begin COMPU_METHOD Def_t_sw_q0p01 "" RAT_FUNC "%7.5" "°C" COEFFS 0 100 0 0 0 1 /end COMPU_METHOD
/begin COMPU_METHOD Def_t_sw_q0p1 "" RAT_FUNC "%6.3" "°C" COEFFS 0 10 0 0 0 1 /end COMPU_METHOD
/begin COMPU_METHOD EngN "" RAT_FUNC "%5.1" "rpm" COEFFS 0 2 0 0 0 1 /end COMPU_METHOD
/begin COMPU_METHOD ident "" RAT_FUNC "%3.1" "-" COEFFS 0 1 0 0 0 1 /end COMPU_METHOD
/begin COMPU_METHOD OneToOne "" RAT_FUNC "%6.0" "-" COEFFS 0 1 0 0 0 1 /end COMPU_METHOD
/begin COMPU_METHOD Pres_bar "" RAT_FUNC "%6.2" "bar" COEFFS 0 1 0 0 0 1 /end COMPU_METHOD
/begin COMPU_METHOD RmpPres_bar "" RAT_FUNC "%6.4" "bar/s" COEFFS 0 65.536 0 0 0 1 /end COMPU_METHOD
/begin COMPU_METHOD TimeDeb "" RAT_FUNC "%5.0" "ms" COEFFS 0 0.1 0 0 0 1 /end COMPU_METHOD
/begin COMPU_METHOD TimeDelay_s "" RAT_FUNC "%12.4" "s" COEFFS 0 0 1 0 0.00023283064365387 0 /end COMPU_METHOD
/begin COMPU_METHOD Time_ms "" RAT_FUNC "%5.0" "ms" COEFFS 0 0.1 0 0 0 1 /end COMPU_METHOD
/begin COMPU_METHOD Trq "" RAT_FUNC "%5.1" "Nm" COEFFS 0 10 0 0 0 1 /end COMPU_METHOD
/begin COMPU_METHOD TrqPrpHigh "" RAT_FUNC "%5.1" "Nm" COEFFS 0 10 0 0 0 1 /end COMPU_METHOD
/begin COMPU_METHOD Vel "" RAT_FUNC "%5.2" "km/h" COEFFS 0 100 0 0 0 1 /end COMPU_METHOD
/begin COMPU_METHOD Volt "" RAT_FUNC "%6.1" "mV" COEFFS 0 5 0 0 0 1 /end COMPU_METHOD
/begin RECORD_LAYOUT CurTKL_UW_VV_UB NO_AXIS_PTS_X 1 UBYTE RESERVED 2 BYTE AXIS_PTS_X 3 UWORD INDEX_INCR DIRECT FNC_VALUES 4 UBYTE COLUMN_DIR DIRECT /end RECORD_LAYOUT
/begin RECORD_LAYOUT Cur_Xs16Ws16 NO_AXIS_PTS_X 1 SWORD AXIS_PTS_X 2 SWORD INDEX_INCR DIRECT FNC_VALUES 3 SWORD COLUMN_DIR DIRECT /end RECORD_LAYOUT
/begin RECORD_LAYOUT Kw_Ws16 FNC_VALUES 1 SWORD COLUMN_DIR DIRECT /end RECORD_LAYOUT
/begin RECORD_LAYOUT Kw_Ws32 FNC_VALUES 1 SLONG COLUMN_DIR DIRECT /end RECORD_LAYOUT
/begin RECORD_LAYOUT Kw_Wu16 FNC_VALUES 1 UWORD COLUMN_DIR DIRECT /end RECORD_LAYOUT
/begin RECORD_LAYOUT Kw_Wu8 FNC_VALUES 1 UBYTE COLUMN_DIR DIRECT /end RECORD_LAYOUT
/begin RECORD_LAYOUT MapTKF_SW_SW_SW NO_AXIS_PTS_X 1 UBYTE NO_AXIS_PTS_Y 2 UBYTE AXIS_PTS_X 3 SWORD INDEX_INCR DIRECT AXIS_PTS_Y 4 SWORD INDEX_INCR DIRECT FNC_VALUES 5 SWORD COLUMN_DIR DIRECT /end RECORD_LAYOUT
/begin RECORD_LAYOUT Val_Ws16 FNC_VALUES 1 SWORD COLUMN_DIR DIRECT /end RECORD_LAYOUT
/begin RECORD_LAYOUT Val_Ws32 FNC_VALUES 1 SLONG COLUMN_DIR DIRECT /end RECORD_LAYOUT
/begin RECORD_LAYOUT Val_Wu16 FNC_VALUES 1 UWORD COLUMN_DIR DIRECT /end RECORD_LAYOUT
/begin RECORD_LAYOUT Val_Wu8 FNC_VALUES 1 UBYTE COLUMN_DIR DIRECT /end RECORD_LAYOUT
/end MODULE
/end PROJECT
